## drivers/hwinfo/Kconfig.nrf
```kconfig
# Copyright The Zephyr Project Contributors
# SPDX-License-Identifier: Apache-2.0

config HWINFO_NRF
	bool "NRF device ID"
	default y
	depends on SOC_FAMILY_NORDIC_NRF
	depends on !TRUSTED_EXECUTION_NONSECURE || TFM_PARTITION_PLATFORM || IRONSIDE_TE_CLIENT
	select HWINFO_HAS_DRIVER
	help
	  Enable Nordic NRF hwinfo driver.
```
