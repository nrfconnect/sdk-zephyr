## boards/nordic/nrf54lm20dk/Kconfig.sysbuild
```kconfig
# Copyright (c) 2026 Nordic Semiconductor ASA
# SPDX-License-Identifier: Apache-2.0

if BOARD_NRF54LM20DK_NRF54LM20A_CPUAPP_ITE || BOARD_NRF54LM20DK_NRF54LM20B_CPUAPP_ITE

configdefault IRONSIDE_TE
	default y

endif # BOARD_NRF54LM20DK_NRF54LM20A_CPUAPP_ITE || BOARD_NRF54LM20DK_NRF54LM20B_CPUAPP_ITE
```

## drivers/flash/Kconfig.ironside_te_rram
```kconfig
#
# Copyright (c) 2026 Nordic Semiconductor ASA
#
# SPDX-License-Identifier: Apache-2.0
#

menuconfig FLASH_IRONSIDE_TE_RRAM
	bool "IronSide TE RRAM"
	default y
	depends on DT_HAS_NORDIC_IRONSIDE_TE_RRAM_CONTROLLER_ENABLED
	select FLASH_HAS_DRIVER_ENABLED
	select FLASH_HAS_DRIVER_FILL
	select FLASH_HAS_NO_EXPLICIT_ERASE
	select FLASH_HAS_PAGE_LAYOUT
	help
	  Flash driver for the RRAM of a device booted by IronSide TE: reads are
	  memory-mapped, writes go through the IronSide TE NVM service.

if FLASH_IRONSIDE_TE_RRAM

config FLASH_IRONSIDE_TE_RRAM_FILL_CHUNK_SIZE
	int "Fill chunk size"
	default 32
	range 16 64
	help
	  Erase and fill send the fill value through the NVM service like any other
	  write, staged in a buffer on the caller's stack and sent one chunk at a
	  time. This is that chunk size, in bytes: it trades stack for secure calls,
	  at one call per chunk, or one radio-synchronized operation per chunk.
	  Must be a whole number of write blocks.

config FLASH_IRONSIDE_TE_RRAM_SYNC_WRITE_LINES
	int "Write lines per radio sync window"
	depends on !SOC_FLASH_NRF_RADIO_SYNC_NONE
	range 1 32
	default 1
	help
	  Number of write lines sent to the NVM service, in one call, per execution
	  window granted by the radio synchronization backend. The window is sized
	  for the worst-case write time of that many lines, so more lines per window
	  mean fewer secure calls and higher throughput, but longer radio blackouts.

endif # FLASH_IRONSIDE_TE_RRAM
```

## drivers/flash/Kconfig.nrf_radio_sync
```kconfig
#
# Copyright (c) 2026 Nordic Semiconductor ASA
#
# SPDX-License-Identifier: Apache-2.0
#

# Shared by the Nordic flash drivers that can run their writes
# in the execution windows of a sync backend, see soc_flash_nrf.h.

if SOC_FLASH_NRF_RRAM || FLASH_IRONSIDE_TE_RRAM

choice SOC_FLASH_NRF_RADIO_SYNC_CHOICE
	prompt "Nordic nRFx flash driver synchronization"
	default SOC_FLASH_NRF_RADIO_SYNC_TICKER if BT_LL_SW_SPLIT
	default SOC_FLASH_NRF_RADIO_SYNC_NONE
	help
	  synchronization between flash memory driver and radio.

config SOC_FLASH_NRF_RADIO_SYNC_TICKER
	bool "Nordic nRFx flash driver synchronized with radio"
	depends on BT_LL_SW_SPLIT
	help
	  Enable synchronization between flash memory driver and radio using
	  Bluetooth LE LL controller ticker API.

config SOC_FLASH_NRF_RADIO_SYNC_NONE
	bool "none"
	help
	  disable synchronization between flash memory driver and radio.

endchoice

config SOC_FLASH_NRF_TIMEOUT_MULTIPLIER
	int "Multiplier for flash operation timeouts [x0.1]"
	depends on !SOC_FLASH_NRF_RADIO_SYNC_NONE
	default 15
	help
	  This is a multiplier that will be divided by 10 that is applied
	  to the flash erase and write operations timeout. The base for
	  the multiplication would allow erasing all nRF flash pages in
	  blocking mode.

endif # SOC_FLASH_NRF_RRAM || FLASH_IRONSIDE_TE_RRAM
```

## dts/bindings/bluetooth/zephyr,bt-hci-fatal-report.yaml
```yaml
# Copyright (c) 2026 Nordic Semiconductor ASA
# SPDX-License-Identifier: Apache-2.0

description: |
  One-way channel carrying a Bluetooth fatal error report from a controller
  running on another core to the host.

  The controller writes its report from a fault handler, where the kernel can no
  longer be relied upon and where blocking is not allowed, so this channel is
  driven with nothing but plain memory accesses and a mailbox signal. It has no
  session handshake and no acknowledgement, because a core that is about to be
  reset cannot take part in either. That is also why it is kept separate from the
  IPC instance carrying HCI: a general purpose IPC backend is free to take locks
  and to defer work to a thread, neither of which survives a fault.

  Both cores must describe the same memory region and the same mailbox channel.

compatible: "zephyr,bt-hci-fatal-report"

include: base.yaml

properties:
  memory-region:
    type: phandle
    required: true
    description: |
      Memory shared between the two cores, written by the controller and read by
      the host. It has to hold one report plus eight bytes of packet buffer
      overhead.

  mboxes:
    type: phandle-array
    required: true
    description: |
      The single mailbox channel of this channel. The controller signals it after
      writing a report, and the host reads the report when signalled.

  mbox-names:
    type: string-array
    required: true

  dcache-alignment:
    type: int
    description: |
      Data cache line size of the cores sharing the memory region. Leave unset
      when neither core caches the region.
```

## dts/bindings/flash_controller/nordic,ironside-te-rram-controller.yaml
```yaml
# Copyright (c) 2026 Nordic Semiconductor ASA
# SPDX-License-Identifier: Apache-2.0

description: |
  RRAM of a device booted by IronSide TE.

  Bound in place of "nordic,rram-controller" on IronSide TE board targets:
  reads stay memory-mapped and writes go through the IronSide TE NVM service.

compatible: "nordic,ironside-te-rram-controller"

include: flash-controller.yaml
```

## modules/hal_nordic/ironside/te/Kconfig
```kconfig
# Copyright (c) 2026 Nordic Semiconductor ASA
# SPDX-License-Identifier: Apache-2.0

menuconfig IRONSIDE_TE_CLIENT
	bool "IronSide TE client"
	depends on ZEPHYR_IRONSIDE_INTEGRATION_KIT_MODULE
	depends on TRUSTED_EXECUTION_NONSECURE
	select ARM_NONSECURE_PREEMPTIBLE_SECURE_CALLS
	help
	  Client for the IronSide TE secure services: PSA Crypto, PSA Initial
	  Attestation, device management, the boot report and the platform
	  services.

if IRONSIDE_TE_CLIENT

config IRONSIDE_TE_FAULT_LOGGING
	bool "Log NS faults on reset"
	depends on LOG
	default y
	help
	  Read the boot report on boot and log the fault IronSide TE recorded, if any.
	  When a fault is caught, IronSide TE takes it and resets the device.

config IRONSIDE_TE_BOOT_LAYOUT_CHECK
	bool "Check the layout against the boot report"
	depends on LOG
	default y
	help
	  Compare the partitions and non-secure RAM the boot report says are in
	  effect with the devicetree this image was built from, and log every
	  difference.

if IRONSIDE_TE_FAULT_LOGGING || IRONSIDE_TE_BOOT_LAYOUT_CHECK

module = IRONSIDE_TE
module-str = IronSide TE
source "subsys/logging/Kconfig.template.log_config"

endif # IRONSIDE_TE_FAULT_LOGGING || IRONSIDE_TE_BOOT_LAYOUT_CHECK

config IRONSIDE_TE_KEYSET
	string "Key source holding the application signing key"
	default "keyring:dev"
	help
	  Passed as --keyset to ironsdk/scripts/sign.py: keyring:<keyset> or
	  dir:<path>. Sysbuild sets it from SB_CONFIG_IRONSIDE_TE_KEYSET.

config IRONSIDE_TE_SIGN_VERSION
	string "Application image version, MAJOR.MINOR.PATCH[.TWEAK]"
	default "0.0.0.1" if "$(VERSION_MAJOR)" = ""
	default "$(VERSION_MAJOR).$(VERSION_MINOR).$(PATCHLEVEL).$(VERSION_TWEAK)"
	help
	  Passed as --version to ironsdk/scripts/sign.py. Set either manually
	  or through the application's VERSION file.
	  The security counter is derived from it: once a device has booted
	  an image, it rejects any image with a lower version.

endif # IRONSIDE_TE_CLIENT

choice PSA_CRYPTO_PROVIDER
	default PSA_CRYPTO_PROVIDER_IRONSIDE_TE

# IronSide TE is precompiled, so its PSA Crypto capabilities are fixed.
config PSA_CRYPTO_PROVIDER_IRONSIDE_TE
	bool "Use IronSide TE"
	depends on IRONSIDE_TE_CLIENT
	select PSA_PROMPTLESS
	select PSA_WANT_ALG_SHA_256
	select PSA_WANT_ALG_SHA_384
	select PSA_WANT_ALG_SHA_512
	select PSA_WANT_ALG_SHA3_224
	select PSA_WANT_ALG_SHA3_256
	select PSA_WANT_ALG_SHA3_384
	select PSA_WANT_ALG_SHA3_512
	select PSA_WANT_ALG_HMAC
	select PSA_WANT_ALG_CMAC
	select PSA_WANT_ALG_SP800_108_COUNTER_CMAC
	select PSA_WANT_ALG_CBC_NO_PADDING
	select PSA_WANT_ALG_CBC_PKCS7
	select PSA_WANT_ALG_CTR
	select PSA_WANT_ALG_ECB_NO_PADDING
	select PSA_WANT_ALG_CCM
	select PSA_WANT_ALG_GCM
	select PSA_WANT_ALG_CHACHA20_POLY1305
	select PSA_WANT_ALG_ECDSA
	select PSA_WANT_ALG_ECDH
	select PSA_WANT_ALG_JPAKE
	select PSA_WANT_KEY_TYPE_AES
	select PSA_WANT_KEY_TYPE_CHACHA20
	select PSA_WANT_KEY_TYPE_HMAC
	select PSA_WANT_KEY_TYPE_DERIVE
	select PSA_WANT_KEY_TYPE_ECC_PUBLIC_KEY
	select PSA_WANT_KEY_TYPE_ECC_KEY_PAIR_IMPORT
	select PSA_WANT_KEY_TYPE_ECC_KEY_PAIR_EXPORT
	select PSA_WANT_KEY_TYPE_ECC_KEY_PAIR_GENERATE
	select PSA_WANT_ECC_SECP_R1_256
	select PSA_WANT_ECC_SECP_R1_384
	select PSA_WANT_ECC_MONTGOMERY_255

endchoice # PSA_CRYPTO_PROVIDER

if PSA_CRYPTO_PROVIDER_IRONSIDE_TE && SECURE_STORAGE_ITS_TRANSFORM_IMPLEMENTATION_AEAD

# The keys live in IronSide TE, so derive the entries' encryption key from its
# Master External Storage Key rather than handle key material here.
choice SECURE_STORAGE_ITS_TRANSFORM_AEAD_CRYPT
	default SECURE_STORAGE_ITS_TRANSFORM_AEAD_CRYPT_DERIVED_KEY
endchoice

endif # PSA_CRYPTO_PROVIDER_IRONSIDE_TE && SECURE_STORAGE_ITS_TRANSFORM_IMPLEMENTATION_AEAD
```

## soc/nordic/nrf54l/Kconfig.sysbuild
```kconfig
# Copyright (c) 2025 Nordic Semiconductor ASA
# SPDX-License-Identifier: Apache-2.0

if SOC_NRF54L05_CPUFLPR || SOC_NRF54L10_CPUFLPR || SOC_NRF54L15_CPUFLPR || \
	SOC_NRF54LM20A_CPUFLPR || SOC_NRF54LM20B_CPUFLPR || SOC_NRF54LV10A_CPUFLPR

config HAS_NORDIC_VPR_LAUNCHER_IMAGE
	default y

endif

config IRONSIDE_TE
	bool
	help
	  IronSide TE provides the roots of trust and a set of secure services.
	  It replaces MCUboot: the application is a non-secure image signed with
	  the IronSide Integration Kit tooling and booted by the IronSide TE UROT.

if IRONSIDE_TE

config IRONSIDE_TE_KEYSET
	string "Key source holding the application signing key"
	default "keyring:dev"
	help
	  Passed as --keyset to the IronSide Integration Kit tools:
	  keyring:<keyset> or dir:<path>. The keyset must already exist,
	  created with ironsdk/scripts/iron_keychain.py, and the device must
	  be provisioned with its public half, or it rejects the signed image.

endif # IRONSIDE_TE

# IronSide TE is the bootloader, so MCUboot must not be built alongside it.
configdefault SUPPORT_BOOTLOADER_MCUBOOT_ZEPHYR
	default n if IRONSIDE_TE
```

## soc/nordic/nrf71/Kconfig.wifi_patch
```kconfig
# Copyright (c) 2026 Nordic Semiconductor ASA
# SPDX-License-Identifier: Apache-2.0

# Declared here because SoC code references it. Defaults and menu entry are
# supplied by the nrf71_wifi module in nrfxlib.
config WIFI_NRF71_PATCH
	bool

if WIFI_NRF71_PATCH

config WIFI_NRF71_PATCH_LMAC_ORIGIN
	hex "LMAC ROM patch MRAM origin" if WIFI_NRF71_PATCH_OVERRIDE_ORIGINS
	hex
	help
	  Fixed MRAM address of the LMAC ROM patch.

config WIFI_NRF71_PATCH_UMAC_ORIGIN
	hex "UMAC ROM patch MRAM origin" if WIFI_NRF71_PATCH_OVERRIDE_ORIGINS
	hex
	help
	  Fixed MRAM address of the UMAC ROM patch.

config WIFI_NRF71_PATCH_LMAC_SIZE
	int "LMAC ROM patch size in bytes"
	help
	  Size of the LMAC ROM patch in bytes. Defaults are supplied by the
	  nrf71_wifi module for the selected patch variant.

config WIFI_NRF71_PATCH_UMAC_SIZE
	int "UMAC ROM patch size in bytes"
	help
	  Size of the UMAC ROM patch in bytes. Defaults are supplied by the
	  nrf71_wifi module for the selected patch variant.

endif # WIFI_NRF71_PATCH
```
