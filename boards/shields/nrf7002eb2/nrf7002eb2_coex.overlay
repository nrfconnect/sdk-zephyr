/*
 * Copyright (c) 2026 Nordic Semiconductor
 *
 * SPDX-License-Identifier: Apache-2.0
 *
 * SR co-existence via expansion_board_header (same nexus as main shield;
 * nRF54L15 DK and nRF54L(m)20 DK).
 */

/ {
	nrf_radio_coex: coex {
		compatible = "nordic,nrf7002-coex";
		status = "okay";
		status0-gpios = <&expansion_board_header 8 GPIO_ACTIVE_HIGH>;
		req-gpios = <&expansion_board_header 9 GPIO_ACTIVE_HIGH>;
		grant-gpios = <&expansion_board_header 12 (GPIO_PULL_DOWN | GPIO_ACTIVE_LOW)>;
	};
};
