## dts/bindings/arm/nordic,nrf-spu.yaml
```yaml
description: Nordic SPU (System Protection Unit)

compatible: "nordic,nrf-spu"

include: base.yaml

properties:
    reg:
      required: true

    interrupts:
      required: true

    ram-regions:
      type: array
      description: number of lockable ram regions and granularity
      required: true

    flash-regions:
      type: array
      description: number of lockable flash regions and granularity
      required: true
```

## dts/bindings/clock/nordic,nrf-clock.yaml
```yaml
---
title: NORDIC NRF CLOCK CONTROL
id: nordic,nrf-clock
version: 0.1

description: >
    This binding gives a base representation of the NRF Clock control

properties:
    compatible:
      type: string
      category: required
      description: compatible strings
      constraint: "nordic,nrf-clock"

    reg:
      type: array
      description: mmio register space
      generation: define
      category: required

    interrupts:
      type: array
      category: required
      description: required interrupts
      generation: define
...
```

## dts/bindings/flash_controller/nordic,nrf91-flash-controller.yaml
```yaml
---
title: Nordic NVMC
id: nordic,nrf91-flash-controller
version: 0.1

description: >
    This binding gives a base representation of the Nordic NVMC

inherits:
    !include flash-controller.yaml

properties:
    compatible:
      constraint: "nrf,nrf91-flash-controller"

...
```

## dts/bindings/gpio/nordic,expansion-board-header.yaml
```yaml
# Copyright (c) 2025 Nordic Semiconductor ASA
# SPDX-License-Identifier: Apache-2.0

description: |
  Nordic Expansion Board header

compatible: "nordic,expansion-board-header"

include:
  - base.yaml
  - gpio-nexus.yaml
```

## dts/bindings/i2s/i2s.yaml
```yaml
#
# Copyright (c) 2018, STMicroelectronics
#
# SPDX-License-Identifier: Apache-2.0
#
---
title: I2S Base Structure
version: 0.1

description: >
    This binding gives the base structures for all I2S devices

child:
    bus: i2s

properties:
    compatible:
      type: string
      category: required
      description: compatible strings
      generation: define
    "#address-cells":
      type: int
      category: required
      description: should be 1.
    "#size-cells":
      type: int
      category: required
      description: should be 0.
    label:
      type: string
      category: required
      description: Human readable string describing the device (used by Zephyr for API name)
      generation: define
    clocks:
      type: array
      category: optional
      description: Clock gate information
      generation: define


...
```

## dts/bindings/mbox/nordic,nrf-vevif-reliable.yaml
```yaml
# Copyright (c) 2026 Nordic Semiconductor ASA
# SPDX-License-Identifier: Apache-2.0

description: |
  Reliable signalling wrapper for Nordic VEVIF-based MBOX channels.

  This controller wraps raw TX/RX mailbox channels and augments them with a
  tiny shared-memory protocol. The raw mailbox remains a doorbell only, while
  shared counters track how many logical signals were produced and consumed.

  The wrapper guarantees that consecutive sends are replayed as distinct RX
  callbacks as long as both sides use the same shared memory region and the
  receiver enables its RX channel before traffic starts.

compatible: "nordic,nrf-vevif-reliable"

include: [base.yaml, mailbox-controller.yaml]

properties:
  memory-region:
    type: phandle
    required: true
    description: Phandle to shared memory region used for reliable state.

  mboxes:
    required: true
    description: Raw MBOX channel specifiers. Must contain RX and TX entries.

  mbox-names:
    required: true
    description: Raw MBOX channel names. Must be called "rx" and "tx".

  nordic,local-id:
    type: int
    required: true
    enum: [0, 1]
    description: |
      Local side identifier used to map shared counters. Side 0 transmits using
      slot 0 and receives using slot 1. Side 1 transmits using slot 1 and
      receives using slot 0.

mbox-cells:
  - channel
```

## dts/bindings/memory-controllers/nordic,nrf-nvmc.yaml
```yaml
---
title: Nordic Non-volatile Memory Controller
version: 1.0

description: >
    This binding gives a base representation of the Nordic NVMC (Non-volatile Memory Controller)

properties:
    compatible:
      type: string
      category: required
      description: compatible strings
      constraint: "nordic,nrf-nvmc"
      generation: define

    reg:
      type: array
      description: mmio register space
      generation: define
      category: required

    label:
      type: string
      category: required
      description: Human readable string describing the device (used by Zephyr for API name)
      generation: define
...
```

## dts/bindings/misc/nordic,nrf-spu-v2.yaml
```yaml
description: Nordic SPU (System Protection Unit)

compatible: "nordic,nrf-spu-v2"

include: base.yaml

properties:
    reg:
      required: true

    interrupts:
      required: true

    remapped-periph-ids:
      type: array
      description: |
        Array of index pairs that denote bus peripherals that should use a
        different ID on the same bus for configurations. The indices are
        represented as a pair of numbers:

          {periph_id_0, remapped_id_0, ..., periph_id_n, remapped_id_n}

        where each pair denotes that configuration for PERIPH.PERM[periph_id_n]
        should instead be written to PERIPH.PERM[remapped_id_n].
```
