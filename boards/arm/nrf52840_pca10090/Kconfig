## boards/arm/nrf52840_pca10090/Kconfig
```kconfig
# Kconfig - nRF52840 PCA10090 board configuration
#
# Copyright (c) 2018 Nordic Semiconductor ASA
#
# SPDX-License-Identifier: Apache-2.0

if BOARD_NRF52840_PCA10090

config BOARD_ENABLE_DCDC
        bool "Enable DCDC mode"
        select SOC_DCDC_NRF52X
        default y

choice
	prompt "nRF9160 UART0 routing"
	default BOARD_PCA10090_UART0_VCOM

config BOARD_PCA10090_UART0_VCOM
	bool "Route to VCOM0"

config BOARD_PCA10090_UART0_ARDUINO
	bool "Route to Arduino interface"

endchoice

choice
	prompt "nRF9160 UART1 routing"
	default BOARD_PCA10090_UART1_VCOM

config BOARD_PCA10090_UART1_VCOM
	bool "Route to VCOM2"

config BOARD_PCA10090_UART1_ARDUINO
	bool "Route to Arduino interface"

endchoice

choice
	prompt "LED pins routing"
	default BOARD_PCA10090_LED_PHY

config BOARD_PCA10090_LED_PHY
	bool "Route to LED on the kit"

config BOARD_PCA10090_LED_ARDUINO
	bool "Route to Arduino interface"

endchoice

choice
	prompt "Button pins routing"
	default BOARD_PCA10090_BUTTON_PHY

config BOARD_PCA10090_BUTTON_PHY
	bool "Route to buttons on the kit"

config BOARD_PCA10090_BUTTON_ARDUINO
	bool "Route to Arduino interface"

endchoice

choice
	prompt "Switch pins routing"
	default BOARD_PCA10090_SWITCH_PHY

config BOARD_PCA10090_SWITCH_PHY
	bool "Route to switches on the kit"

config BOARD_PCA10090_SWITCH_ARDUINO
	bool "Route to Arduino interface"

endchoice

choice
	prompt "Interface pins 0-2"
	default BOARD_PCA10090_INTERFACE_0_ARDUINO

config BOARD_PCA10090_INTERFACE_0_ARDUINO
	bool "Route to Arduino interface"
	help
	 Pin 0: nRF9160 P0.17 connects to A3
	 Pin 1: nRF9160 P0.18 connects to A4
	 Pin 2: nRF9160 P0.19 connects to A5

config BOARD_PCA10090_INTERFACE_0_MCU
	bool "Route to nRF52840"
	help
	 This connects the following pins on the nRF9160 to pins on the nRF52840:
	 Pin 0: nRF9160 P0.17 connects to nRF52840 P0.17
	 Pin 1: nRF9160 P0.18 connects to nRF52840 P0.20
	 Pin 2: nRF9160 P0.19 connects to nRF52840 P0.15

endchoice

choice
	prompt "Interface pins 3-5"
	default BOARD_PCA10090_INTERFACE_1_TRACE

config BOARD_PCA10090_INTERFACE_1_TRACE
	bool "Route to TRACE interface"
	help
	 Pin 3: nRF9160 P0.21 connects to TRACECLK
	 Pin 4: nRF9160 P0.22 connects to TRACEDATA0
	 Pin 5: nRF9160 P0.23 connects to TRACEDATA1

config BOARD_PCA10090_INTERFACE_1_MCU
	bool "Route to nRF52840"
	help
	 Pin 3: nRF9160 P0.21 connects to nRF52840 P0.22
	 Pin 4: nRF9160 P0.22 connects to nRF52840 P1.04
	 Pin 5: nRF9160 P0.23 connects to nRF52840 P1.02

endchoice

choice
	prompt "Interface pins 6-8"
	default BOARD_PCA10090_INTERFACE_2_COEX

config BOARD_PCA10090_INTERFACE_2_COEX
	bool "Route to COEX interface"

config BOARD_PCA10090_INTERFACE_2_MCU
	bool "Route to nRF52840"
	help
	 Pin 6: nRF9160 COEX0 connects to nRF52840 P1.15
	 Pin 7: nRF9160 COEX1 connects to nRF52840 P0.11
	 Pin 8: nRF9160 COEX2 connects to nRF52840 P1.15

endchoice

endif # BOARD_NRF52840_PCA10090
```

## boards/arm/nrf52840_pca20035/Kconfig.board
```kconfig
# Kconfig - nRF52840 PCA20035 board configuration
#
# Copyright (c) 2016 Nordic Semiconductor ASA
#
# SPDX-License-Identifier: Apache-2.0

config  BOARD_NRF52840_PCA20035
	bool "NRF52840 PCA20035"
	depends on SOC_NRF52840_QIAA
```

## boards/arm/nrf52_pca20041/Kconfig.board
```kconfig
#
# Copyright (c) 2018 Nordic Semiconductor
#
# SPDX-License-Identifier: BSD-5-Clause-Nordic
#

config  BOARD_NRF52_PCA20041
	bool "nRF52 PCA20041"
	depends on SOC_NRF52832_QFAA
```

## boards/arm/nrf9160_pca20035/Kconfig.board
```kconfig
# Kconfig - nRF91 PCA20035 board configuration
#
# Copyright (c) 2018 Nordic Semiconductor ASA
#
# SPDX-License-Identifier: Apache-2.0

config BOARD_NRF9160_PCA20035
	bool "nRF9160 PCA20035"
	depends on SOC_NRF9160_SICA
```

## boards/arm/nrf9160_pca20035/Kconfig.defconfig
```kconfig
# Kconfig - nRF91 PCA20035 board configuration
#
# Copyright (c) 2018 Nordic Semiconductor ASA
#
# SPDX-License-Identifier: Apache-2.0

if BOARD_NRF9160_PCA20035

config BOARD
	default "nrf9160_pca20035"

if I2C

config I2C_2
	default y

endif # I2C

if SPI

config SPI_3
	default y

endif # SPI

endif # BOARD_NRF9160_PCA20035
```

## boards/arm/nrf9160_pca20035/nrf9160_pca20035ns_defconfig
```kconfig
CONFIG_ARM=y
CONFIG_SOC_FAMILY_NRF=y
CONFIG_SOC_SERIES_NRF91X=y
CONFIG_SOC_NRF9160_SICA=y
CONFIG_BOARD_NRF9160_PCA20035=y

# Enable MPU
CONFIG_ARM_MPU=y

# Enable TrustZone-M
CONFIG_ARM_TRUSTZONE_M=y

# This Board implies building Non-Secure firmware
CONFIG_TRUSTED_EXECUTION_NONSECURE=y

# Enable GPIO
CONFIG_GPIO=y

# Enable UARTE
CONFIG_SERIAL=y
CONFIG_UART_NRFX=y
CONFIG_UART_0_NRF_UARTE=y

# Enable console
CONFIG_CONSOLE=y
CONFIG_UART_CONSOLE=y

# Enable I2C
CONFIG_I2C=y
CONFIG_HAS_NRFX=y
CONFIG_I2C_NRFX=y
CONFIG_I2C_2=y
CONFIG_I2C_2_NRF_TWIM=y

# Enable SPI
CONFIG_SPI=y
CONFIG_HAS_NRFX=y
CONFIG_SPI_NRFX=y
CONFIG_SPI_3=y
CONFIG_SPI_3_NRF_SPIM=y

# Disable entropy driver, as it's not yet implemented for nRF9160
CONFIG_ENTROPY_NRF5_RNG=n
```

## boards/nordic/nrf54h20dk/Kconfig.sysbuild
```kconfig
# Copyright (c) 2025 Nordic Semiconductor ASA
# SPDX-License-Identifier: Apache-2.0

config SECURE_BOOT_APPCORE
	default y if BOARD_NRF54H20DK_NRF54H20_CPUAPP_IRON_MCUBOOT_B0

choice BOOTLOADER
	default BOOTLOADER_MCUBOOT if BOARD_NRF54H20DK_NRF54H20_CPUAPP_IRON_MCUBOOT_B0
endchoice
```

## boards/nordic/nrf54l15dk/Kconfig.defconfig
```kconfig
# Copyright (c) 2024 Nordic Semiconductor ASA
# SPDX-License-Identifier: Apache-2.0

if BOARD_NRF54L15DK_NRF54L15_CPUAPP

config BT_CTLR
	default BT

config ROM_START_OFFSET
	default 0 if PARTITION_MANAGER_ENABLED
	default 0x800 if BOOTLOADER_MCUBOOT

endif # BOARD_NRF54L15DK_NRF54L15_CPUAPP

# What MCUboot requires is here
if MCUBOOT

# Within sdk-nrf NRF security is default
config NRF_SECURITY
	default y
	select NRF_OBERON

# NRF_SECURITY enforces PSA crypt
config MBEDTLS
	default n

endif # MCUBOOT

if BOARD_NRF54L15DK_NRF54L15_CPUAPP_NS

config BT_CTLR
	default BT

# By default, if we build for a Non-Secure version of the board,
# enable building with TF-M as the Secure Execution Environment.
config BUILD_WITH_TFM
	default y if BOARD_NRF54L15DK_NRF54L15_CPUAPP_NS

# By default, if we build with TF-M, instruct build system to
# flash the combined TF-M (Secure) & Zephyr (Non Secure) image
config TFM_FLASH_MERGED_BINARY
	default y
	depends on BUILD_WITH_TFM

endif #BOARD_NRF54L15DK_NRF54L15_CPUAPP_NS
```

## boards/nordic/nrf54l15pdk/Kconfig.nrf54l15pdk
```kconfig
# Copyright (c) 2024 Nordic Semiconductor ASA
# SPDX-License-Identifier: Apache-2.0

config BOARD_NRF54L15PDK
	select SOC_NRF54L15_ENGA_CPUAPP if BOARD_NRF54L15PDK_NRF54L15_CPUAPP || BOARD_NRF54L15PDK_NRF54L15_CPUAPP_NS
	select SOC_NRF54L15_ENGA_CPUFLPR if BOARD_NRF54L15PDK_NRF54L15_CPUFLPR || \
					    BOARD_NRF54L15PDK_NRF54L15_CPUFLPR_XIP

if SOC_NRF54L15_ENGA_CPUFLPR && PARTITION_MANAGER_ENABLED
config FLASH_BASE_ADDRESS
	hex
	default 0x0
config FLASH_SIZE
	int
	default 1524
endif
```

## boards/qemu/xtensa/board.yml
```yaml
board:
  name: qemu_xtensa
  full_name: QEMU Emulation for Xtensa
  vendor: cdns
  socs:
  - name: dc233c
    variants:
    - name: mmu
```

## drivers/display/Kconfig.tn0xxx
```kconfig
# Copyright (c) 2023 Alen Daniel
# SPDX-License-Identifier: Apache-2.0

config TN0XXX
	bool "Kyocera TN0XXX memory display controller driver"
	default y
	depends on DT_HAS_KYO_TN0XXX_ENABLED
	select SPI
	help
	  Enable driver for kyocera memory in pixel tft display series TN0XXX

if TN0XXX

config TN0XXX_VERTICAL_BIT_MAPPING
	bool "TN0XXX uses bitmaps with bits aligned vertically"
	default n
	help
	  Initialize display in portrait orientation using bitmaps aligned vertically

config TN0XXX_ROTATED_180_DEGREE
	bool "TN0XXX display rotated 180 degrees and bits aligned vertically"
	default n
	help
	  Initialize display in portrait orientation using bitmaps aligned vertically,
	  except that the display orientation is flipped by 180 degrees

endif # TN0XXX
```

## drivers/mbox/Kconfig.nrf_vevif_reliable
```kconfig
# Copyright (c) 2026 Nordic Semiconductor ASA
# SPDX-License-Identifier: Apache-2.0

config MBOX_NRF_VEVIF_RELIABLE
	bool "nRF VEVIF reliable signalling wrapper"
	depends on DT_HAS_NORDIC_NRF_VEVIF_RELIABLE_ENABLED
	default y
	help
	  Reliable signalling layer built on top of raw Nordic VEVIF mailbox
	  channels. This wrapper uses shared counters and acknowledgements to
	  guarantee that consecutive sends are replayed as distinct RX callbacks.

config MBOX_NRF_VEVIF_RELIABLE_INIT_PRIORITY
	int "Reliable VEVIF init priority"
	default 41
	depends on MBOX_NRF_VEVIF_RELIABLE
	help
	  Initialization priority for the reliable VEVIF wrapper. This must be
	  later than the raw MBOX init priority.

config MBOX_NRF_VEVIF_RELIABLE_LOCK_WAIT_USEC
	int "Reliable VEVIF sender lock wait"
	default 10000
	range 1 1000000
	depends on MBOX_NRF_VEVIF_RELIABLE
	help
	  Maximum time spent waiting for the reliable sender lock.

config MBOX_NRF_VEVIF_RELIABLE_RETRY_DELAY_USEC
	int "Reliable VEVIF retry delay"
	default 10
	range 1 100000
	depends on MBOX_NRF_VEVIF_RELIABLE
	help
	  Delay between acknowledgment polls and retransmission attempts.

config MBOX_NRF_VEVIF_RELIABLE_MAX_RETRIES
	int "Reliable VEVIF retransmission attempts"
	default 1000
	range 1 1000000
	depends on MBOX_NRF_VEVIF_RELIABLE
	help
	  Number of notify/retry cycles before reliable send times out.
```

## drivers/misc/nordic_spu/Kconfig
```kconfig
#
# Copyright (c) 2023 Nordic Semiconductor ASA
#
# SPDX-License-Identifier: LicenseRef-Nordic-5-Clause
#

config NORDIC_SPU
	bool "SPU driver"
	depends on !TRUSTED_EXECUTION_NONSECURE
	depends on DT_HAS_NORDIC_NRF_SPU_V2_ENABLED
	default y
	help
	  This library provides functions for configuring SPU instances in
	  Haltium MCUs.

if NORDIC_SPU

config SPU_DEVICE_INIT_PRIORITY
	int "SPU device driver init priority"
	default KERNEL_INIT_PRIORITY_DEVICE
	help
	  Device priority to use for initializing the SPU driver. This can be set
	  to something other than the default kernel priority for CPUs that must
	  configure their SPU in a specific order.

config SPU_PERIPHERAL_DEFAULT_LOCK_STATE
	bool "Default peripheral lock state"
	help
	  Lock all peripherals configured through the device driver. Peripherals
	  locked this way will remain locked until the next reset of the SPU's
	  domain.

config SPU_FEATURE_DEFAULT_LOCK_STATE
	bool "Default feature lock state"
	help
	  Lock all features configured through the device driver. Features locked
	  this way will remain locked until the next reset of the SPU's domain.

module = SPU
module-str = SPU Configuration
source "subsys/logging/Kconfig.template.log_config"

config SPU_LOG_PERIPH_CONFIGS
	bool "Log peripheral configurations"
	depends on SPU_LOG_LEVEL_INF || SPU_LOG_LEVEL_DBG
	default y
	help
	  Enable logging for peripheral configurations. Can help reduce log
	  flooding, such as during debugging feature configurations and peripheral
	  configuration is do-not-care.

config SPU_LOG_REMAPPED_PERIPH_IDS
	bool "Log peripheral ID remapping"
	depends on SPU_LOG_PERIPH_CONFIGS
	depends on SPU_LOG_LEVEL_DBG
	default y
	help
	  Internal switch for logging extra debugging information for peripherals
	  that have remapped IDs for their SPU configuration.

config SPU_LOG_FEATURE_CONFIGS
	bool "Log feature configurations"
	depends on SPU_LOG_LEVEL_INF || SPU_LOG_LEVEL_DBG
	default y
	help
	  Enable logging for feature configurations. As there are many of these,
	  they can easily flood the logging output and cause more important logging
	  messages to be dropped.

feature=BELLBOARD
rsource "Kconfig.template.log_feature"
feature=DPPI
rsource "Kconfig.template.log_feature"
feature=GPIO
rsource "Kconfig.template.log_feature"
feature=GPIOTE
rsource "Kconfig.template.log_feature"
feature=GRTC
rsource "Kconfig.template.log_feature"
feature=IPCT
rsource "Kconfig.template.log_feature"

endif # SPU
```

## drivers/misc/nordic_spu/Kconfig.template.log_feature
```kconfig
#
# Copyright (c) 2023 Nordic Semiconductor ASA
#
# SPDX-License-Identifier: LicenseRef-Nordic-5-Clause
#

config SPU_LOG_FEATURE_$(feature)
	bool "Log $(feature) feature configs"
	depends on SPU_LOG_FEATURE_CONFIGS
	default y
	help
	  Enable logging output for configurations of the SPU feature.
```

## drivers/modem/Kconfig.cellular
```kconfig
# Copyright (c) 2023 Bjarki Arge Andreasen
# SPDX-License-Identifier: Apache-2.0

config MODEM_CELLULAR
	bool "Generic cellular modem support"
	select MODEM_MODULES
	select MODEM_PPP
	select MODEM_CMUX
	select MODEM_CHAT
	select MODEM_PIPE
	select MODEM_PIPELINK
	select MODEM_BACKEND_UART
	select RING_BUFFER
	select NET_L2_PPP_OPTION_MRU
	depends on (DT_HAS_QUECTEL_BG95_ENABLED || DT_HAS_ZEPHYR_GSM_PPP_ENABLED || \
		    DT_HAS_SIMCOM_SIM7080_ENABLED || DT_HAS_U_BLOX_SARA_R4_ENABLED || \
		    DT_HAS_U_BLOX_SARA_R5_ENABLED || DT_HAS_SWIR_HL7800_ENABLED || \
		    DT_HAS_TELIT_ME910G1_ENABLED || DT_HAS_QUECTEL_EG25_G_ENABLED || \
		    DT_HAS_NORDIC_NRF91_SLM_ENABLED || DT_HAS_SQN_GM02S_ENABLED)
	help
	  This driver uses the generic 3gpp AT commands, along
	  with the standard protocols CMUX and PPP, to configure
	  cellular modems to establish a point-to-point
	  network connection. It is a template for tailored
	  drivers for the ublox, quectel and other modems, which
	  include power management and more complex device specific
	  features.

if MODEM_CELLULAR

config MODEM_CELLULAR_APN
	string "APN"
	default "internet"

config MODEM_CELLULAR_PERIODIC_SCRIPT_MS
	int "Periodic script interval in milliseconds"
	default 2000

config MODEM_CELLULAR_UART_BUFFER_SIZES
	int "The UART receive and transmit buffer sizes in bytes."
	default 512

config MODEM_CELLULAR_CMUX_MAX_FRAME_SIZE
	int "The maximum CMUX frame size in bytes."
	default 128
	help
	  This value affects the size of buffers used to receive and transmit CMUX frames.

config MODEM_CELLULAR_CHAT_BUFFER_SIZES
	int "The size of the buffers used for the chat scripts in bytes."
	default 128

config MODEM_CELLULAR_USER_PIPE_BUFFER_SIZES
	int "The size of the buffers used for each user pipe in bytes."
	default 128

choice
	default MODEM_CELLULAR_UART_BAUDRATE_115200
	prompt "Choose a uart baudrate"

	config MODEM_CELLULAR_UART_BAUDRATE_9600
		bool "9600"
	config MODEM_CELLULAR_UART_BAUDRATE_19200
		bool "19200"
	config MODEM_CELLULAR_UART_BAUDRATE_38400
		bool "38400"
	config MODEM_CELLULAR_UART_BAUDRATE_57600
		bool "57600"
	config MODEM_CELLULAR_UART_BAUDRATE_115200
		bool "115200"
	config MODEM_CELLULAR_UART_BAUDRATE_230400
		bool "230400"
	config MODEM_CELLULAR_UART_BAUDRATE_460800
		bool "460800"
endchoice

config MODEM_CELLULAR_UART_BAUDRATE
	int
	default 9600 if MODEM_CELLULAR_UART_BAUDRATE_9600
	default 19200 if MODEM_CELLULAR_UART_BAUDRATE_19200
	default 38400 if MODEM_CELLULAR_UART_BAUDRATE_38400
	default 57600 if MODEM_CELLULAR_UART_BAUDRATE_57600
	default 115200 if MODEM_CELLULAR_UART_BAUDRATE_115200
	default 230400 if MODEM_CELLULAR_UART_BAUDRATE_230400
	default 460800 if MODEM_CELLULAR_UART_BAUDRATE_460800

config MODEM_CELLULAR_CMUX_BAUDRATE
	int
	default 1 if MODEM_CELLULAR_UART_BAUDRATE_9600
	default 2 if MODEM_CELLULAR_UART_BAUDRATE_19200
	default 3 if MODEM_CELLULAR_UART_BAUDRATE_38400
	default 4 if MODEM_CELLULAR_UART_BAUDRATE_57600
	default 5 if MODEM_CELLULAR_UART_BAUDRATE_115200
	default 6 if MODEM_CELLULAR_UART_BAUDRATE_230400
	default 7 if MODEM_CELLULAR_UART_BAUDRATE_460800

endif
```

## dts/bindings/arm/nordic,nrf-ficr.yaml
```yaml
---
title: Nordic FICR (Factory Information Configuration)
version: 0.1

description: >
    Binding for the Nordic FICR (Factory Information Configuration)

properties:
    compatible:
      type: string
      category: required
      description: compatible strings
      constraint: "nordic,nrf-ficr"
      generation: define

    reg:
      type: array
      description: mmio register space
      generation: define
      category: required

...
```
