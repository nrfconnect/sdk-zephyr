## tests/subsys/ipc/ipc_sessions/testcase.yaml
```yaml
sample:
  name: IPC Service integration test
  description: IPC Service integration and efficiency test

common:
  sysbuild: true
  tags: ipc ipc_sessions
  harness: ztest

tests:
  sample.ipc.ipc_sessions.nrf5340dk:
    platform_allow:
      - nrf5340dk/nrf5340/cpuapp
    integration_platforms:
      - nrf5340dk/nrf5340/cpuapp
  sample.ipc.ipc_sessions.nrf54h20dk_cpuapp_cpurad:
    platform_allow:
      - nrf54h20dk/nrf54h20/cpuapp
    integration_platforms:
      - nrf54h20dk/nrf54h20/cpuapp
    extra_configs:
      - CONFIG_IPC_TEST_SKIP_CORE_RESET=y
  sample.ipc.ipc_sessions.nrf54h20dk_cpuapp_cpuppr:
    platform_allow:
      - nrf54h20dk/nrf54h20/cpuapp
    integration_platforms:
      - nrf54h20dk/nrf54h20/cpuapp
    extra_args: >-
      FILE_SUFFIX=cpuppr
      ipc_sessions_SNIPPET=nordic-ppr
```

## tests/subsys/jwt/testcase.yaml
```yaml
common:
  filter: CONFIG_FULL_LIBC_SUPPORTED
  min_ram: 96
  min_flash: 72
  timeout: 120
  tags: jwt
  integration_platforms:
    - qemu_x86
  extra_configs:
    - CONFIG_TEST_RANDOM_GENERATOR=y
  platform_exclude:
    - max32657evkit/max32657/ns
tests:
  libraries.encoding.jwt.ecdsa.psa:
    extra_configs:
      - CONFIG_JWT_SIGN_ECDSA_PSA=y
      # Explicitly select CONFIG_MBEDTLS_PSA_CRYPTO_EXTERNAL_RNG because this
      # is not automatically selected on platforms that do not have a CSPRNG
      # source.
      - CONFIG_MBEDTLS_PSA_CRYPTO_EXTERNAL_RNG=y
      - CONFIG_MBEDTLS_PSA_CRYPTO_EXTERNAL_RNG_ALLOW_NON_CSPRNG=y
      - CONFIG_MBEDTLS_ENABLE_HEAP=y
  libraries.encoding.jwt.rsa.legacy:
    filter: CSPRNG_ENABLED
    extra_configs:
      - CONFIG_JWT_SIGN_RSA_LEGACY=y
  libraries.encoding.jwt.rsa.psa:
    extra_configs:
      - CONFIG_JWT_SIGN_RSA_PSA=y
      # Explicitly select CONFIG_MBEDTLS_PSA_CRYPTO_EXTERNAL_RNG because this
      # is not automatically selected on platforms that do not have a CSPRNG
      # source.
      - CONFIG_MBEDTLS_PSA_CRYPTO_EXTERNAL_RNG=y
      - CONFIG_MBEDTLS_PSA_CRYPTO_EXTERNAL_RNG_ALLOW_NON_CSPRNG=y
      - CONFIG_PSA_WANT_RSA_KEY_SIZE_2048=y
      - CONFIG_MBEDTLS_ENABLE_HEAP=y
      - CONFIG_MBEDTLS_HEAP_SIZE=8192
```

## tests/subsys/stm_nrfutil/sample.yaml
```yaml
tests:
  tests.subsys.stm_nrfutil:
    tags: stm
    harness: pytest
    harness_config:
      pytest_dut_scope: session
      fixture: nrfutil_trace
```
