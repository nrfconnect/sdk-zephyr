## CMakeLists.txt
```
# SPDX-License-Identifier: Apache-2.0

cmake_minimum_required(VERSION 3.20.0)

find_package(Zephyr REQUIRED HINTS $ENV{ZEPHYR_BASE})
project(bsim_test_multi_id_bond_keep)

add_subdirectory(${ZEPHYR_BASE}/tests/bsim/babblekit babblekit)
target_link_libraries(app PRIVATE babblekit)

target_sources(app PRIVATE
	src/bs_bt_utils.c
	src/central.c
	src/main.c
	src/peripheral.c
)

zephyr_include_directories(
  ${BSIM_COMPONENTS_PATH}/libUtilv1/src/
  ${BSIM_COMPONENTS_PATH}/libPhyComv1/src/
  )
```

## prj.conf
```kconfig
CONFIG_BT=y

CONFIG_BT_SMP=y

CONFIG_ASSERT=y
CONFIG_BT_TESTING=y
CONFIG_LOG=y

CONFIG_BT_ID_MAX=4
CONFIG_BT_MAX_PAIRED=3
CONFIG_BT_MAX_CONN=1

CONFIG_BT_PRIVACY=y
CONFIG_BT_ID_AUTO_SWAP_MATCHING_BONDS=y

CONFIG_BT_FILTER_ACCEPT_LIST=y
```

## src/main.c
```c
/*
 * Copyright (c) 2025 Nordic Semiconductor ASA
 *
 * SPDX-License-Identifier: Apache-2.0
 */

#include "bs_bt_utils.h"
#include "bstests.h"

#if defined(CONFIG_BT_CENTRAL)
void central_basic(void);
void central_fal(void);
void central_dir(void);
void central_unpair(void);
#if defined(CONFIG_BT_SETTINGS)
void central_persist_bond(void);
void central_persist_reconnect(void);
#endif /* CONFIG_BT_SETTINGS */
#endif /* CONFIG_BT_CENTRAL */

#if defined(CONFIG_BT_PERIPHERAL)
void peripheral_basic(void);
void peripheral_fal(void);
void peripheral_dir(void);
void peripheral_unpair(void);
#if defined(CONFIG_BT_SETTINGS)
void peripheral_persist_bond(void);
void peripheral_persist_reconnect(void);
#endif /* CONFIG_BT_SETTINGS */
#endif /* CONFIG_BT_PERIPHERAL */

#if !defined(CONFIG_BT_CENTRAL) && !defined(CONFIG_BT_PERIPHERAL)
#error "At least one of CONFIG_BT_CENTRAL or CONFIG_BT_PERIPHERAL must be enabled"
#endif /* !CONFIG_BT_CENTRAL && !CONFIG_BT_PERIPHERAL */

static const struct bst_test_instance test_to_add[] = {
#if defined(CONFIG_BT_CENTRAL)
	{
		.test_id = "central_basic",
		.test_main_f = central_basic,
	},
	{
		.test_id = "central_fal",
		.test_main_f = central_fal,
	},
	{
		.test_id = "central_dir",
		.test_main_f = central_dir,
	},
	{
		.test_id = "central_unpair",
		.test_main_f = central_unpair,
	},
#if defined(CONFIG_BT_SETTINGS)
	{
		.test_id = "central_persist_bond",
		.test_main_f = central_persist_bond,
	},
	{
		.test_id = "central_persist_reconnect",
		.test_main_f = central_persist_reconnect,
	},
#endif /* CONFIG_BT_SETTINGS */
#endif /* CONFIG_BT_CENTRAL */
#if defined(CONFIG_BT_PERIPHERAL)
	{
		.test_id = "peripheral_basic",
		.test_main_f = peripheral_basic,
	},
	{
		.test_id = "peripheral_fal",
		.test_main_f = peripheral_fal,
	},
	{
		.test_id = "peripheral_dir",
		.test_main_f = peripheral_dir,
	},
	{
		.test_id = "peripheral_unpair",
		.test_main_f = peripheral_unpair,
	},
#if defined(CONFIG_BT_SETTINGS)
	{
		.test_id = "peripheral_persist_bond",
		.test_main_f = peripheral_persist_bond,
	},
	{
		.test_id = "peripheral_persist_reconnect",
		.test_main_f = peripheral_persist_reconnect,
	},
#endif /* CONFIG_BT_SETTINGS */
#endif /* CONFIG_BT_PERIPHERAL */
	BSTEST_END_MARKER,
};

static struct bst_test_list *install(struct bst_test_list *tests)
{
	return bst_add_tests(tests, test_to_add);
};

bst_test_install_t test_installers[] = {install, NULL};

int main(void)
{
	bst_main();
	return 0;
}
```

## src/bs_bt_utils.c
```c
/*
 * Copyright (c) 2025 Nordic Semiconductor ASA
 *
 * SPDX-License-Identifier: Apache-2.0
 */

#include "host/hci_core.h"

#include "bs_bt_utils.h"

BUILD_ASSERT(CONFIG_BT_MAX_PAIRED >= 3, "Test needs to pair with 3 devices.");
BUILD_ASSERT(CONFIG_BT_ID_MAX >= 4, "Need 4 IDs: 1 default + 3 for the test.");

DEFINE_FLAG(flag_is_connected);

struct bt_conn *g_conn;

const char *addr_to_str(const bt_addr_le_t *addr)
{
	static char str[BT_ADDR_LE_STR_LEN];

	bt_addr_le_to_str(addr, str, sizeof(str));

	return str;
}

static void disconnected(struct bt_conn *conn, uint8_t reason)
{
	const bt_addr_le_t *dst;
	char addr_str[BT_ADDR_LE_STR_LEN];

	dst = bt_conn_get_dst(conn);
	bt_addr_le_to_str(dst, addr_str, sizeof(addr_str));
	printk("Disconnected from %p (addr %s) (reason %d)\n", conn, addr_str, reason);

	UNSET_FLAG(flag_is_connected);
}

BUILD_ASSERT(CONFIG_BT_MAX_CONN == 1, "This test assumes a single link.");
static void connected(struct bt_conn *conn, uint8_t err)
{
	const bt_addr_le_t *dst;
	char addr_str[BT_ADDR_LE_STR_LEN];

	TEST_ASSERT((!g_conn || (conn == g_conn)), "Unexpected new connection.");

	UNSET_FLAG(security_changed_flag);

	dst = bt_conn_get_dst(conn);
	bt_addr_le_to_str(dst, addr_str, sizeof(addr_str));
	printk("Connected to %p, err %d dst %s\n", conn, err, addr_str);

	if (!g_conn) {
		g_conn = bt_conn_ref(conn);
	}

	if (err != 0) {
		clear_g_conn();
		return;
	}

	printk("Set flag_is_connected\n");
	SET_FLAG(flag_is_connected);
}

DEFINE_FLAG(security_changed_flag);

static void security_changed(struct bt_conn *conn, bt_security_t level,
			     enum bt_security_err err)
{
	const bt_addr_le_t *dst;
	char addr_str[BT_ADDR_LE_STR_LEN];

	dst = bt_conn_get_dst(conn);
	bt_addr_le_to_str(dst, addr_str, sizeof(addr_str));
	printk("Security changed for %p (addr %s), level %d, err %d\n", conn, addr_str, level, err);

	if (!err && level == BT_SECURITY_L2) {
		SET_FLAG(security_changed_flag);
	}
}

BT_CONN_CB_DEFINE(conn_callbacks) = {
	.connected = connected,
	.disconnected = disconnected,
	.security_changed = security_changed,
};

void clear_g_conn(void)
{
	struct bt_conn *conn;

	conn = g_conn;
	g_conn = NULL;
	TEST_ASSERT(conn, "Test error: No g_conn!");
	bt_conn_unref(conn);
}

/* The pairing complete flags is raised by events and lowered by test code. */
DEFINE_FLAG(flag_pairing_complete);

static void pairing_failed(struct bt_conn *conn, enum bt_security_err reason)
{
	printk("Pairing failed with %p (reason %d)\n", conn, reason);

	/* Pairing should never fail in this test. */
	TEST_ASSERT(false, "Pairing failed with %p (reason %d)", conn, reason);
}

static void pairing_complete(struct bt_conn *conn, bool bonded)
{
	const bt_addr_le_t *dst;
	char addr_str[BT_ADDR_LE_STR_LEN];

	dst = bt_conn_get_dst(conn);
	bt_addr_le_to_str(dst, addr_str, sizeof(addr_str));
	printk("Pairing complete with %p (bonded %d) dst %s\n", conn, bonded, addr_str);

	SET_FLAG(flag_pairing_complete);
}

static struct bt_conn_auth_info_cb bt_conn_auth_info_cb = {
	.pairing_failed = pairing_failed,
	.pairing_complete = pairing_complete,
};

void bs_bt_utils_setup(void)
{
	int err;

	err = bt_enable(NULL);
	TEST_ASSERT(!err, "bt_enable failed.");
	err = bt_conn_auth_info_cb_register(&bt_conn_auth_info_cb);
	TEST_ASSERT(!err, "bt_conn_auth_info_cb_register failed.");
}

#if defined(CONFIG_BT_CENTRAL)
static enum bt_gap_adv_type scan_adv_type;

static void scan_connect_to_first_result__device_found(const bt_addr_le_t *addr, int8_t rssi,
						       uint8_t type, struct net_buf_simple *ad)
{
	char addr_str[BT_ADDR_LE_STR_LEN];
	int err;

	if (g_conn != NULL) {
		printk("Already connected, ignoring advertisement.");
		return;
	}

	/* We're only interested in connectable events */
	if (type != scan_adv_type) {
		TEST_FAIL("Unexpected advertisement type %d, expected %d", type, scan_adv_type);
	}

	bt_addr_le_to_str(addr, addr_str, sizeof(addr_str));
	printk("Got scan result, connecting.. dst %s, RSSI %d\n", addr_str, rssi);

	err = bt_le_scan_stop();
	TEST_ASSERT(!err, "Err bt_le_scan_stop %d", err);

	err = bt_conn_le_create(addr, BT_CONN_LE_CREATE_CONN, BT_LE_CONN_PARAM_DEFAULT, &g_conn);
	TEST_ASSERT(!err, "Err bt_conn_le_create %d", err);
}

int scan_connect_to_first_result(bool directed, bool filter)
{
	struct bt_le_scan_param param = BT_LE_SCAN_PARAM_INIT(BT_LE_SCAN_TYPE_PASSIVE,
							      BT_LE_SCAN_OPT_FILTER_DUPLICATE,
							      BT_GAP_SCAN_FAST_INTERVAL,
							      BT_GAP_SCAN_FAST_WINDOW);

	if (filter) {
		param.options = BT_LE_SCAN_OPT_FILTER_ACCEPT_LIST;
	}

	if (directed) {
		scan_adv_type = BT_GAP_ADV_TYPE_ADV_DIRECT_IND;
	} else {
		scan_adv_type = BT_GAP_ADV_TYPE_ADV_IND;
	}

	return bt_le_scan_start(&param, scan_connect_to_first_result__device_found);
}
#endif /* CONFIG_BT_CENTRAL */

#if defined(CONFIG_BT_PERIPHERAL)
int advertise_connectable(int id, bt_addr_le_t *directed_dst, bool filter)
{
	struct bt_le_adv_param param = {};

	param.id = id;
	param.interval_min = 0x0020;
	param.interval_max = 0x4000;
	param.options |= BT_LE_ADV_OPT_CONN;

	if (filter) {
		param.options |= BT_LE_ADV_OPT_FILTER_CONN;
	}

	if (directed_dst) {
		param.options |= BT_LE_ADV_OPT_DIR_ADDR_RPA;
		param.peer = directed_dst;
	}

	return bt_le_adv_start(&param, NULL, 0, NULL, 0);
}
#endif /* CONFIG_BT_PERIPHERAL */
```

## src/bs_bt_utils.h
```c
/**
 * Copyright (c) 2025 Nordic Semiconductor ASA
 *
 * SPDX-License-Identifier: Apache-2.0
 */

#include "bs_tracing.h"
#include "bs_types.h"
#include "bstests.h"
#include "time_machine.h"
#include <zephyr/sys/__assert.h>

#include <errno.h>
#include <stddef.h>
#include <stdint.h>

#include <zephyr/bluetooth/bluetooth.h>
#include <zephyr/bluetooth/conn.h>
#include <zephyr/bluetooth/gatt.h>
#include <zephyr/bluetooth/hci.h>
#include <zephyr/kernel.h>
#include <zephyr/types.h>

#include "babblekit/testcase.h"
#include "babblekit/flags.h"

DECLARE_FLAG(flag_pairing_complete);
DECLARE_FLAG(flag_is_connected);
DECLARE_FLAG(security_changed_flag);

#define WAIT_FOR_CONNECTED() WAIT_FOR_FLAG(flag_is_connected)
#define WAIT_FOR_DISCONNECTED() WAIT_FOR_FLAG_UNSET(flag_is_connected)
#define WAIT_FOR_ENCRYPTED_CONNECTION() \
	do { \
		WAIT_FOR_FLAG(security_changed_flag); \
		bool pairing_not_triggered; \
		pairing_not_triggered = !IS_FLAG_SET(flag_pairing_complete); \
		TEST_ASSERT(pairing_not_triggered, "Pairing triggered during encryption"); \
	} while (0)

#define FAL_ADD(addr) \
	do { \
		int err; \
		err = bt_le_filter_accept_list_add(addr); \
		TEST_ASSERT(!err, "Err bt_le_filter_accept_list_add %d", err); \
	} while (0)

#define FAL_CLEAR() \
	do { \
		int err; \
		err = bt_le_filter_accept_list_clear(); \
		TEST_ASSERT(!err, "Err bt_le_filter_accept_list_clear %d", err); \
	} while (0)

extern struct bt_conn *g_conn;

const char *addr_to_str(const bt_addr_le_t *addr);
void clear_g_conn(void);
void bs_bt_utils_setup(void);
int scan_connect_to_first_result(bool directed, bool filter);
int advertise_connectable(int id, bt_addr_le_t *directed_dst, bool filter);
```

## src/central.c
```c
/*
 * Copyright (c) 2025 Nordic Semiconductor ASA
 *
 * SPDX-License-Identifier: Apache-2.0
 */

#include "bs_bt_utils.h"
#include <zephyr/bluetooth/addr.h>
#include <zephyr/bluetooth/conn.h>
#include <zephyr/settings/settings.h>

#include <stdint.h>

#include <zephyr/bluetooth/bluetooth.h>

#include "babblekit/testcase.h"
#include "babblekit/flags.h"

#if defined(CONFIG_BT_CENTRAL)

#define SCAN_CONNECT_TO_FIRST_RESULT(directed, fal) \
	do { \
		int err; \
		err = scan_connect_to_first_result(directed, fal); \
		TEST_ASSERT(err == 0, "Failed to start scanning (err %d)", err); \
	} while (0)

#define CONNECTION_ENCRYPT() \
	do { \
		int err; \
		err = bt_conn_set_security(g_conn, BT_SECURITY_L2); \
		TEST_ASSERT(err == 0, "Failed to set security (err %d)", err); \
	} while (0)

#define DISCONNECT() \
	do { \
		int err; \
		err = bt_conn_disconnect(g_conn, BT_HCI_ERR_REMOTE_USER_TERM_CONN); \
		TEST_ASSERT(err == 0, "Failed to disconnect (err %d)", err); \
	} while (0)

void central_basic(void)
{
	bs_bt_utils_setup();

	printk("== Bonding id a ==\n");
	SCAN_CONNECT_TO_FIRST_RESULT(false, false);
	WAIT_FOR_CONNECTED();
	CONNECTION_ENCRYPT();
	TAKE_FLAG(flag_pairing_complete);
	DISCONNECT();
	WAIT_FOR_DISCONNECTED();
	clear_g_conn();

	printk("== Bonding id b ==\n");
	SCAN_CONNECT_TO_FIRST_RESULT(false, false);
	WAIT_FOR_CONNECTED();
	CONNECTION_ENCRYPT();
	TAKE_FLAG(flag_pairing_complete);
	DISCONNECT();
	WAIT_FOR_DISCONNECTED();
	clear_g_conn();

	printk("== Connect to id a again ==\n");
	SCAN_CONNECT_TO_FIRST_RESULT(false, false);
	WAIT_FOR_CONNECTED();
	CONNECTION_ENCRYPT();
	WAIT_FOR_ENCRYPTED_CONNECTION();
	DISCONNECT();
	WAIT_FOR_DISCONNECTED();
	clear_g_conn();

	printk("== Connect to id b again ==\n");
	SCAN_CONNECT_TO_FIRST_RESULT(false, false);
	WAIT_FOR_CONNECTED();
	CONNECTION_ENCRYPT();
	WAIT_FOR_ENCRYPTED_CONNECTION();
	DISCONNECT();
	WAIT_FOR_DISCONNECTED();
	clear_g_conn();

	printk("== Connect to id a again ==\n");
	SCAN_CONNECT_TO_FIRST_RESULT(false, false);
	WAIT_FOR_CONNECTED();
	CONNECTION_ENCRYPT();
	WAIT_FOR_ENCRYPTED_CONNECTION();
	DISCONNECT();
	WAIT_FOR_DISCONNECTED();
	clear_g_conn();

	printk("== Connect to id b again ==\n");
	SCAN_CONNECT_TO_FIRST_RESULT(false, false);
	WAIT_FOR_CONNECTED();
	CONNECTION_ENCRYPT();
	WAIT_FOR_ENCRYPTED_CONNECTION();
	DISCONNECT();
	WAIT_FOR_DISCONNECTED();
	clear_g_conn();

	TEST_PASS("PASS");
}

void central_fal(void)
{
	bt_addr_le_t peripheral_a;
	bt_addr_le_t peripheral_b;

	bs_bt_utils_setup();

	printk("== Bonding id a ==\n");
	SCAN_CONNECT_TO_FIRST_RESULT(false, false);
	WAIT_FOR_CONNECTED();
	CONNECTION_ENCRYPT();
	TAKE_FLAG(flag_pairing_complete);
	DISCONNECT();
	WAIT_FOR_DISCONNECTED();
	peripheral_a = *bt_conn_get_dst(g_conn);
	clear_g_conn();

	printk("== Bonding id b ==\n");
	SCAN_CONNECT_TO_FIRST_RESULT(false, false);
	WAIT_FOR_CONNECTED();
	CONNECTION_ENCRYPT();
	TAKE_FLAG(flag_pairing_complete);
	DISCONNECT();
	WAIT_FOR_DISCONNECTED();
	peripheral_b = *bt_conn_get_dst(g_conn);
	clear_g_conn();

	printk("== Connect to id a again ==\n");
	FAL_ADD(&peripheral_a);
	SCAN_CONNECT_TO_FIRST_RESULT(false, true);
	WAIT_FOR_CONNECTED();
	CONNECTION_ENCRYPT();
	WAIT_FOR_ENCRYPTED_CONNECTION();
	DISCONNECT();
	WAIT_FOR_DISCONNECTED();
	clear_g_conn();
	FAL_CLEAR();

	printk("== Connect to id b again ==\n");
	FAL_ADD(&peripheral_b);
	SCAN_CONNECT_TO_FIRST_RESULT(false, true);
	WAIT_FOR_CONNECTED();
	CONNECTION_ENCRYPT();
	WAIT_FOR_ENCRYPTED_CONNECTION();
	DISCONNECT();
	WAIT_FOR_DISCONNECTED();
	clear_g_conn();
	FAL_CLEAR();

	printk("== Connect to id a again ==\n");
	FAL_ADD(&peripheral_a);
	SCAN_CONNECT_TO_FIRST_RESULT(false, true);
	WAIT_FOR_CONNECTED();
	CONNECTION_ENCRYPT();
	WAIT_FOR_ENCRYPTED_CONNECTION();
	DISCONNECT();
	WAIT_FOR_DISCONNECTED();
	clear_g_conn();
	FAL_CLEAR();

	printk("== Connect to id b again ==\n");
	FAL_ADD(&peripheral_b);
	SCAN_CONNECT_TO_FIRST_RESULT(false, true);
	WAIT_FOR_CONNECTED();
	CONNECTION_ENCRYPT();
	WAIT_FOR_ENCRYPTED_CONNECTION();
	DISCONNECT();
	WAIT_FOR_DISCONNECTED();
	clear_g_conn();
	FAL_CLEAR();

	TEST_PASS("PASS");
}

void central_dir(void)
{
	bs_bt_utils_setup();

	printk("== Bonding id a ==\n");
	SCAN_CONNECT_TO_FIRST_RESULT(false, false);
	WAIT_FOR_CONNECTED();
	CONNECTION_ENCRYPT();
	TAKE_FLAG(flag_pairing_complete);
	DISCONNECT();
	WAIT_FOR_DISCONNECTED();
	clear_g_conn();

	printk("== Bonding id b ==\n");
	SCAN_CONNECT_TO_FIRST_RESULT(false, false);
	WAIT_FOR_CONNECTED();
	CONNECTION_ENCRYPT();
	TAKE_FLAG(flag_pairing_complete);
	DISCONNECT();
	WAIT_FOR_DISCONNECTED();
	clear_g_conn();

	printk("== Connect to id a again ==\n");
	SCAN_CONNECT_TO_FIRST_RESULT(true, false);
	WAIT_FOR_CONNECTED();
	CONNECTION_ENCRYPT();
	WAIT_FOR_ENCRYPTED_CONNECTION();
	DISCONNECT();
	WAIT_FOR_DISCONNECTED();
	clear_g_conn();

	printk("== Connect to id b again ==\n");
	SCAN_CONNECT_TO_FIRST_RESULT(true, false);
	WAIT_FOR_CONNECTED();
	CONNECTION_ENCRYPT();
	WAIT_FOR_ENCRYPTED_CONNECTION();
	DISCONNECT();
	WAIT_FOR_DISCONNECTED();
	clear_g_conn();

	printk("== Connect to id a again ==\n");
	SCAN_CONNECT_TO_FIRST_RESULT(true, false);
	WAIT_FOR_CONNECTED();
	CONNECTION_ENCRYPT();
	WAIT_FOR_ENCRYPTED_CONNECTION();
	DISCONNECT();
	WAIT_FOR_DISCONNECTED();
	clear_g_conn();

	printk("== Connect to id b again ==\n");
	SCAN_CONNECT_TO_FIRST_RESULT(true, false);
	WAIT_FOR_CONNECTED();
	CONNECTION_ENCRYPT();
	WAIT_FOR_ENCRYPTED_CONNECTION();
	DISCONNECT();
	WAIT_FOR_DISCONNECTED();
	clear_g_conn();

	TEST_PASS("PASS");
}

void central_unpair(void)
{
	bs_bt_utils_setup();

	printk("== Bonding id a ==\n");
	SCAN_CONNECT_TO_FIRST_RESULT(false, false);
	WAIT_FOR_CONNECTED();
	CONNECTION_ENCRYPT();
	TAKE_FLAG(flag_pairing_complete);
	DISCONNECT();
	WAIT_FOR_DISCONNECTED();
	clear_g_conn();

	printk("== Bonding id b ==\n");
	SCAN_CONNECT_TO_FIRST_RESULT(false, false);
	WAIT_FOR_CONNECTED();
	CONNECTION_ENCRYPT();
	TAKE_FLAG(flag_pairing_complete);
	DISCONNECT();
	WAIT_FOR_DISCONNECTED();
	clear_g_conn();

	printk("== Bonding id c ==\n");
	SCAN_CONNECT_TO_FIRST_RESULT(false, false);
	WAIT_FOR_CONNECTED();
	CONNECTION_ENCRYPT();
	TAKE_FLAG(flag_pairing_complete);
	DISCONNECT();
	WAIT_FOR_DISCONNECTED();
	clear_g_conn();

	printk("== Connect to id a again ==\n");
	SCAN_CONNECT_TO_FIRST_RESULT(false, false);
	WAIT_FOR_CONNECTED();
	CONNECTION_ENCRYPT();
	WAIT_FOR_ENCRYPTED_CONNECTION();
	/* Peripheral should unpair and thus disconnect. */
	WAIT_FOR_DISCONNECTED();
	clear_g_conn();

	printk("== Connect to id b again ==\n");
	SCAN_CONNECT_TO_FIRST_RESULT(false, false);
	WAIT_FOR_CONNECTED();
	CONNECTION_ENCRYPT();
	WAIT_FOR_ENCRYPTED_CONNECTION();
	/* Peripheral should unpair and thus disconnect. */
	WAIT_FOR_DISCONNECTED();
	clear_g_conn();

	printk("== Connect to id c again ==\n");
	SCAN_CONNECT_TO_FIRST_RESULT(false, false);
	WAIT_FOR_CONNECTED();
	CONNECTION_ENCRYPT();
	WAIT_FOR_ENCRYPTED_CONNECTION();
	/* Peripheral should unpair and thus disconnect. */
	WAIT_FOR_DISCONNECTED();
	clear_g_conn();

	TEST_PASS("PASS");
}

#if defined(CONFIG_BT_SETTINGS)
void central_persist_bond(void)
{
	int err;

	bs_bt_utils_setup();

	err = settings_load();
	TEST_ASSERT(!err, "Failed to load settings (err %d)", err);

	printk("== Bonding id a ==\n");
	SCAN_CONNECT_TO_FIRST_RESULT(false, false);
	WAIT_FOR_CONNECTED();
	CONNECTION_ENCRYPT();
	TAKE_FLAG(flag_pairing_complete);
	DISCONNECT();
	WAIT_FOR_DISCONNECTED();
	clear_g_conn();

	printk("== Bonding id b ==\n");
	SCAN_CONNECT_TO_FIRST_RESULT(false, false);
	WAIT_FOR_CONNECTED();
	CONNECTION_ENCRYPT();
	TAKE_FLAG(flag_pairing_complete);
	DISCONNECT();
	WAIT_FOR_DISCONNECTED();
	clear_g_conn();

	TEST_PASS("PASS");
}

void central_persist_reconnect(void)
{
	int err;

	bs_bt_utils_setup();

	err = settings_load();
	TEST_ASSERT(!err, "Failed to load settings (err %d)", err);

	printk("== Connect to id a again ==\n");
	SCAN_CONNECT_TO_FIRST_RESULT(true, false);
	WAIT_FOR_CONNECTED();
	CONNECTION_ENCRYPT();
	WAIT_FOR_ENCRYPTED_CONNECTION();
	DISCONNECT();
	WAIT_FOR_DISCONNECTED();
	clear_g_conn();

	printk("== Connect to id b again ==\n");
	SCAN_CONNECT_TO_FIRST_RESULT(true, false);
	WAIT_FOR_CONNECTED();
	CONNECTION_ENCRYPT();
	WAIT_FOR_ENCRYPTED_CONNECTION();
	DISCONNECT();
	WAIT_FOR_DISCONNECTED();
	clear_g_conn();

	printk("== Connect to id a again ==\n");
	SCAN_CONNECT_TO_FIRST_RESULT(true, false);
	WAIT_FOR_CONNECTED();
	CONNECTION_ENCRYPT();
	WAIT_FOR_ENCRYPTED_CONNECTION();
	DISCONNECT();
	WAIT_FOR_DISCONNECTED();
	clear_g_conn();

	printk("== Connect to id b again ==\n");
	SCAN_CONNECT_TO_FIRST_RESULT(true, false);
	WAIT_FOR_CONNECTED();
	CONNECTION_ENCRYPT();
	WAIT_FOR_ENCRYPTED_CONNECTION();
	DISCONNECT();
	WAIT_FOR_DISCONNECTED();
	clear_g_conn();

	TEST_PASS("PASS");
}
#endif /* CONFIG_BT_SETTINGS */

#endif /* CONFIG_BT_CENTRAL */
```

## src/peripheral.c
```c
/*
 * Copyright (c) 2025: Nordic Semiconductor ASA
 *
 * SPDX-License-Identifier: Apache-2.0
 */

#include "bs_bt_utils.h"
#include <zephyr/bluetooth/addr.h>
#include <zephyr/bluetooth/bluetooth.h>
#include <zephyr/bluetooth/conn.h>
#include <zephyr/toolchain.h>
#include <zephyr/settings/settings.h>

#include "host/keys.h"

#include <stdint.h>
#include <string.h>

#include "babblekit/testcase.h"
#include "babblekit/flags.h"

#if defined(CONFIG_BT_PERIPHERAL)

BUILD_ASSERT(IS_ENABLED(CONFIG_BT_ID_AUTO_SWAP_MATCHING_BONDS), "");

#define ADVERTISE_CONNECTABLE(id, central, fal) \
	do { \
		int err; \
		err = advertise_connectable(id, central, fal); \
		TEST_ASSERT(err == 0, "Advertising failed to start (err %d)", err); \
	} while (0)

#define UNPAIR(id, addr) \
	do { \
		int err; \
		err = bt_unpair(id, addr); \
		TEST_ASSERT(err == 0, "Unpairing failed (err %d)", err); \
	} while (0)

#define ID_CONFLICT_FLAG_CHECK(id, addr, set) \
	do { \
		struct bt_keys *keys; \
		keys = bt_keys_find_addr(id, addr); \
		TEST_ASSERT(keys != NULL, "No keys found for id %d addr %s", id,\
			    addr_to_str(addr)); \
		if (set) { \
			TEST_ASSERT(keys->flags & BT_KEYS_ID_CONFLICT, \
				    "ID conflict flag not set for id %d addr %s", id, \
				    addr_to_str(addr)); \
		} else { \
			TEST_ASSERT(!(keys->flags & BT_KEYS_ID_CONFLICT), \
				    "ID conflict flag set for id %d addr %s", id, \
				    addr_to_str(addr));\
		} \
	} while (0)

void peripheral_basic(void)
{
	int id_a;
	int id_b;
	bt_addr_le_t central;

	bs_bt_utils_setup();

	id_a = bt_id_create(NULL, NULL);
	TEST_ASSERT(id_a >= 0, "bt_id_create id_a failed (err %d)", id_a);

	id_b = bt_id_create(NULL, NULL);
	TEST_ASSERT(id_b >= 0, "bt_id_create id_b failed (err %d)", id_b);

	printk("== Bonding id a ==\n");
	ADVERTISE_CONNECTABLE(id_a, NULL, false);
	WAIT_FOR_CONNECTED();
	/* Central should bond here, and trigger a disconnect. */
	TAKE_FLAG(flag_pairing_complete);
	WAIT_FOR_ENCRYPTED_CONNECTION();
	WAIT_FOR_DISCONNECTED();
	central = *bt_conn_get_dst(g_conn);
	clear_g_conn();

	printk("== Bonding id b ==\n");
	ADVERTISE_CONNECTABLE(id_b, NULL, false);
	WAIT_FOR_CONNECTED();
	/* Central should bond here, and trigger a disconnect. */
	TAKE_FLAG(flag_pairing_complete);
	WAIT_FOR_ENCRYPTED_CONNECTION();
	WAIT_FOR_DISCONNECTED();
	clear_g_conn();

	printk("== Advertising id a again ==\n");
	ADVERTISE_CONNECTABLE(id_a, NULL, false);
	WAIT_FOR_CONNECTED();
	/* Central should encrypt connection here and trigger disconnect. */
	WAIT_FOR_ENCRYPTED_CONNECTION();
	WAIT_FOR_DISCONNECTED();
	clear_g_conn();

	printk("== Advertising id b again ==\n");
	ADVERTISE_CONNECTABLE(id_b, NULL, false);
	WAIT_FOR_CONNECTED();
	/* Central should encrypt connection here and trigger disconnect. */
	WAIT_FOR_ENCRYPTED_CONNECTION();
	WAIT_FOR_DISCONNECTED();
	clear_g_conn();

	printk("== Advertising id a again ==\n");
	ADVERTISE_CONNECTABLE(id_a, NULL, false);
	WAIT_FOR_CONNECTED();
	/* Central should encrypt connection here and trigger disconnect. */
	WAIT_FOR_ENCRYPTED_CONNECTION();
	WAIT_FOR_DISCONNECTED();
	clear_g_conn();

	printk("== Advertising id b again ==\n");
	ADVERTISE_CONNECTABLE(id_b, NULL, false);
	WAIT_FOR_CONNECTED();
	/* Central should encrypt connection here and trigger disconnect. */
	WAIT_FOR_ENCRYPTED_CONNECTION();
	WAIT_FOR_DISCONNECTED();
	clear_g_conn();

	TEST_PASS("PASS");
}

void peripheral_fal(void)
{
	int id_a;
	int id_b;
	bt_addr_le_t central;

	bs_bt_utils_setup();

	id_a = bt_id_create(NULL, NULL);
	TEST_ASSERT(id_a >= 0, "bt_id_create id_a failed (err %d)", id_a);

	id_b = bt_id_create(NULL, NULL);
	TEST_ASSERT(id_b >= 0, "bt_id_create id_b failed (err %d)", id_b);

	printk("== Bonding id a ==\n");
	ADVERTISE_CONNECTABLE(id_a, NULL, false);
	WAIT_FOR_CONNECTED();
	/* Central should bond here, and trigger a disconnect. */
	TAKE_FLAG(flag_pairing_complete);
	WAIT_FOR_ENCRYPTED_CONNECTION();
	WAIT_FOR_DISCONNECTED();
	central = *bt_conn_get_dst(g_conn);
	clear_g_conn();

	printk("== Bonding id b ==\n");
	ADVERTISE_CONNECTABLE(id_b, NULL, false);
	WAIT_FOR_CONNECTED();
	TAKE_FLAG(flag_pairing_complete);
	/* Central should bond here, and trigger a disconnect. */
	WAIT_FOR_ENCRYPTED_CONNECTION();
	WAIT_FOR_DISCONNECTED();
	clear_g_conn();

	printk("== Advertising id a again ==\n");
	FAL_ADD(&central);
	ADVERTISE_CONNECTABLE(id_a, NULL, true);
	WAIT_FOR_CONNECTED();
	/* Central should encrypt connection here and trigger disconnect. */
	WAIT_FOR_ENCRYPTED_CONNECTION();
	WAIT_FOR_DISCONNECTED();
	clear_g_conn();
	FAL_CLEAR();

	printk("== Advertising id b again ==\n");
	FAL_ADD(&central);
	ADVERTISE_CONNECTABLE(id_b, NULL, true);
	WAIT_FOR_CONNECTED();
	/* Central should encrypt connection here and trigger disconnect. */
	WAIT_FOR_ENCRYPTED_CONNECTION();
	WAIT_FOR_DISCONNECTED();
	clear_g_conn();
	FAL_CLEAR();

	printk("== Advertising id a again ==\n");
	FAL_ADD(&central);
	ADVERTISE_CONNECTABLE(id_a, NULL, true);
	WAIT_FOR_CONNECTED();
	/* Central should encrypt connection here and trigger disconnect. */
	WAIT_FOR_ENCRYPTED_CONNECTION();
	WAIT_FOR_DISCONNECTED();
	clear_g_conn();
	FAL_CLEAR();

	printk("== Advertising id b again ==\n");
	FAL_ADD(&central);
	ADVERTISE_CONNECTABLE(id_b, NULL, true);
	WAIT_FOR_CONNECTED();
	/* Central should encrypt connection here and trigger disconnect. */
	WAIT_FOR_ENCRYPTED_CONNECTION();
	WAIT_FOR_DISCONNECTED();
	clear_g_conn();
	FAL_CLEAR();

	TEST_PASS("PASS");
}

void peripheral_dir(void)
{
	int id_a;
	int id_b;
	bt_addr_le_t central;

	bs_bt_utils_setup();

	id_a = bt_id_create(NULL, NULL);
	TEST_ASSERT(id_a >= 0, "bt_id_create id_a failed (err %d)", id_a);

	id_b = bt_id_create(NULL, NULL);
	TEST_ASSERT(id_b >= 0, "bt_id_create id_b failed (err %d)", id_b);

	printk("== Bonding id a ==\n");
	ADVERTISE_CONNECTABLE(id_a, NULL, false);
	WAIT_FOR_CONNECTED();
	/* Central should bond here, and trigger a disconnect. */
	TAKE_FLAG(flag_pairing_complete);
	WAIT_FOR_ENCRYPTED_CONNECTION();
	WAIT_FOR_DISCONNECTED();
	central = *bt_conn_get_dst(g_conn);
	clear_g_conn();

	printk("== Bonding id b ==\n");
	ADVERTISE_CONNECTABLE(id_b, NULL, false);
	WAIT_FOR_CONNECTED();
	/* Central should bond here, and trigger a disconnect. */
	TAKE_FLAG(flag_pairing_complete);
	WAIT_FOR_ENCRYPTED_CONNECTION();
	WAIT_FOR_DISCONNECTED();
	clear_g_conn();

	printk("== Advertising id a again ==\n");
	ADVERTISE_CONNECTABLE(id_a, &central, false);
	WAIT_FOR_CONNECTED();
	/* Central should encrypt connection here and trigger disconnect. */
	WAIT_FOR_ENCRYPTED_CONNECTION();
	WAIT_FOR_DISCONNECTED();
	clear_g_conn();
	FAL_CLEAR();

	printk("== Advertising id b again ==\n");
	FAL_ADD(&central);
	ADVERTISE_CONNECTABLE(id_b, &central, false);
	WAIT_FOR_CONNECTED();
	/* Central should encrypt connection here and trigger disconnect. */
	WAIT_FOR_ENCRYPTED_CONNECTION();
	WAIT_FOR_DISCONNECTED();
	clear_g_conn();
	FAL_CLEAR();

	printk("== Advertising id a again ==\n");
	ADVERTISE_CONNECTABLE(id_a, &central, false);
	WAIT_FOR_CONNECTED();
	/* Central should encrypt connection here and trigger disconnect. */
	WAIT_FOR_ENCRYPTED_CONNECTION();
	WAIT_FOR_DISCONNECTED();
	clear_g_conn();
	FAL_CLEAR();

	printk("== Advertising id b again ==\n");
	FAL_ADD(&central);
	ADVERTISE_CONNECTABLE(id_b, &central, false);
	WAIT_FOR_CONNECTED();
	/* Central should encrypt connection here and trigger disconnect. */
	WAIT_FOR_ENCRYPTED_CONNECTION();
	WAIT_FOR_DISCONNECTED();
	clear_g_conn();
	FAL_CLEAR();

	TEST_PASS("PASS");
}

void peripheral_unpair(void)
{
	int id_a;
	int id_b;
	int id_c;
	bt_addr_le_t central;

	bs_bt_utils_setup();

	id_a = bt_id_create(NULL, NULL);
	TEST_ASSERT(id_a >= 0, "bt_id_create id_a failed (err %d)", id_a);

	id_b = bt_id_create(NULL, NULL);
	TEST_ASSERT(id_b >= 0, "bt_id_create id_b failed (err %d)", id_b);

	id_c = bt_id_create(NULL, NULL);
	TEST_ASSERT(id_c >= 0, "bt_id_create id_c failed (err %d)", id_c);

	printk("== Bonding id a ==\n");
	ADVERTISE_CONNECTABLE(id_a, NULL, false);
	WAIT_FOR_CONNECTED();
	/* Central should bond here, and trigger a disconnect. */
	TAKE_FLAG(flag_pairing_complete);
	WAIT_FOR_ENCRYPTED_CONNECTION();
	WAIT_FOR_DISCONNECTED();
	central = *bt_conn_get_dst(g_conn);
	clear_g_conn();

	printk("== Bonding id b ==\n");
	ADVERTISE_CONNECTABLE(id_b, NULL, false);
	WAIT_FOR_CONNECTED();
	/* Central should bond here, and trigger a disconnect. */
	TAKE_FLAG(flag_pairing_complete);
	WAIT_FOR_ENCRYPTED_CONNECTION();
	WAIT_FOR_DISCONNECTED();
	ID_CONFLICT_FLAG_CHECK(id_a, &central, true);
	ID_CONFLICT_FLAG_CHECK(id_b, &central, true);
	clear_g_conn();

	printk("== Bonding id c ==\n");
	ADVERTISE_CONNECTABLE(id_c, NULL, false);
	WAIT_FOR_CONNECTED();
	/* Central should bond here, and trigger a disconnect. */
	TAKE_FLAG(flag_pairing_complete);
	WAIT_FOR_ENCRYPTED_CONNECTION();
	WAIT_FOR_DISCONNECTED();
	ID_CONFLICT_FLAG_CHECK(id_b, &central, true);
	ID_CONFLICT_FLAG_CHECK(id_c, &central, true);
	clear_g_conn();

	printk("== Advertising id a again ==\n");
	ADVERTISE_CONNECTABLE(id_a, NULL, false);
	WAIT_FOR_CONNECTED();
	/* Central should encrypt connection here. */
	WAIT_FOR_ENCRYPTED_CONNECTION();
	printk("== Unpairing id a ==\n");
	UNPAIR(id_a, &central);
	WAIT_FOR_DISCONNECTED();
	clear_g_conn();

	ID_CONFLICT_FLAG_CHECK(id_b, &central, true);
	ID_CONFLICT_FLAG_CHECK(id_c, &central, true);

	printk("== Advertising id b again ==\n");
	ADVERTISE_CONNECTABLE(id_b, NULL, false);
	WAIT_FOR_CONNECTED();
	/* Central should encrypt connection here. */
	WAIT_FOR_ENCRYPTED_CONNECTION();
	printk("== Unpairing id b ==\n");
	UNPAIR(id_b, &central);
	WAIT_FOR_DISCONNECTED();
	clear_g_conn();

	ID_CONFLICT_FLAG_CHECK(id_c, &central, false);

	printk("== Advertising id c again ==\n");
	ADVERTISE_CONNECTABLE(id_c, NULL, false);
	WAIT_FOR_CONNECTED();
	/* Central should encrypt connection here. */
	WAIT_FOR_ENCRYPTED_CONNECTION();
	printk("== Unpairing id c ==\n");
	UNPAIR(id_c, &central);
	WAIT_FOR_DISCONNECTED();
	clear_g_conn();

	TEST_PASS("PASS");
}

#if defined(CONFIG_BT_SETTINGS)
void peripheral_persist_bond(void)
{
	int id_a;
	int id_b;
	bt_addr_le_t central;
	int err;

	bs_bt_utils_setup();

	err = settings_load();
	TEST_ASSERT(!err, "settings_load failed (err %d)", err);

	id_a = bt_id_create(NULL, NULL);
	TEST_ASSERT(id_a == 1, "bt_id_create id_a failed (err %d)", id_a);

	id_b = bt_id_create(NULL, NULL);
	TEST_ASSERT(id_b == 2, "bt_id_create id_b failed (err %d)", id_b);

	printk("== Bonding id a ==\n");
	ADVERTISE_CONNECTABLE(id_a, NULL, false);
	WAIT_FOR_CONNECTED();
	/* Central should bond here, and trigger a disconnect. */
	TAKE_FLAG(flag_pairing_complete);
	WAIT_FOR_ENCRYPTED_CONNECTION();
	WAIT_FOR_DISCONNECTED();
	central = *bt_conn_get_dst(g_conn);
	clear_g_conn();

	printk("== Bonding id b ==\n");
	ADVERTISE_CONNECTABLE(id_b, NULL, false);
	WAIT_FOR_CONNECTED();
	/* Central should bond here, and trigger a disconnect. */
	TAKE_FLAG(flag_pairing_complete);
	WAIT_FOR_ENCRYPTED_CONNECTION();
	WAIT_FOR_DISCONNECTED();
	clear_g_conn();

	TEST_PASS("PASS");
}

static void bond_get(const struct bt_bond_info *info, void *user_data)
{
	bt_addr_le_t *central = (bt_addr_le_t *)user_data;

	if (bt_addr_le_cmp(BT_ADDR_LE_NONE, central) == 0) {
		bt_addr_le_copy(central, &info->addr);
	} else {
		char bond_addr[BT_ADDR_LE_STR_LEN];
		char central_addr[BT_ADDR_LE_STR_LEN];

		bt_addr_le_to_str(&info->addr, bond_addr, sizeof(bond_addr));
		bt_addr_le_to_str(central, central_addr, sizeof(central_addr));

		TEST_ASSERT(false, "Unexpected bond found: %s", bond_addr);
		TEST_ASSERT(bt_addr_le_cmp(&info->addr, central) == 0,
			    "Bonded address %s does not match expected %s", bond_addr,
			    central_addr);
	}
}

static void bond_check(const struct bt_bond_info *info, void *user_data)
{
	bt_addr_le_t *central = (bt_addr_le_t *)user_data;

	char bond_addr[BT_ADDR_LE_STR_LEN];
	char central_addr[BT_ADDR_LE_STR_LEN];

	bt_addr_le_to_str(&info->addr, bond_addr, sizeof(bond_addr));
	bt_addr_le_to_str(central, central_addr, sizeof(central_addr));

	TEST_ASSERT(bt_addr_le_cmp(&info->addr, central) == 0,
		    "Bonded address %s does not match expected %s", bond_addr, central_addr);
}

void peripheral_persist_reconnect(void)
{
	int id_a;
	int id_b;
	bt_addr_le_t central;
	int err;
	size_t id_count;

	bs_bt_utils_setup();

	err = settings_load();
	TEST_ASSERT(!err, "settings_load failed (err %d)", err);

	bt_id_get(NULL, &id_count);
	TEST_ASSERT(id_count == 3, "Expected 3 IDs, found %zu", id_count);

	/* Values must be identical to generated in peripheral_persist_bond() test. */
	id_a = 1;
	id_b = 2;

	/* Get the bonded Central address from the settings. */
	bt_addr_le_copy(&central, BT_ADDR_LE_NONE);
	bt_foreach_bond(id_a, bond_get, &central);

	/* Check that id_b is bonded to the same Central as id_a. */
	bt_foreach_bond(id_b, bond_check, &central);

	printk("== Advertising id a again ==\n");
	ADVERTISE_CONNECTABLE(id_a, &central, false);
	WAIT_FOR_CONNECTED();
	/* Central should encrypt connection here and trigger disconnect. */
	WAIT_FOR_ENCRYPTED_CONNECTION();
	WAIT_FOR_DISCONNECTED();
	clear_g_conn();

	printk("== Advertising id b again ==\n");
	ADVERTISE_CONNECTABLE(id_b, &central, false);
	WAIT_FOR_CONNECTED();
	/* Central should encrypt connection here and trigger disconnect. */
	WAIT_FOR_ENCRYPTED_CONNECTION();
	WAIT_FOR_DISCONNECTED();
	clear_g_conn();

	printk("== Advertising id a again ==\n");
	ADVERTISE_CONNECTABLE(id_a, &central, false);
	WAIT_FOR_CONNECTED();
	/* Central should encrypt connection here and trigger disconnect. */
	WAIT_FOR_ENCRYPTED_CONNECTION();
	WAIT_FOR_DISCONNECTED();
	clear_g_conn();

	printk("== Advertising id b again ==\n");
	ADVERTISE_CONNECTABLE(id_b, &central, false);
	WAIT_FOR_CONNECTED();
	/* Central should encrypt connection here and trigger disconnect. */
	WAIT_FOR_ENCRYPTED_CONNECTION();
	WAIT_FOR_DISCONNECTED();
	clear_g_conn();

	TEST_PASS("PASS");
}
#endif /* CONFIG_BT_SETTINGS */

#endif /* CONFIG_BT_PERIPHERAL */
```
