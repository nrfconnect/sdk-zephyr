## CMakeLists.txt
```
# SPDX-License-Identifier: Apache-2.0

cmake_minimum_required(VERSION 3.20.0)

find_package(Zephyr REQUIRED HINTS $ENV{ZEPHYR_BASE})
project(bsim_test_multi_id_bond_keep_ext)

add_subdirectory(${ZEPHYR_BASE}/tests/bsim/babblekit babblekit)
target_link_libraries(app PRIVATE babblekit)

target_sources(app PRIVATE
	src/bs_bt_utils.c
	src/central.c
	src/main.c
	src/peripheral.c
)

zephyr_include_directories(
  ${BSIM_COMPONENTS_PATH}/libUtilv1/src/
  ${BSIM_COMPONENTS_PATH}/libPhyComv1/src/
  )
```

## prj.conf
```kconfig
CONFIG_BT=y

CONFIG_BT_SMP=y

CONFIG_ASSERT=y
CONFIG_BT_TESTING=y
CONFIG_LOG=y

# 1 default identity + 2 identities for the test
CONFIG_BT_ID_MAX=3
CONFIG_BT_MAX_PAIRED=2

# Set to 4 to split 2 connections for Central and 2 for Peripheral in a single executable
CONFIG_BT_MAX_CONN=4

# Allow establishing 2 connections for Peripheral
CONFIG_BT_CTLR_SDC_PERIPHERAL_COUNT=2

CONFIG_BT_PRIVACY=y
CONFIG_BT_ID_AUTO_SWAP_MATCHING_BONDS=y

CONFIG_BT_FILTER_ACCEPT_LIST=y

CONFIG_BT_EXT_ADV=y

# This test uses 2 advertisers
CONFIG_BT_EXT_ADV_MAX_ADV_SET=2
```

## src/main.c
```c
/*
 * Copyright (c) 2025 Nordic Semiconductor ASA
 *
 * SPDX-License-Identifier: Apache-2.0
 */

#include "bs_bt_utils.h"
#include "bstests.h"

#if defined(CONFIG_BT_CENTRAL)
void central_mult_adv_reject(void);
#endif /* CONFIG_BT_CENTRAL */

#if defined(CONFIG_BT_PERIPHERAL)
void peripheral_mult_adv_reject(void);
#endif /* CONFIG_BT_PERIPHERAL */

#if !defined(CONFIG_BT_CENTRAL) && !defined(CONFIG_BT_PERIPHERAL)
#error "At least one of CONFIG_BT_CENTRAL or CONFIG_BT_PERIPHERAL must be enabled"
#endif /* !CONFIG_BT_CENTRAL && !CONFIG_BT_PERIPHERAL */

#if defined(CONFIG_BT_CENTRAL)
static void central_preinit(void)
{
	g_is_central = true;
}
#endif /* CONFIG_BT_CENTRAL */

#if defined(CONFIG_BT_PERIPHERAL)
static void peripheral_preinit(void)
{
	g_is_central = false;
}
#endif /* CONFIG_BT_PERIPHERAL */

static const struct bst_test_instance test_to_add[] = {
#if defined(CONFIG_BT_CENTRAL)
	{
		.test_pre_init_f = central_preinit,
		.test_id = "central_mult_adv_reject",
		.test_main_f = central_mult_adv_reject,
	},
#endif /* CONFIG_BT_CENTRAL */
#if defined(CONFIG_BT_PERIPHERAL)
	{
		.test_pre_init_f = peripheral_preinit,
		.test_id = "peripheral_mult_adv_reject",
		.test_main_f = peripheral_mult_adv_reject,
	},
#endif /* CONFIG_BT_PERIPHERAL */
	BSTEST_END_MARKER,
};

static struct bst_test_list *install(struct bst_test_list *tests)
{
	return bst_add_tests(tests, test_to_add);
};

bst_test_install_t test_installers[] = {install, NULL};

int main(void)
{
	bst_main();
	return 0;
}
```

## src/bs_bt_utils.c
```c
/*
 * Copyright (c) 2025 Nordic Semiconductor ASA
 *
 * SPDX-License-Identifier: Apache-2.0
 */

#include "bs_bt_utils.h"

BUILD_ASSERT(CONFIG_BT_MAX_PAIRED >= 2, "CONFIG_BT_MAX_PAIRED is too small.");
BUILD_ASSERT(CONFIG_BT_ID_MAX >= 3, "CONFIG_BT_ID_MAX is too small.");

DEFINE_FLAG(flag_is_connected);

static sys_slist_t g_link_list = SYS_SLIST_STATIC_INIT(&g_link_list);

bool g_is_central;

const char *addr_to_str(const bt_addr_le_t *addr)
{
	static char str[BT_ADDR_LE_STR_LEN];

	bt_addr_le_to_str(addr, str, sizeof(str));

	return str;
}

void link_ctx_init(struct link_ctx *ctx)
{
	TEST_ASSERT(ctx->node.next == NULL,
		    "%s called on an already initialized context.", __func__);
	sys_slist_append(&g_link_list, &ctx->node);

	UNSET_FLAG(ctx->connected);
	UNSET_FLAG(ctx->pairing_complete);
	UNSET_FLAG(ctx->timedout);
	UNSET_FLAG(ctx->encrypted);
}

#if defined(CONFIG_BT_PERIPHERAL)
static struct link_ctx *get_link_ctx_by_adv(struct bt_le_ext_adv *adv)
{
	struct link_ctx *ctx;

	SYS_SLIST_FOR_EACH_CONTAINER(&g_link_list, ctx, node) {
		if (ctx->adv == adv) {
			return ctx;
		}
	}

	return NULL;
}
#endif /* CONFIG_BT_PERIPHERAL */

static struct link_ctx *get_link_ctx_by_conn(struct bt_conn *conn)
{
	struct link_ctx *ctx;

	SYS_SLIST_FOR_EACH_CONTAINER(&g_link_list, ctx, node) {
		if (ctx->conn == conn) {
			return ctx;
		}
	}

	return NULL;
}

void clear_conn(struct link_ctx *ctx)
{
	TEST_ASSERT(ctx->conn != NULL, "clear_g_conn called with NULL ctx->conn.");
	bt_conn_unref(ctx->conn);
	ctx->conn = NULL;
}

static void connected(struct bt_conn *conn, uint8_t err)
{
	const bt_addr_le_t *dst;
	char addr_str[BT_ADDR_LE_STR_LEN];
	struct link_ctx *ctx;

	dst = bt_conn_get_dst(conn);
	bt_addr_le_to_str(dst, addr_str, sizeof(addr_str));
	printk("Connected to %p, err %d dst %s\n", conn, err, addr_str);

	if (!g_is_central) {
		/* The connection for Peripheral will be handled in the advertiser connected
		 * callback, so we don't need to do anything here.
		 */
		TEST_ASSERT(err == 0 || err == BT_HCI_ERR_ADV_TIMEOUT,
			    "Failed to connect (err %d)", err);
		return;
	}

	TEST_ASSERT(err == 0, "Failed to connect (err %d)", err);

	ctx = get_link_ctx_by_conn(conn);
	TEST_ASSERT(ctx, "No link context for this connection.");
	TEST_ASSERT(ctx->conn == conn, "Connected to unexpected connection.");

	UNSET_FLAG(ctx->encrypted);
	SET_FLAG(ctx->connected);
}

static void disconnected(struct bt_conn *conn, uint8_t reason)
{
	const bt_addr_le_t *dst;
	char addr_str[BT_ADDR_LE_STR_LEN];
	struct link_ctx *ctx;

	dst = bt_conn_get_dst(conn);
	bt_addr_le_to_str(dst, addr_str, sizeof(addr_str));
	printk("Disconnected from %p (addr %s) (reason %d)\n", conn, addr_str, reason);

	ctx = get_link_ctx_by_conn(conn);
	TEST_ASSERT(ctx, "No link context for this connection.");
	TEST_ASSERT(ctx->conn == conn, "Disconnected from unexpected connection.");

	if (!g_is_central) {
		UNSET_FLAG(ctx->timedout);
	}

	UNSET_FLAG(ctx->connected);
}

BUILD_ASSERT(CONFIG_BT_MAX_CONN >= 2, "This test assumes a multi link.");

static void security_changed(struct bt_conn *conn, bt_security_t level,
			     enum bt_security_err err)
{
	const bt_addr_le_t *dst;
	char addr_str[BT_ADDR_LE_STR_LEN];
	struct link_ctx *ctx;

	dst = bt_conn_get_dst(conn);
	bt_addr_le_to_str(dst, addr_str, sizeof(addr_str));
	printk("Security changed for %p (addr %s), level %d, err %d\n", conn, addr_str, level, err);

	ctx = get_link_ctx_by_conn(conn);
	TEST_ASSERT(ctx, "No link context for this connection.");
	TEST_ASSERT(ctx->conn == conn, "Security changed for unexpected connection.");

	if (!err && level == BT_SECURITY_L2) {
		SET_FLAG(ctx->encrypted);
	}
}

BT_CONN_CB_DEFINE(conn_callbacks) = {
	.connected = connected,
	.disconnected = disconnected,
	.security_changed = security_changed,
};

static void pairing_failed(struct bt_conn *conn, enum bt_security_err reason)
{
	printk("Pairing failed with %p (reason %d)\n", conn, reason);

	/* Pairing should not fail in this test, so we assert here. */
	TEST_ASSERT(false, "Pairing failed with %p (reason %d)", conn, reason);
}

static void pairing_complete(struct bt_conn *conn, bool bonded)
{
	const bt_addr_le_t *dst;
	char addr_str[BT_ADDR_LE_STR_LEN];
	struct link_ctx *ctx;

	dst = bt_conn_get_dst(conn);
	bt_addr_le_to_str(dst, addr_str, sizeof(addr_str));
	printk("Pairing complete with %p (bonded %d) dst %s\n", conn, bonded, addr_str);

	ctx = get_link_ctx_by_conn(conn);
	TEST_ASSERT(ctx, "No link context for this connection.");

	SET_FLAG(ctx->pairing_complete);
}

static struct bt_conn_auth_info_cb bt_conn_auth_info_cb = {
	.pairing_failed = pairing_failed,
	.pairing_complete = pairing_complete,
};

void bs_bt_utils_setup(void)
{
	int err;

	err = bt_enable(NULL);
	TEST_ASSERT(!err, "bt_enable failed.");
	err = bt_conn_auth_info_cb_register(&bt_conn_auth_info_cb);
	TEST_ASSERT(!err, "bt_conn_auth_info_cb_register failed.");
}

#if defined(CONFIG_BT_CENTRAL)
static enum bt_gap_adv_type scan_adv_type;
static struct link_ctx *scanning_ctx;

static void scan_connect_to_first_result__device_found(const bt_addr_le_t *addr, int8_t rssi,
						       uint8_t type, struct net_buf_simple *ad)
{
	char addr_str[BT_ADDR_LE_STR_LEN];
	int err;

	if (scanning_ctx == NULL) {
		/* Not scanning, ignore the advertisement. */
		return;
	}

	/* We're only interested in connectable events */
	if (type != scan_adv_type) {
		TEST_FAIL("Unexpected advertisement type %d, expected %d", type, scan_adv_type);
	}

	bt_addr_le_to_str(addr, addr_str, sizeof(addr_str));
	printk("Got scan result, connecting.. dst %s, RSSI %d\n", addr_str, rssi);

	err = bt_le_scan_stop();
	TEST_ASSERT(!err, "Err bt_le_scan_stop %d", err);

	err = bt_conn_le_create(addr, BT_CONN_LE_CREATE_CONN, BT_LE_CONN_PARAM_DEFAULT,
				&scanning_ctx->conn);
	TEST_ASSERT(!err, "Err bt_conn_le_create %d", err);

	scanning_ctx = NULL;
}

int scan_connect_to_first_result(struct link_ctx *ctx, bool directed, bool filter)
{
	struct bt_le_scan_param param = BT_LE_SCAN_PARAM_INIT(BT_LE_SCAN_TYPE_PASSIVE,
							      BT_LE_SCAN_OPT_FILTER_DUPLICATE,
							      BT_GAP_SCAN_FAST_INTERVAL,
							      BT_GAP_SCAN_FAST_WINDOW);

	if (filter) {
		param.options = BT_LE_SCAN_OPT_FILTER_ACCEPT_LIST;
	}

	if (directed) {
		scan_adv_type = BT_GAP_ADV_TYPE_ADV_DIRECT_IND;
	} else {
		scan_adv_type = BT_GAP_ADV_TYPE_ADV_IND;
	}

	TEST_ASSERT(scanning_ctx == NULL, "Already scanning, cannot start a new scan.");
	scanning_ctx = ctx;

	TEST_ASSERT(scanning_ctx->conn == NULL, "%s called on an already initialized context.",
		    __func__);

	return bt_le_scan_start(&param, scan_connect_to_first_result__device_found);
}
#endif /* CONFIG_BT_CENTRAL */

#if defined(CONFIG_BT_PERIPHERAL)
static void adv_sent(struct bt_le_ext_adv *adv, struct bt_le_ext_adv_sent_info *info)
{
	struct link_ctx *ctx;

	ctx = get_link_ctx_by_adv(adv);
	TEST_ASSERT(ctx, "No link context for this advertiser.");

	printk("Advertiser %p sent, num_sent %d\n", adv, info->num_sent);

	SET_FLAG(ctx->timedout);
}

static void adv_connected(struct bt_le_ext_adv *adv, struct bt_le_ext_adv_connected_info *info)
{
	struct link_ctx *ctx;
	const bt_addr_le_t *dst;
	char addr_str[BT_ADDR_LE_STR_LEN];

	dst = bt_conn_get_dst(info->conn);
	bt_addr_le_to_str(dst, addr_str, sizeof(addr_str));
	printk("Connected to %p, dst %s\n", info->conn, addr_str);

	TEST_ASSERT(!g_is_central, "%s called in central role, this should not happen.", __func__);

	ctx = get_link_ctx_by_adv(adv);
	TEST_ASSERT(ctx, "No link context for this advertiser.");

	TEST_ASSERT(!ctx->conn, "Already connected on this advertiser.");
	ctx->conn = bt_conn_ref(info->conn);

	UNSET_FLAG(ctx->encrypted);
	SET_FLAG(ctx->connected);
}

static struct bt_le_ext_adv_cb ext_adv_callbacks = {
	.sent = adv_sent,
	.connected = adv_connected,
};

int advertiser_create(struct link_ctx *ctx, int id, bt_addr_le_t *directed_dst, bool filter)
{
	struct bt_le_adv_param param = {
		.id = id,
		.interval_min = 0x0020,
		.interval_max = 0x4000,
	};

	TEST_ASSERT(ctx->adv == NULL, "%s called on an already initialized context.", __func__);

	param.options |= BT_LE_ADV_OPT_CONN;

	if (filter) {
		param.options |= BT_LE_ADV_OPT_FILTER_CONN;
	}

	if (directed_dst) {
		param.options |= BT_LE_ADV_OPT_DIR_ADDR_RPA;
		param.peer = directed_dst;
	}

	return bt_le_ext_adv_create(&param, &ext_adv_callbacks, &ctx->adv);
}

int advertise_connectable(struct link_ctx *ctx)
{
	struct bt_le_ext_adv_start_param start_param = {
		.timeout = 100,
		.num_events = 0,
	};

	TEST_ASSERT(ctx->adv != NULL,
		    "advertise_connectable_ext called on an uninitialized context.");

	return bt_le_ext_adv_start(ctx->adv, &start_param);
}

void advertiser_destroy(struct link_ctx *ctx)
{
	int err;

	TEST_ASSERT(ctx->adv != NULL, "%s called on an uninitialized context.", __func__);

	err = bt_le_ext_adv_stop(ctx->adv);
	TEST_ASSERT(err == 0, "Failed to stop advertiser (err %d)", err);

	err = bt_le_ext_adv_delete(ctx->adv);
	TEST_ASSERT(err == 0, "Failed to delete advertiser (err %d)", err);

	ctx->adv = NULL;
}
#endif /* CONFIG_BT_PERIPHERAL */
```

## src/bs_bt_utils.h
```c
/**
 * Common functions and helpers for BSIM GATT tests
 *
 * Copyright (c) 2025 Nordic Semiconductor ASA
 *
 * SPDX-License-Identifier: Apache-2.0
 */

#include "bs_tracing.h"
#include "bs_types.h"
#include "bstests.h"
#include "time_machine.h"
#include <zephyr/sys/__assert.h>

#include <errno.h>
#include <stddef.h>
#include <stdint.h>

#include <zephyr/bluetooth/bluetooth.h>
#include <zephyr/bluetooth/conn.h>
#include <zephyr/bluetooth/gatt.h>
#include <zephyr/bluetooth/hci.h>
#include <zephyr/bluetooth/uuid.h>
#include <zephyr/kernel.h>
#include <zephyr/types.h>
#include <zephyr/sys/slist.h>

#include "babblekit/testcase.h"
#include "babblekit/flags.h"

#define WAIT_FOR_CONNECTED(link) WAIT_FOR_FLAG((link)->connected)
#define WAIT_FOR_DISCONNECTED(link) WAIT_FOR_FLAG_UNSET((link)->connected)
#define WAIT_FOR_ENCRYPTED_CONNECTION(link) \
	do { \
		WAIT_FOR_FLAG((link)->encrypted); \
		bool pairing_not_triggered; \
		pairing_not_triggered = !IS_FLAG_SET((link)->pairing_complete); \
		TEST_ASSERT(pairing_not_triggered, "Pairing triggered during encryption"); \
	} while (0)

#define WAIT_FOR_PAIRING_COMPLETE(link) \
	TAKE_FLAG((link)->pairing_complete);

#define FAL_ADD(addr) \
	do { \
		int err; \
		err = bt_le_filter_accept_list_add(addr); \
		TEST_ASSERT(!err, "Err bt_le_filter_accept_list_add %d", err); \
	} while (0)

#define FAL_CLEAR() \
	do { \
		int err; \
		err = bt_le_filter_accept_list_clear(); \
		TEST_ASSERT(!err, "Err bt_le_filter_accept_list_clear %d", err); \
	} while (0)

#define WAIT_FOR_ADV_TIMEOUT(link) \
	TAKE_FLAG((link)->timedout)

struct link_ctx {
	/* Common fields for both Central and Peripheral. */
	sys_snode_t node;

	struct bt_conn *conn;
	atomic_t connected;
	atomic_t encrypted;
	atomic_t pairing_complete;

	/* Peripheral specific fields. */
	atomic_t timedout;
	struct bt_le_ext_adv *adv;
};

const char *addr_to_str(const bt_addr_le_t *addr);

extern bool g_is_central;

void bs_bt_utils_setup(void);

void link_ctx_init(struct link_ctx *ctx);
void clear_conn(struct link_ctx *ctx);

int scan_connect_to_first_result(struct link_ctx *ctx, bool directed, bool filter);

int advertiser_create(struct link_ctx *ctx, int id, bt_addr_le_t *directed_dst, bool filter);
int advertise_connectable(struct link_ctx *ctx);
void advertiser_destroy(struct link_ctx *ctx);
```

## src/central.c
```c
/*
 * Copyright (c) 2025 Nordic Semiconductor ASA
 *
 * SPDX-License-Identifier: Apache-2.0
 */

#include "bs_bt_utils.h"
#include <zephyr/bluetooth/addr.h>
#include <zephyr/bluetooth/conn.h>

#include <stdint.h>

#include <zephyr/bluetooth/bluetooth.h>

#include "babblekit/testcase.h"
#include "babblekit/flags.h"

#if defined(CONFIG_BT_CENTRAL)

#define SCAN_CONNECT_TO_FIRST_RESULT(link, directed, fal) \
	do { \
		int err; \
		err = scan_connect_to_first_result(link, directed, fal); \
		TEST_ASSERT(err == 0, "Failed to start scanning (err %d)", err); \
	} while (0)

#define CONNECTION_ENCRYPT(link) \
	do { \
		int err; \
		err = bt_conn_set_security((link)->conn, BT_SECURITY_L2); \
		TEST_ASSERT(err == 0, "Failed to set security (err %d)", err); \
	} while (0)

#define DISCONNECT(link) \
	do { \
		int err; \
		err = bt_conn_disconnect((link)->conn, BT_HCI_ERR_REMOTE_USER_TERM_CONN); \
		TEST_ASSERT(err == 0, "Failed to disconnect (err %d)", err); \
	} while (0)

void central_mult_adv_reject(void)
{
	struct link_ctx link = {};
	bt_addr_le_t peripheral_b;

	bs_bt_utils_setup();
	link_ctx_init(&link);

	printk("== Bonding id a ==\n");
	SCAN_CONNECT_TO_FIRST_RESULT(&link, false, false);
	WAIT_FOR_CONNECTED(&link);
	CONNECTION_ENCRYPT(&link);
	WAIT_FOR_PAIRING_COMPLETE(&link);
	DISCONNECT(&link);
	WAIT_FOR_DISCONNECTED(&link);
	clear_conn(&link);

	printk("== Bonding id b ==\n");
	SCAN_CONNECT_TO_FIRST_RESULT(&link, false, false);
	WAIT_FOR_CONNECTED(&link);
	CONNECTION_ENCRYPT(&link);
	WAIT_FOR_PAIRING_COMPLETE(&link);
	DISCONNECT(&link);
	WAIT_FOR_DISCONNECTED(&link);
	peripheral_b = *bt_conn_get_dst(link.conn);
	clear_conn(&link);

	printk("== Connect to id b again ==\n");
	FAL_ADD(&peripheral_b);
	SCAN_CONNECT_TO_FIRST_RESULT(&link, true, true);
	WAIT_FOR_CONNECTED(&link);
	CONNECTION_ENCRYPT(&link);
	WAIT_FOR_ENCRYPTED_CONNECTION(&link);
	DISCONNECT(&link);
	WAIT_FOR_DISCONNECTED(&link);
	clear_conn(&link);
	FAL_CLEAR();

	TEST_PASS("PASS");
}

#endif /* CONFIG_BT_CENTRAL */
```

## src/peripheral.c
```c
/*
 * Copyright (c) 2025 Nordic Semiconductor ASA
 *
 * SPDX-License-Identifier: Apache-2.0
 */

#include "bs_bt_utils.h"
#include <zephyr/bluetooth/addr.h>
#include <zephyr/bluetooth/bluetooth.h>
#include <zephyr/bluetooth/conn.h>
#include <zephyr/toolchain.h>

#include <stdint.h>
#include <string.h>

#include "babblekit/testcase.h"
#include "babblekit/flags.h"

#if defined(CONFIG_BT_PERIPHERAL)

#define ADVERTISER_CREATE(link, id, dir_addr, filter) \
	do { \
		int err; \
		err = advertiser_create(link, id, dir_addr, filter); \
		TEST_ASSERT(err == 0, "advertiser_create failed (err %d)", err); \
	} while (0)

#define ADVERTISE_CONNECTABLE(link) \
	do { \
		int err; \
		err = advertise_connectable(link); \
		TEST_ASSERT(err == 0, "advertise_connectable failed (err %d)", err); \
	} while (0)

void peripheral_mult_adv_reject(void)
{
	int id_a;
	int id_b;
	struct link_ctx link_a = {};
	struct link_ctx link_b = {};
	bt_addr_le_t central;
	int err;

	bs_bt_utils_setup();
	link_ctx_init(&link_a);
	link_ctx_init(&link_b);

	id_a = bt_id_create(NULL, NULL);
	TEST_ASSERT(id_a >= 0, "bt_id_create id_a failed (err %d)", id_a);

	id_b = bt_id_create(NULL, NULL);
	TEST_ASSERT(id_b >= 0, "bt_id_create id_b failed (err %d)", id_b);

	ADVERTISER_CREATE(&link_a, id_a, NULL, false);
	ADVERTISER_CREATE(&link_b, id_b, NULL, false);

	printk("== Bonding id a ==\n");
	ADVERTISE_CONNECTABLE(&link_a);
	WAIT_FOR_CONNECTED(&link_a);
	/* Central should bond here, and trigger a disconnect. */
	WAIT_FOR_PAIRING_COMPLETE(&link_a);
	WAIT_FOR_ENCRYPTED_CONNECTION(&link_a);
	WAIT_FOR_DISCONNECTED(&link_a);
	central = *bt_conn_get_dst(link_a.conn);
	clear_conn(&link_a);

	printk("== Bonding id b ==\n");
	ADVERTISE_CONNECTABLE(&link_b);
	WAIT_FOR_CONNECTED(&link_b);
	/* Central should bond here, and trigger a disconnect. */
	WAIT_FOR_PAIRING_COMPLETE(&link_b);
	WAIT_FOR_ENCRYPTED_CONNECTION(&link_b);
	WAIT_FOR_DISCONNECTED(&link_b);
	clear_conn(&link_b);

	/* Re-create advertisers to use directed advertisements. */
	advertiser_destroy(&link_a);
	advertiser_destroy(&link_b);
	ADVERTISER_CREATE(&link_a, id_a, &central, false);
	ADVERTISER_CREATE(&link_b, id_b, &central, false);

	printk("== Advertising id a again ==\n");
	ADVERTISE_CONNECTABLE(&link_a);
	printk("== Advertising id b at the same time ==\n");
	err = advertise_connectable(&link_b);
	TEST_ASSERT(err == -EPERM, "advertise_connectable incorrectly failed (err %d)", err);
	WAIT_FOR_ADV_TIMEOUT(&link_a);
	printk("== Advertising id b again ==\n");
	ADVERTISE_CONNECTABLE(&link_b);
	WAIT_FOR_CONNECTED(&link_b);
	WAIT_FOR_ENCRYPTED_CONNECTION(&link_b);
	WAIT_FOR_DISCONNECTED(&link_b);
	clear_conn(&link_b);

	TEST_PASS("PASS");
}

#endif /* CONFIG_BT_PERIPHERAL */
```
