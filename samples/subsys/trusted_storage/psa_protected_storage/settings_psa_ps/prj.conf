## CMakeLists.txt
```
#
# Copyright (c) 2021 Nordic Semiconductor ASA
#
# SPDX-License-Identifier: Apache-2.0
#

cmake_minimum_required(VERSION 3.20.0)

find_package(Zephyr REQUIRED HINTS $ENV{ZEPHYR_BASE})

project(settings_protected_storage)

target_sources(app PRIVATE ../src/main.c src/settings_setup_littlefs.c)
```

## prj.conf
```kconfig
#
# Copyright (c) 2021 Nordic Semiconductor ASA
#
# SPDX-License-Identifier: Apache-2.0
#

CONFIG_FLASH=y
CONFIG_FLASH_PAGE_LAYOUT=y
CONFIG_FLASH_MAP=y

CONFIG_MAIN_STACK_SIZE=2048
CONFIG_HEAP_MEM_POOL_SIZE=2048

CONFIG_FILE_SYSTEM=y
CONFIG_FILE_SYSTEM_LITTLEFS=y

CONFIG_SETTINGS=y
CONFIG_SETTINGS_RUNTIME=y
CONFIG_SETTINGS_FS=y
CONFIG_SETTINGS_FS_DIR="/ff/settings"
CONFIG_SETTINGS_FS_FILE="/ff/settings/run"

CONFIG_TRUSTED_STORAGE=y
CONFIG_PROTECTED_STORAGE=y
CONFIG_PROTECTED_STORAGE_SETTINGS=y
CONFIG_PROTECTED_STORAGE_SETTINGS_TRUST_NONE=y
```

## src/settings_setup_littlefs.c
```c
/*
 * Copyright (c) 2022 Nordic Semiconductor ASA
 *
 * SPDX-License-Identifier: Apache-2.0
 */

#include <zephyr/kernel.h>
#include <zephyr/init.h>
#include "settings/settings_file.h"
#include <zephyr/device.h>
#include <zephyr/fs/fs.h>
#include <zephyr/fs/littlefs.h>

/* NFFS work area strcut */
FS_LITTLEFS_DECLARE_DEFAULT_CONFIG(cstorage);
static struct fs_mount_t littlefs_mnt = {
	.type = FS_LITTLEFS,
	.fs_data = &cstorage,
	.storage_dev = (void *)FLASH_AREA_ID(littlefs_dev),
	.mnt_point = "/ff",
};

static int setup_settings_backend(const struct device *dev)
{
	int rc;
	const struct flash_area *fap;

	ARG_UNUSED(dev);

	rc = flash_area_open(FLASH_AREA_ID(littlefs_dev), &fap);
	if (rc != 0)
		return rc;

	rc = flash_area_erase(fap, fap->fa_off, fap->fa_size);
	if (rc != 0)
		return rc;

	rc = fs_mount(&littlefs_mnt);
	if (rc != 0)
		return rc;

	return 0;
}

SYS_INIT(setup_settings_backend, APPLICATION, CONFIG_APPLICATION_INIT_PRIORITY);
```
