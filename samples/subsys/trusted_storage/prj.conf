## CMakeLists.txt
```
#
# Copyright (c) 2021 Nordic Semiconductor ASA
#
# SPDX-License-Identifier: Apache-2.0
#

cmake_minimum_required(VERSION 3.20.0)

find_package(Zephyr REQUIRED HINTS $ENV{ZEPHYR_BASE})

project(protected_storage)

target_sources(app PRIVATE src/main.c)

if(CONFIG_BUILD_WITH_TFM)
        target_include_directories(app PRIVATE
        $<TARGET_PROPERTY:tfm,TFM_BINARY_DIR>/install/interface/include
        )
endif()
```

## sample.yaml
```
sample:
  description: Protected Storage API sample
  name: PSA Protected Storage
common:
  tags: psa
  platform_allow:
    - mps2_an521_ns
    - v2m_musca_s1_ns
    - nrf52840dk_nrf52840
    - nrf5340dk_nrf5340_cpuapp_ns
    - nrf9160dk_nrf9160_ns
  integration_platforms:
    - mps2_an521_ns
  harness: console
  harness_config:
    type: multi_line
    regex:
      - "Protected Storage sample started"
      - "PSA Protected Storage API Version [0-9]*.[0-9]*"
      - "Writing data to UID1: .*"
      - "Info on data stored in UID1:"
      - "- Size: [0-9]*"
      - "- Capacity: 0x[0-9a-f]*"
      - "- Flags: 0x[0-9-a-f]*"
      - "Got expected error \\(PSA_ERROR_NOT_PERMITTED\\) when writing to protected\
      \ UID"
      - "Removing UID1"
      - "Done"

tests:
  sample.tfm.protected_storage:
    tags:
      - tfm
      - trusted_storage
```

## prj.conf
```kconfig
#
# Copyright (c) 2021 Nordic Semiconductor ASA
#
# SPDX-License-Identifier: Apache-2.0
#
```

## boards/nrf5340dk_nrf5340_cpuapp.conf
```kconfig
 # SPDX-License-Identifier: Apache-2.0
 # Copyright (c) 2023 Nordic Semiconductor ASA

CONFIG_NORDIC_QSPI_NOR=y
CONFIG_NORDIC_QSPI_NOR_FLASH_LAYOUT_PAGE_SIZE=4096

CONFIG_NRF_SECURITY=y

CONFIG_FLASH=y
CONFIG_FLASH_PAGE_LAYOUT=y
CONFIG_FLASH_MAP=y

CONFIG_MAIN_STACK_SIZE=2048
CONFIG_HEAP_MEM_POOL_SIZE=2048

CONFIG_FILE_SYSTEM=y
CONFIG_FILE_SYSTEM_LITTLEFS=y

CONFIG_SETTINGS=y
CONFIG_SETTINGS_RUNTIME=y
CONFIG_SETTINGS_FILE=y
CONFIG_SETTINGS_FILE_PATH="/0/settings/run"

CONFIG_MBEDTLS=y
CONFIG_MBEDTLS_PSA_CRYPTO_C=y
CONFIG_MBEDTLS_ENABLE_HEAP=y
CONFIG_MBEDTLS_HEAP_SIZE=1024

CONFIG_PSA_TRUSTED_STORAGE=y
CONFIG_PROTECTED_STORAGE=y
```

## boards/nrf9160dk_nrf9160_ns.conf
```kconfig
 # SPDX-License-Identifier: Apache-2.0
 # Copyright (c) 2023 Nordic Semiconductor ASA

CONFIG_BUILD_WITH_TFM=y
CONFIG_TFM_PROFILE_TYPE_NOT_SET=y
```

## src/main.c
```c
/*
 * Copyright (c) 2021 Nordic Semiconductor ASA.
 *
 * SPDX-License-Identifier: Apache-2.0
 */

#include <zephyr/kernel.h>
#include <string.h>
#include <zephyr/sys/printk.h>
#include <psa/storage_common.h>
#include <psa/protected_storage.h>

#define TEST_STRING_1 "The quick brown fox jumps over the lazy dog"
#define TEST_STRING_2 "Lorem ipsum dolor sit amet"

/* Use settings with littlefs backend */
#ifdef CONFIG_PSA_TRUSTED_STORAGE

#include "settings/settings_file.h"
#include <zephyr/device.h>
#include <zephyr/fs/fs.h>
#include <zephyr/fs/littlefs.h>

#define STORAGE_PARTITION    storage_partition
#define STORAGE_PARTITION_ID FIXED_PARTITION_ID(STORAGE_PARTITION)

/* LittleFS work area struct */
FS_LITTLEFS_DECLARE_DEFAULT_CONFIG(cstorage);
static struct fs_mount_t littlefs_mnt = {
	.type = FS_LITTLEFS,
	.fs_data = &cstorage,
	.storage_dev = (void *)STORAGE_PARTITION_ID,
	.mnt_point = "/0",
};

static int setup_settings_backend(void)
{
	int rc;

	rc = fs_mount(&littlefs_mnt);
	if (rc != 0) {
		return rc;
	}

	return 0;
}

SYS_INIT(setup_settings_backend, APPLICATION, CONFIG_APPLICATION_INIT_PRIORITY);
#endif

int main(void)
{
	psa_status_t status = 0;

	printk("Protected Storage sample started.\n");
	printk("PSA Protected Storage API Version %d.%d\n", PSA_PS_API_VERSION_MAJOR,
	       PSA_PS_API_VERSION_MINOR);

	printk("Writing data to UID1: %s\n", TEST_STRING_1);
	psa_storage_uid_t uid1 = 1;
	psa_storage_create_flags_t uid1_flag = PSA_STORAGE_FLAG_NONE;

	status = psa_ps_set(uid1, sizeof(TEST_STRING_1), TEST_STRING_1, uid1_flag);
	if (status != PSA_SUCCESS) {
		printk("Failed to store data! (%d)\n", status);
		return 0;
	}

	/* Get info on UID1 */
	struct psa_storage_info_t uid1_info;

	status = psa_ps_get_info(uid1, &uid1_info);
	if (status != PSA_SUCCESS) {
		printk("Failed to get info! (%d)\n", status);
		return 0;
	}
	printk("Info on data stored in UID1:\n");
	printk("- Size: %d\n", uid1_info.size);
	printk("- Capacity: 0x%2x\n", uid1_info.capacity);
	printk("- Flags: 0x%2x\n", uid1_info.flags);

	printk("Read and compare data stored in UID1\n");
	size_t bytes_read;
	char stored_data[sizeof(TEST_STRING_1)];

	status = psa_ps_get(uid1, 0, sizeof(TEST_STRING_1), &stored_data, &bytes_read);
	if (status != PSA_SUCCESS) {
		printk("Failed to get data stored in UID1! (%d)\n", status);
		return 0;
	}
	printk("Data stored in UID1: %s\n", stored_data);

	printk("Overwriting data stored in UID1: %s\n", TEST_STRING_2);
	status = psa_ps_set(uid1, sizeof(TEST_STRING_2), TEST_STRING_2, uid1_flag);
	if (status != PSA_SUCCESS) {
		printk("Failed to overwrite UID1! (%d)\n", status);
		return 0;
	}

	printk("Writing data to UID2 with overwrite protection: %s\n", TEST_STRING_1);
	psa_storage_uid_t uid2 = 2;
	psa_storage_create_flags_t uid2_flag = PSA_STORAGE_FLAG_WRITE_ONCE;

	status = psa_ps_set(uid2, sizeof(TEST_STRING_1), TEST_STRING_1, uid2_flag);
	if (status != PSA_SUCCESS) {
		printk("Failed to set write once flag! (%d)\n", status);
		printk("Maybe erase the device?\n");
		return 0;
	}

	printk("Attempting to write '%s' to UID2\n", TEST_STRING_2);
	status = psa_ps_set(uid2, sizeof(TEST_STRING_2), TEST_STRING_2, uid2_flag);
	if (status != PSA_ERROR_NOT_PERMITTED) {
		printk("Got unexpected status when overwriting! (%d)\n", status);
		return 0;
	}
	printk("Got expected error (PSA_ERROR_NOT_PERMITTED) when writing to protected UID\n");

	printk("Removing UID1\n");
	status = psa_ps_remove(uid1);
	if (status != PSA_SUCCESS) {
		printk("Failed to remove UID1! (%d)\n", status);
		return 0;
	}

	printk("Done");

	return 0;
}
```
