## CMakeLists.txt
```
# SPDX-License-Identifier: Apache-2.0

cmake_minimum_required(VERSION 3.20.0)

find_package(Zephyr REQUIRED HINTS $ENV{ZEPHYR_BASE})
project(zperf)

target_sources(app PRIVATE
  src/main.c
  )

if (CONFIG_NET_SAMPLE_CODE_RELOCATE)
  # Relocate key networking stack components and L2 layer to RAM
  zephyr_code_relocate(LIBRARY subsys__net__ip
    LOCATION "${CONFIG_NET_SAMPLE_CODE_RAM_NAME}_TEXT" NOKEEP)
  zephyr_code_relocate(LIBRARY subsys__net
    LOCATION "${CONFIG_NET_SAMPLE_CODE_RAM_NAME}_TEXT" NOKEEP)
if (CONFIG_NET_L2_ETHERNET)
  zephyr_code_relocate(LIBRARY drivers__ethernet
    LOCATION "${CONFIG_NET_SAMPLE_CODE_RAM_NAME}_TEXT" NOKEEP)
  zephyr_code_relocate(LIBRARY subsys__net__l2__ethernet
    LOCATION "${CONFIG_NET_SAMPLE_CODE_RAM_NAME}_TEXT" NOKEEP)
endif()
endif()

if (CONFIG_SOC_NRF5340_CPUAPP)
  target_sources(app PRIVATE
    src/nrf5340_cpu_boost.c
    )
endif()
```

## sample.yaml
```
common:
  tags:
    - net
    - zperf
  platform_exclude:
    - sam_e70_xplained/same70q21
  min_ram: 64
sample:
  description: Network performance measurement tool for Zephyr
  name: zperf
tests:
  sample.net.zperf:
    harness: net
    platform_allow: qemu_x86
  sample.net.zperf_no_server:
    harness: net
    platform_allow: qemu_x86
    extra_configs:
      - CONFIG_NET_ZPERF_SERVER=n
  sample.net.zperf.async_tx.stm32:
    filter: dt_compat_enabled("st,stm32-ethernet") and CONFIG_ETH_STM32_HAL_API_V2
    harness: console
    harness_config:
      type: multi_line
      regex:
        - "coming up"
    integration_platforms:
      - stm32h573i_dk
    extra_configs:
      - CONFIG_ETH_STM32_HAL_TX_ASYNC=n
  sample.net.zperf_st:
    harness: console
    harness_config:
      type: multi_line
      regex:
        - "coming up"
    platform_allow:
      - nucleo_h563zi
      - nucleo_h743zi
      - nucleo_h753zi
      - nucleo_f429zi
      - nucleo_f746zg
      - stm32h573i_dk
    integration_platforms:
      - stm32h573i_dk
  sample.net.zperf_no_shell:
    harness: net
    extra_configs:
      - CONFIG_NET_SHELL=n
    platform_allow: qemu_x86
  sample.net.zperf_concurrent_upload:
    harness: net
    extra_configs:
      - CONFIG_ZPERF_SESSION_PER_THREAD=y
    platform_allow: qemu_x86
  sample.net.zperf.usbd_cdc_ecm:
    harness: net
    extra_args:
      - EXTRA_CONF_FILE="overlay-usbd.conf"
      - DTC_OVERLAY_FILE="usbd_cdc_ecm.overlay"
    platform_allow:
      - nrf52840dk/nrf52840
      - frdm_k64f
    tags:
      - usb
      - net
      - zperf
    depends_on: usbd
  sample.net.zperf.usbd_cdc_ncm:
    harness: net
    extra_args:
      - EXTRA_CONF_FILE="overlay-usbd.conf"
      - DTC_OVERLAY_FILE="usbd_cdc_ncm.overlay"
    platform_allow:
      - nrf52840dk/nrf52840
      - frdm_k64f
    tags:
      - usb
      - net
      - zperf
    depends_on: usbd
  sample.net.zperf.shield:
    harness: net
    platform_allow: reel_board
    extra_args: SHIELD=link_board_eth
    tags:
      - shield
      - net
      - zperf
    depends_on:
      - arduino_spi
      - arduino_gpio
  sample.net.zperf.nxp_enet1g:
    extra_args: EXTRA_DTC_OVERLAY_FILE="nxp,enet1g.overlay"
    tags:
      - net
      - zperf
    platform_allow:
      - mimxrt1170_evk/mimxrt1176/cm7
  sample.net.zperf.802154.subg:
    extra_args: EXTRA_CONF_FILE="overlay-802154-subg.conf"
    platform_allow: beagleconnect_freedom
  sample.net.zperf.nrf7002dk:
    extra_args: SNIPPET=wifi-ipv4
    extra_configs:
      - CONFIG_BUILD_ONLY_NO_BLOBS=y
    platform_allow: nrf7002dk/nrf5340/cpuapp
  sample.net.zperf.raw_tx:
    harness: net
    platform_allow: qemu_x86
    extra_configs:
      - CONFIG_NET_SOCKETS_PACKET=y
      - CONFIG_NET_ZPERF_RAW_TX=y
  sample.net.zperf.raw_tx.nrf7002dk:
    extra_args: SNIPPET=wifi-ipv4
    extra_configs:
      - CONFIG_BUILD_ONLY_NO_BLOBS=y
      - CONFIG_NET_SOCKETS_PACKET=y
      - CONFIG_NET_ZPERF_RAW_TX=y
    platform_allow: nrf7002dk/nrf5340/cpuapp
```

## prj.conf
```kconfig
CONFIG_NETWORKING=y
CONFIG_NET_ZPERF=y
CONFIG_NET_ZPERF_SERVER=y
CONFIG_NET_LOG=y
CONFIG_NET_IPV6=y
CONFIG_NET_IPV4=y
CONFIG_NET_DHCPV4=n
CONFIG_NET_UDP=y
CONFIG_NET_TCP=y
CONFIG_NET_TCP_IPV6_ND_REACHABILITY_HINT=y
CONFIG_NET_STATISTICS=y

CONFIG_NET_PKT_RX_COUNT=40
CONFIG_NET_PKT_TX_COUNT=40
CONFIG_NET_BUF_RX_COUNT=160
CONFIG_NET_BUF_TX_COUNT=160
CONFIG_NET_BUF_DATA_SIZE=256
CONFIG_NET_IF_UNICAST_IPV6_ADDR_COUNT=4
CONFIG_NET_IF_MCAST_IPV6_ADDR_COUNT=5
CONFIG_NET_IF_UNICAST_IPV4_ADDR_COUNT=1
CONFIG_NET_MAX_CONTEXTS=5
CONFIG_NET_TC_TX_COUNT=1
CONFIG_NET_SOCKETS=y
CONFIG_NET_SOCKETS_SERVICE_THREAD_PRIO=-1
CONFIG_ZVFS_POLL_MAX=9

CONFIG_INIT_STACKS=y
CONFIG_TEST_RANDOM_GENERATOR=y

CONFIG_NET_L2_ETHERNET=y
CONFIG_NET_SHELL=y

CONFIG_NET_CONFIG_SETTINGS=y
CONFIG_NET_CONFIG_MY_IPV6_ADDR="2001:db8::1"
CONFIG_NET_CONFIG_PEER_IPV6_ADDR="2001:db8::2"
CONFIG_NET_CONFIG_MY_IPV4_ADDR="192.0.2.1"
CONFIG_NET_CONFIG_PEER_IPV4_ADDR="192.0.2.2"

CONFIG_LOG=y
CONFIG_SHELL_CMDS_RESIZE=n

CONFIG_CACHE_MANAGEMENT=n
CONFIG_SPEED_OPTIMIZATIONS=y
CONFIG_TIMESLICING=n

# For speed optimizations
CONFIG_PICOLIBC_USE_MODULE=n
```

## overlay-loopback.conf
```kconfig
CONFIG_NET_DRIVERS=y
CONFIG_NET_LOOPBACK=y
CONFIG_NET_LOOPBACK_MTU=1100
# Enable for testing TX only
CONFIG_NET_LOOPBACK_SIMULATE_PACKET_DROP=y

CONFIG_NET_BUF_DATA_SIZE=1100
# Optimized networking settings for performance
CONFIG_NET_PKT_RX_COUNT=24
CONFIG_NET_PKT_TX_COUNT=48
CONFIG_NET_BUF_RX_COUNT=24
CONFIG_NET_BUF_TX_COUNT=96
```

## src/main.c
```c
/*
 * Copyright (c) 2020 Nordic Semiconductor ASA
 *
 * SPDX-License-Identifier: Apache-2.0
 */

/**
 * @file
 * @brief Zperf sample.
 */
#include <zephyr/usb/usb_device.h>
#include <zephyr/net/net_config.h>

#ifdef CONFIG_NET_LOOPBACK_SIMULATE_PACKET_DROP
#include <zephyr/net/loopback.h>
#endif
int main(void)
{
	printk("Starting %s with CPU frequency: %d MHz", CONFIG_BOARD, SystemCoreClock/MHZ(1));

#if defined(CONFIG_USB_DEVICE_STACK)
	int ret;

	ret = usb_enable(NULL);
	if (ret != 0) {
		printk("usb enable error %d\n", ret);
	}

	(void)net_config_init_app(NULL, "Initializing network");
#endif /* CONFIG_USB_DEVICE_STACK */
#ifdef CONFIG_NET_LOOPBACK_SIMULATE_PACKET_DROP
	loopback_set_packet_drop_ratio(1);
#endif

#if defined(CONFIG_NET_DHCPV4) && !defined(CONFIG_NET_CONFIG_SETTINGS)
	net_dhcpv4_start(net_if_get_default());
#endif
	return 0;
}
```

## src/nrf5340_cpu_boost.c
```c
/*
 * Copyright (c) 2025 Nordic Semiconductor ASA
 *
 * SPDX-License-Identifier: Apache-2.0
 */

/**
 * @file
 * @brief CPU frequency boost for nRF53 series
 */

#include <zephyr/kernel.h>
#include <zephyr/logging/log.h>
#include <zephyr/drivers/clock_control/nrf_clock_control.h>

static const uint32_t hfclk_requested_frequency = MHZ(128);

LOG_MODULE_DECLARE(zperf, CONFIG_NET_ZPERF_LOG_LEVEL);

static int nrf53_cpu_boost(void)
{
	int err = 0;

	/* For optimal performance, the CPU frequency should be set to 128 MHz */
#if defined(CONFIG_CLOCK_CONTROL_NRF)
	err = nrfx_clock_divider_set(NRF_CLOCK_DOMAIN_HFCLK, NRF_CLOCK_HFCLK_DIV_1);
#else
	err = clock_control_set_rate(DEVICE_DT_GET_ONE(nordic_nrf_clock_hfclk), NULL,
				     &hfclk_requested_frequency);
#endif
	if (err != 0) {
		LOG_WRN("Failed to set 128 MHz: %d", err);
	}

	LOG_INF("Starting %s with CPU frequency: %d MHz", CONFIG_BOARD, SystemCoreClock/MHZ(1));

	return err;
}

SYS_INIT(nrf53_cpu_boost, POST_KERNEL, CONFIG_KERNEL_INIT_PRIORITY_DEFAULT);
```
