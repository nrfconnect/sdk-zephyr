## CMakeLists.txt
```
#
# Copyright (c) 2021 Nordic Semiconductor ASA
#
# SPDX-License-Identifier: Apache-2.0
#

cmake_minimum_required(VERSION 3.13.1)

# Override the binary used by qemu
set(QEMU_KERNEL_OPTION "-device;loader,file=${CMAKE_BINARY_DIR}/tfm_merged.hex")

find_package(Zephyr REQUIRED HINTS $ENV{ZEPHYR_BASE})

project(tfm_psa_storage_test)

target_sources(app PRIVATE src/main.c)
```

## sample.yaml
```
common:
    tags: tfm
    platform_allow: mps2_an521_ns
                    nrf5340dk_nrf5340_cpuapp_ns nrf9160dk_nrf9160_ns
                    v2m_musca_s1_ns
    integration_platforms:
      - mps2_an521_ns
    harness: console
    harness_config:
      type: multi_line
      regex:
        - "\\*\\*\\*\\*\\* PSA Architecture Test Suite - Version .* \\*\\*\\*\\*\\*"
        - "TOTAL FAILED *: 0"
sample:
  name: "TFM PSA Test"

tests:
  sample.tfm.psa_test_protected_storage:
    extra_args: "CONFIG_TFM_PSA_TEST_PROTECTED_STORAGE=y"
    timeout: 120
  sample.tfm.psa_test_internal_trusted_storage:
    extra_args: "CONFIG_TFM_PSA_TEST_INTERNAL_TRUSTED_STORAGE=y"
  sample.tfm.psa_test_storage:
    extra_args: "CONFIG_TFM_PSA_TEST_STORAGE=y"
    timeout: 130
  sample.tfm.psa_test_crypto:
    timeout: 120
    extra_args: "CONFIG_TFM_PSA_TEST_CRYPTO=y"

# The test suite below has been disabled due to licensing issues with the QCBOR
# library used by t_cose. This test will be re-enabled once the licensing
# issues have been sorted out upstream.
#
#  sample.tfm.psa_test_initial_attestation:
#    extra_args: "CONFIG_TFM_PSA_TEST_INITIAL_ATTESTATION=y"
```

## prj.conf
```kconfig
#
# Copyright (c) 2021 Nordic Semiconductor ASA
#
# SPDX-License-Identifier: Apache-2.0
#

CONFIG_BUILD_WITH_TFM=y
CONFIG_TFM_PROFILE_TYPE_NOT_SET=y

# Needed for CRYPTO and INITIAL_ATTESTATION
CONFIG_MAIN_STACK_SIZE=4096
```

## boards/nrf9160dk_nrf9160ns.overlay
```dts
/*
 * Copyright (c) 2021 Nordic Semiconductor ASA
 *
 * SPDX-License-Identifier: Apache-2.0
 */

/* Disable uart1 in nonsecure since it is used by the TFM secure app. */
&uart1 {
	status = "disabled";
};
```

## src/main.c
```c
/*
 * Copyright (c) 2021 Nordic Semiconductor ASA.
 *
 * SPDX-License-Identifier: Apache-2.0
 */

#include <zephyr.h>

/* Run the PSA test suite */
void psa_test(void);

__attribute__((noreturn))
void main(void)
{
	psa_test();

	for (;;) {
	}
}
```
