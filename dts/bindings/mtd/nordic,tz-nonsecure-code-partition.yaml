## dts/bindings/mtd/nordic,tz-nonsecure-code-partition.yaml
```yaml
# Copyright (c) 2026 Nordic Semiconductor ASA
# SPDX-License-Identifier: Apache-2.0

description: |
  Tags a memory-mapped flash/RRAM partition as an ARM TrustZone Non-Secure
  code slot. Peer of "nordic,tz-nonsecure-data-partition".

  Inherits from "zephyr,mapped-partition", so a node carrying this compat is
  a fully-fledged memory-mapped NVM partition. The TF-M build additionally
  iterates this compat to compute FLASH_NS_PARTITION_SIZE, the size of a
  single non-secure image slot. Multiple okay nodes are allowed for
  multi-slot MCUboot layouts; a BUILD_ASSERT enforces equal reg size across
  them.

  Example:

      slot0_ns_partition: partition@8a000 {
          compatible = "nordic,tz-nonsecure-code-partition";
          label = "image-0-nonsecure";
          reg = <0x0008a000 DT_SIZE_K(940)>;
      };

compatible: "nordic,tz-nonsecure-code-partition"

include: [zephyr,mapped-partition.yaml]
```

## dts/bindings/mtd/nordic,tz-nonsecure-data-partition.yaml
```yaml
# Copyright (c) 2026 Nordic Semiconductor ASA
# SPDX-License-Identifier: Apache-2.0

description: |
  Tags a memory-mapped flash/RRAM partition as ARM TrustZone Non-Secure data
  (non-secure storage, settings, ZMS, ...). Peer of
  "nordic,tz-nonsecure-code-partition".

  Inherits from "zephyr,mapped-partition", so a node carrying this compat is
  a fully-fledged memory-mapped NVM partition. The TF-M build sums both
  peers to compute the total non-secure flash footprint
  (FLASH_NONSECURE_TOTAL_SIZE) while keeping FLASH_NS_PARTITION_SIZE a
  per-slot value.

  Example:

      storage_partition: partition@175000 {
          compatible = "nordic,tz-nonsecure-data-partition";
          label = "storage";
          reg = <0x00175000 DT_SIZE_K(32)>;
      };

compatible: "nordic,tz-nonsecure-data-partition"

include: [zephyr,mapped-partition.yaml]
```

## dts/bindings/mtd/nordic,tz-secure-code-partition.yaml
```yaml
# Copyright (c) 2026 Nordic Semiconductor ASA
# SPDX-License-Identifier: Apache-2.0

description: |
  Tags a memory-mapped flash/RRAM partition as an ARM TrustZone Secure code
  slot (e.g. the TF-M secure image). Peer of "nordic,tz-secure-data-partition".

  Inherits from "zephyr,mapped-partition", so a node carrying this compat is
  a fully-fledged memory-mapped NVM partition. The TF-M build additionally
  iterates this compat to compute FLASH_S_PARTITION_SIZE, the size of a
  single image slot (consumed as SECURE_IMAGE_MAX_SIZE). Multiple okay nodes
  are allowed for multi-slot MCUboot layouts; a BUILD_ASSERT enforces equal
  reg size across them.

  Example:

      slot0_partition: partition@0 {
          compatible = "nordic,tz-secure-code-partition";
          label = "image-0";
          reg = <0x0 DT_SIZE_K(512)>;
      };

compatible: "nordic,tz-secure-code-partition"

include: [zephyr,mapped-partition.yaml]
```

## dts/bindings/mtd/nordic,tz-secure-data-partition.yaml
```yaml
# Copyright (c) 2026 Nordic Semiconductor ASA
# SPDX-License-Identifier: Apache-2.0

description: |
  Tags a memory-mapped flash/RRAM partition as ARM TrustZone Secure data
  (PS, ITS, OTP, NV counters, ...). Peer of "nordic,tz-secure-code-partition".

  Inherits from "zephyr,mapped-partition", so a node carrying this compat is
  a fully-fledged memory-mapped NVM partition. The TF-M build sums both
  peers to compute the total secure flash footprint (FLASH_SECURE_TOTAL_SIZE)
  while keeping FLASH_S_PARTITION_SIZE a per-slot value.

  Example:

      tfm_ps_partition: partition@80000 {
          compatible = "nordic,tz-secure-data-partition";
          label = "tfm-ps";
          reg = <0x00080000 DT_SIZE_K(16)>;
      };

compatible: "nordic,tz-secure-data-partition"

include: [zephyr,mapped-partition.yaml]
```

## dts/bindings/power/nordic,nrf-power.yaml
```yaml
---
title: NORDIC NRF POWER
id: nordic,nrf-power
version: 0.1

description: >
    This binding gives a base representation of the NRF power control

properties:
    compatible:
      type: string
      category: required
      description: compatible strings
      constraint: "nordic,nrf-power"

    reg:
      type: array
      description: mmio register space
      generation: define
      category: required

    interrupts:
      type: array
      category: required
      description: required interrupts
      generation: define
...
```

## dts/bindings/rtc/nordic,nrf-rtc.yaml
```yaml
#
# Copyright (c) 2018, Nordic
#
# SPDX-License-Identifier: Apache-2.0
#
---
title: NRF RTC
id: nordic,nrf-rtc
version: 0.1

description: >
    This binding gives a base representation of the NRF RTC

inherits:
    !include rtc.yaml

properties:
    compatible:
      type: string
      category: required
      description: compatible strings
      constraint: "nordic,nrf-rtc"

    reg:
      type: array
      description: mmio register space
      generation: define
      category: required

    interrupts:
      type: array
      category: required
      description: required interrupts
      generation: define
...
```

## dts/bindings/spi/nordic,nrf-spi-common.yaml
```yaml
# Copyright (c) 2018 Nordic Semiconductor ASA
# SPDX-License-Identifier: Apache-2.0

# Common fields for Nordic nRF family SPI peripherals

include: [spi-controller.yaml, pinctrl-device.yaml]

properties:
    reg:
      required: true

    interrupts:
      required: true

    max-frequency:
      type: int
      required: true
      description: |
        Maximum data rate the SPI peripheral can be driven at, in Hz. This
        property must be set at SoC level DTS files.

    overrun-character:
      type: int
      default: 0xff
      description: |
        The overrun character (ORC) is used when all bytes from the TX buffer
        are sent, but the transfer continues due to RX. Defaults to 0xff
        (line high), the most common value used in SPI transfers.

    sck-pin:
      type: int
      deprecated: true
      required: false
      description: |
        IMPORTANT: This option will only be used if the new pin control driver
        is not enabled.

        The SCK pin to use.

        For pins P0.0 through P0.31, use the pin number. For example,
        to use P0.16 for SCK, set:

            sck-pin = <16>;

        For pins P1.0 through P1.31, add 32 to the pin number. For
        example, to use P1.2 for SCK, set:

            sck-pin = <34>;  /* 32 + 2 */

    mosi-pin:
      type: int
      deprecated: true
      required: false
      description: |
        IMPORTANT: This option will only be used if the new pin control driver
        is not enabled.

        The MOSI pin to use. The pin numbering scheme is the same as
        the sck-pin property's.

    miso-pin:
      type: int
      deprecated: true
      required: false
      description: |
        IMPORTANT: This option will only be used if the new pin control driver
        is not enabled.

        The MISO pin to use. The pin numbering scheme is the same as
        the sck-pin property's.

    wake-gpios:
      type: phandle-array
      description: |
        Optional bi-directional line that allows SPI master to indicate to SPI
        slave (by setting the line high) that a transfer is to occur, so that
        the latter can prepare (and indicate its readiness) for handling that
        transfer when it is actually needed, and stay in any desired low-power
        state otherwise.
        The protocol is as follows:
        - initially, SPI slave configures its WAKE line pin as an input and SPI
          master keeps the line in the low state
        - when a transfer is to be performed, SPI master configures its WAKE
          line pin as an input with pull-up; this changes the line state to
          high but allows SPI slave to override that state
        - when SPI slave detects the high state of the WAKE line, it prepares
          for the transfer and when everything is ready, it drives the WAKE
          line low by configuring its pin as an output
        - the generated high-to-low transition on the WAKE line is a signal
          to SPI master that it can proceed with the transfer
        - SPI slave releases the line by configuring its pin back to be an input
          and SPI master again keeps the line in the low state
        Please note that the line must be configured and properly handled on
        both sides for the mechanism to work correctly.
```

## dts/bindings/timer/nordic,nrf-timer.yaml
```yaml
#
# Copyright (c) 2018, Nordic Semiconductor ASA
#
# SPDX-License-Identifier: Apache-2.0
#
---
title: Nordic Semiconductor NRF timer
version: 0.1

description: >
    This is a representation of the NRF timer

properties:
    compatible:
      type: string
      category: required
      description: compatible strings
      constraint: "nordic,nrf-timer"
      generation: define

    reg:
      type: array
      description: mmio register space
      generation: define
      category: required

    label:
      type: string
      category: required
      description: Human readable string describing the device (used by Zephyr for API name)
      generation: define

    interrupts:
      type: array
      category: required
      description: required interrupts
      generation: define

...
```

## modules/Kconfig.mcuboot_bootutil
```kconfig
# Copyright (c) 2020 Nordic Semiconductor ASA
# SPDX-License-Identifier: Apache-2.0

menuconfig MCUBOOT_BOOTUTIL_LIB
	bool "MCUboot utility library"
	help
	  Enable MCUboot utility library which implements functions
	  required by the chain-loaded application and the MCUboot.

if MCUBOOT_BOOTUTIL_LIB

# hiden option for disabling module-own log configuration
# while building MCUboot bootloader
config MCUBOOT_BOOTUTIL_LIB_OWN_LOG
	bool
	default y

if MCUBOOT_BOOTUTIL_LIB_OWN_LOG
module = MCUBOOT_UTIL
module-str = MCUboot bootutil
source "subsys/logging/Kconfig.template.log_config"
endif

config BOOT_IMAGE_ACCESS_HOOKS
	bool "Enable hooks for overriding MCUboot's bootutil native routines"
	help
	  Allow to provide procedures for override or extend native
	  MCUboot's routines required for access the image data.

config BOOT_IMAGE_ACCESS_HOOKS_FILE
	string "Hooks implementation file path"
	depends on BOOT_IMAGE_ACCESS_HOOKS
	help
	  Path to the file which implements hooks.
	  You can use either absolute or relative path.
	  In case relative path is used, the build system assumes that it starts
	  from the directory where the project KConfig configuration file is
	  located. If the key file is not there, the build system uses relative
	  path that starts from the Application cmake directory.

endif # MCUBOOT_BOOTUTIL_LIB
```

## modules/hal_nordic/ironside/se/Kconfig
```kconfig
# Copyright (c) 2025 Nordic Semiconductor ASA
# SPDX-License-Identifier: Apache-2.0

config HAS_IRONSIDE_SE
	bool

menu "IronSide SE"
	depends on HAS_IRONSIDE_SE

config IRONSIDE_SE_CALL
	bool "IronSide calls"
	default y
	depends on DT_HAS_NORDIC_IRONSIDE_CALL_ENABLED
	depends on MULTITHREADING
	select EVENTS
	select MBOX
	help
	  Support for IronSide call APIs.

if IRONSIDE_SE_CALL

config IRONSIDE_SE_CALL_INIT_PRIORITY
	int "IronSide calls' driver initialization priority"
	default 41
	help
	  Initialization priority of the IronSide call protocol driver.
	  It must be below MBOX_INIT_PRIORITY, but higher than the priority of any feature
	  that depends on IRONSIDE_SE_CALL.

endif # IRONSIDE_SE_CALL

config IRONSIDE_SE_DVFS
	bool "DVFS support"
	depends on SOC_NRF54H20_CPUAPP
	depends on IRONSIDE_SE_CALL
	help
	  Support for changing the DVFS operating point.

if IRONSIDE_SE_DVFS

config IRONSIDE_SE_DVFS_ABB_STATUSANA_CHECK_MAX_ATTEMPTS
	int "ABB analog status check maximum attempts"
	range 0 255
	default 50
	help
	  Maximum attempts with 10us intervals before busy status will be reported.

endif # IRONSIDE_SE_DVFS

menuconfig NRF_PERIPHCONF_SECTION
	bool "Global peripheral initialization section"
	depends on LINKER_DEVNULL_SUPPORT
	help
	  Include static global domain peripheral initialization values from the
	  build in a dedicated section. The section is either stripped from the
	  firmware binary or kept as constant data, depending on how it will be
	  loaded at runtime.

if NRF_PERIPHCONF_SECTION

config NRF_PERIPHCONF_SECTION_STRIP
	bool
	default y
	depends on !NRF_PERIPHCONF_SECTION_KEEP
	imply LINKER_DEVNULL_MEMORY
	help
	  Strip the PERIPHCONF section from the firmware binary.

config NRF_PERIPHCONF_SECTION_KEEP
	bool "Keep the section in the binary"
	default y if NRF_PERIPHCONF_SECTION_KEEP_BY_DEFAULT
	help
	  Keep the PERIPHCONF section as data in the firmware binary.

config NRF_PERIPHCONF_GENERATE_ENTRIES
	bool "Generate PERIPHCONF entries source file"
	default y
	help
	  Generate a C file containing PERIPHCONF entries based on the
	  device configuration in the devicetree.

config NRF_PERIPHCONF_GENERATE_ENTRIES_NO_LOCK
	bool "Don't lock registers in PERIPHCONF"
	help
	  Don't set the lock bit in registers that support it (SPU registers).
	  This is needed when the registers are reconfigured after boot.

endif # NRF_PERIPHCONF_SECTION

config NRF_PERIPHCONF_SECTION_KEEP_BY_DEFAULT
	bool "Keep the PERIPHCONF section by default (set by Sysbuild, do not change)"
	help
	  This is set by Sysbuild to change the default behavior for the image so that
	  NRF_PERIPHCONF_SECTION_KEEP is set unless explicitly configured otherwise.

endmenu # IronSide SE
```

## modules/hal_nordic/nrfs/dvfs_new/Kconfig
```kconfig
#
# Copyright (c) 2024 Nordic Semiconductor ASA
#
# SPDX-License-Identifier: Apache-2.0
#

menu "Local domain DVFS library"

module = LOCAL_DOMAIN_DVFS_NEW_LIB
module-str = Local domain DVFS library
source "subsys/logging/Kconfig.template.log_config"

config NRFS_LOCAL_DOMAIN_DVFS_TEST
	bool "Local domain DVFS test"
	help
	  Disable hw registers interaction for testing.

config NRFS_LOCAL_DOMAIN_DVFS_SCALE_DOWN_AFTER_INIT
	bool "Local domain scale down after init"
	help
	  Request lowest oppoint after DVFS initialization.

config NRFS_LOCAL_DOMAIN_DOWNSCALE_SAFETY_TIMEOUT_US
	int "Voltage downscale procedure safety timeout in us"
	range 1 10000000
	default 1000000 if (NRFS_LOCAL_DOMAIN_DVFS_TEST || LOG)
	default 1500

config NRFS_LOCAL_DOMAIN_DOWNSCALE_FINISH_DELAY_TIMEOUT_US
	int "Additional delay to let secdom finish dowscale procedure in us"
	range 1 10000000
	default 1000
	help
	  This value depends on the secdom core performance and shouldn't be touched by the user.

endmenu
```
