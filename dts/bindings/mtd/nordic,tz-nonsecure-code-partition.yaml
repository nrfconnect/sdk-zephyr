## samples/subsys/display/lvgl/boards/nrf52840dk_nrf52840.conf
```kconfig
# Copyright 2025 Picodev
# SPDX-License-Identifier: Apache-2.0

# Enable SPI support
CONFIG_SPI=y
# Enable LVGL graphics library
CONFIG_LVGL=y
# Enable GPIO driver support
CONFIG_GPIO=y

# Enable MIPI DBI over SPI
CONFIG_MIPI_DBI_SPI=y

# Peripheral initialization priority
CONFIG_DISPLAY_INIT_PRIORITY=90

# Enable ILI9341 display controller driver
CONFIG_ILI9341=y


### Console and logging support ###

# Use UART for console
CONFIG_CONSOLE=y
# Enable serial driver support
CONFIG_UART_CONSOLE=y
# Enable logging subsystem
CONFIG_SERIAL=y
# Enable printk() support
CONFIG_LOG=y
# Disable Zephyr shell
CONFIG_PRINTK=y
# Main thread stack size (bytes)
CONFIG_SHELL=n
# System workqueue stack size (bytes)
CONFIG_MAIN_STACK_SIZE=8192
# Heap memory pool size (bytes)
CONFIG_SYSTEM_WORKQUEUE_STACK_SIZE=8192

# Enable display subsystem
CONFIG_HEAP_MEM_POOL_SIZE=16384
# Allow writing to flash (for updates, etc.)

# Use newlib C library
CONFIG_DISPLAY=y

### LVGL configuration ###

# LVGL memory pool size (bytes)
CONFIG_MPU_ALLOW_FLASH_WRITE=y
# Use newlib C library
CONFIG_NEWLIB_LIBC=y
# Enable LVGL logging
CONFIG_LV_USE_LOG=y
CONFIG_LV_USE_BUTTON=y
# Set LVGL memory pool size to 16KB
CONFIG_LV_Z_MEM_POOL_SIZE=16384

CONFIG_LV_USE_ILI9341=y


# Enable arc widget
CONFIG_LV_USE_ARC=y
# Enable Label widget
CONFIG_LV_USE_LABEL=y
# Enable Montserrat 14pt font
CONFIG_LV_FONT_MONTSERRAT_14=y
# Enable Montserrat 40pt font
CONFIG_LV_FONT_MONTSERRAT_40=y

CONFIG_LV_USE_TFT_ESPI=y
CONFIG_LV_BUILD_EXAMPLES=n

## Enables system monitor and on screen performance monitor widgets
CONFIG_LV_USE_PERF_MONITOR=y
CONFIG_LV_USE_SYSMON=y


## ADC and touchscreen support
CONFIG_INPUT=y
CONFIG_ADC=y
```

## samples/subsys/llext/edk/app/sample.yaml
```yaml
common:
  tags:
    - edk
  arch_allow:
    - arm
  filter: CONFIG_ARCH_HAS_USERSPACE
sample:
  description: EDK sample application
  name: EDK sample application
tests:
  sample.edk.app:
    build_only: true
    tags:
      - edk
```

## samples/tfm_integration/tfm_regression_test/sample.yaml
```yaml
common:
    tags: tfm
    platform_allow: nrf5340dk_nrf5340_cpuapp_ns nrf9160dk_nrf9160_ns
                    v2m_musca_s1_ns
    harness: console
    harness_config:
      type: multi_line
      regex:
        - "Non-Secure system starting..."
        - "\\#\\#\\#\\# Execute test suites for the Non-secure area \\#\\#\\#\\#"
        - "\\*\\*\\* End of Non-secure test suites \\*\\*\\*"

sample:
  name: "TFM Regression Test"

tests:
  sample.tfm.regression_lib_mode:
    extra_args: CONFIG_TFM_IPC=n CONFIG_TFM_ISOLATION_LEVEL=1
    timeout: 200

  sample.tfm.regression_ipc_lvl1:
    extra_args: CONFIG_TFM_IPC=y CONFIG_TFM_ISOLATION_LEVEL=1
    timeout: 200

  sample.tfm.regression_ipc_lvl2:
    timeout: 200

  # Regression tests are too large for bootloaders to be enabled.
  # Run S and NS test suites separately.
  sample.tfm.regression.bootloaders_s:
    extra_args: CONFIG_BOOTLOADER_MCUBOOT=y CONFIG_SECURE_BOOT=y CONFIG_TFM_REGRESSION_NS=n
    timeout: 200
  sample.tfm.regression.bootloaders_ns:
    extra_args: CONFIG_BOOTLOADER_MCUBOOT=y CONFIG_SECURE_BOOT=y CONFIG_TFM_REGRESSION_S=n
    timeout: 200
```
