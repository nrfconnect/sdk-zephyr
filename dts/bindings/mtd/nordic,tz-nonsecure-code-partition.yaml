## modules/mbedtls/Kconfig.psa
```kconfig
#
# Copyright (c) 2022 Nordic Semiconductor
#
# SPDX-License-Identifier: Apache-2.0
#
menu "PSA RNG support"

config PSA_WANT_GENERATE_RANDOM
	bool
	prompt "PSA RNG support"
	default y

config PSA_WANT_ALG_CTR_DRBG
	bool
	prompt "PSA RNG using CTR_DRBG"
	help
	  Provide CTR_DRBG as the random number generator.
	  Note: This configuration is currently not described and has no effect.

config PSA_WANT_ALG_HMAC_DRBG
	bool
	prompt "PSA RNG using HMAC_DRBG"
	help
	  Provide HMAC_DRBG as the random number generator.
	  Note: This configuration is currently not described and has no effect.

endmenu # RNG support

config PSA_HAS_KEY_SUPPORT
	bool
	default y
	depends on PSA_WANT_KEY_TYPE_DERIVE		|| \
		   PSA_WANT_KEY_TYPE_HMAC		|| \
		   PSA_WANT_KEY_TYPE_AES 		|| \
		   PSA_WANT_KEY_TYPE_CHACHA20		|| \
		   PSA_WANT_KEY_TYPE_ECC_KEY_PAIR	|| \
		   PSA_WANT_KEY_TYPE_ECC_PUBLIC_KEY	|| \
		   PSA_WANT_KEY_TYPE_RSA_KEY_PAIR	|| \
		   PSA_WANT_KEY_TYPE_RSA_PUBLIC_KEY

config PSA_WANT_KEY_TYPE_DERIVE
	bool
	default y
	depends on PSA_HAS_KEY_DERIVATION
	help
	  Prompt-less configuration that states that the derived key type is used.

config PSA_WANT_KEY_TYPE_HMAC
	bool
	default y
	depends on PSA_HAS_MAC_SUPPORT
	help
	  Prompt-less configuration that states that the HMAC key type is used.

config PSA_WANT_KEY_TYPE_AES
	bool
	default y
	depends on PSA_HAS_CIPHER_SUPPORT || PSA_HAS_AEAD_SUPPORT
	help
	  Prompt-less configuration that states that AES key type is used.

config PSA_WANT_KEY_TYPE_CHACHA20
	bool
	default y
	depends on PSA_WANT_ALG_CHACHA20_POLY1305
	help
	  Prompt-less configuration that states that CHACHA20 key type is used.

config PSA_WANT_KEY_TYPE_ECC_KEY_PAIR
	bool
	default y
	depends on PSA_HAS_ECC_SUPPORT
	help
	  Prompt-less configuration that states that ECC key pair type is used.

config PSA_WANT_KEY_TYPE_ECC_PUBLIC_KEY
	bool
	default y
	depends on PSA_HAS_ECC_SUPPORT
	help
	  Prompt-less configuration that states that ECC public key type is used.

config PSA_WANT_KEY_TYPE_RSA_KEY_PAIR
	bool
	default y
	depends on PSA_HAS_RSA_SUPPORT
	help
	  Prompt-less configuration that states that RSA key pair type is used.

config PSA_WANT_KEY_TYPE_RSA_PUBLIC_KEY
	bool
	default y
	depends on PSA_HAS_RSA_SUPPORT
	help
	  Prompt-less configuration that states that RSA public key type is used.

menu "PSA AEAD support"

config PSA_HAS_AEAD_SUPPORT
	bool
	default y
	depends on PSA_WANT_ALG_CCM || \
		   PSA_WANT_ALG_GCM || \
		   PSA_WANT_ALG_CHACHA20_POLY1305
	help
	  Prompt-less configuration that states that AEAD is supported.

config PSA_WANT_ALG_CCM
	bool
	prompt "PSA AES CCM support" if !PSA_PROMPTLESS
	default y if !PSA_DEFAULT_OFF

config PSA_WANT_ALG_GCM
	bool
	prompt "PSA AES GCM support" if !PSA_PROMPTLESS
	default y if !PSA_DEFAULT_OFF

config PSA_WANT_ALG_CHACHA20_POLY1305
	bool
	prompt "PSA ChaCha20/Poly1305 support" if !PSA_PROMPTLESS
	default y if !PSA_DEFAULT_OFF

endmenu # PSA AEAD support


menu "PSA MAC support"

config PSA_HAS_MAC_SUPPORT
	bool
	default y
	depends on PSA_WANT_ALG_CBC_MAC	|| \
		   PSA_WANT_ALG_CMAC	|| \
		   PSA_WANT_ALG_HMAC
	help
	  Prompt-less configuration that states that MAC is supported.

config PSA_WANT_ALG_CBC_MAC
	bool
	help
	  CBC-MAC is not yet supported via the PSA API in Mbed TLS.

config PSA_WANT_ALG_CMAC
	bool
	prompt "PSA AES CMAC support" if !PSA_PROMPTLESS
	default y if !PSA_DEFAULT_OFF

config PSA_WANT_ALG_HMAC
	bool
	prompt "PSA HMAC support" if !PSA_PROMPTLESS
	default y if !PSA_DEFAULT_OFF

endmenu # PSA MAC support


menu "PSA Hash support"

config PSA_HAS_HASH_SUPPORT
	bool
	default y
	depends on PSA_WANT_ALG_SHA_1		|| \
		   PSA_WANT_ALG_SHA_224		|| \
		   PSA_WANT_ALG_SHA_256		|| \
		   PSA_WANT_ALG_SHA_384		|| \
		   PSA_WANT_ALG_SHA_512		|| \
		   PSA_WANT_ALG_RIPEMD160	|| \
		   PSA_WANT_ALG_MD5
	help
	  Prompt-less configuration that states that hash is supported.

config PSA_WANT_ALG_SHA_1
	bool
	prompt "PSA SHA1 support" if !PSA_PROMPTLESS
	default y if !PSA_DEFAULT_OFF

config PSA_WANT_ALG_SHA_224
	bool
	prompt "PSA SHA-224 support" if !PSA_PROMPTLESS
	default y if !PSA_DEFAULT_OFF

config PSA_WANT_ALG_SHA_256
	bool
	prompt "PSA SSH-256 support" if !PSA_PROMPTLESS
	default y if !PSA_DEFAULT_OFF

config PSA_WANT_ALG_SHA_384
	bool
	prompt "PSA SHA-384 support" if !PSA_PROMPTLESS
	default y if !PSA_DEFAULT_OFF

config PSA_WANT_ALG_SHA_512
	bool
	prompt "PSA SHA-512 support" if !PSA_PROMPTLESS
	default y if !PSA_DEFAULT_OFF

config PSA_WANT_ALG_RIPEMD160
	bool
	prompt "PSA RIPEMD160 support" if !PSA_PROMPTLESS

config PSA_WANT_ALG_MD5
	bool
	prompt "PSA MD5 support" if !PSA_PROMPTLESS

endmenu # PSA Hash support

menu "PSA Cipher support"

config PSA_HAS_CIPHER_SUPPORT
	bool
	default y
	depends on PSA_WANT_ALG_ECB_NO_PADDING	|| \
		   PSA_WANT_ALG_CBC_NO_PADDING	|| \
		   PSA_WANT_ALG_CBC_PKCS7	|| \
		   PSA_WANT_ALG_CFB 		|| \
		   PSA_WANT_ALG_CTR		|| \
		   PSA_WANT_ALG_OFB		|| \
		   PSA_WANT_ALG_CTR		|| \
		   PSA_WANT_ALG_XTS
	help
	  Prompt-less configuration that states that cipher is supported.

config PSA_WANT_ALG_ECB_NO_PADDING
	bool
	prompt "PSA AES ECB (no padding)" if !PSA_PROMPTLESS
	default y if !PSA_DEFAULT_OFF

config PSA_WANT_ALG_CBC_NO_PADDING
	bool
	prompt "PSA CBC support (without padding)" if !PSA_PROMPTLESS
	default y if !PSA_DEFAULT_OFF

config PSA_WANT_ALG_CBC_PKCS7
	bool
	prompt "PSA CBC support (padded with PKCS#7)" if !PSA_PROMPTLESS
	default y if !PSA_DEFAULT_OFF

config PSA_WANT_ALG_CFB
	bool
	prompt "PSA AES CFB support" if !PSA_PROMPTLESS

config PSA_WANT_ALG_CTR
	bool
	prompt "PSA AES CTR mode support" if !PSA_PROMPTLESS
	default y if !PSA_DEFAULT_OFF

config PSA_WANT_ALG_OFB
	bool
	prompt "PSA AES OFB mode support" if !PSA_PROMPTLESS

config PSA_WANT_ALG_XTS
	bool
	help
	  AES XTS is currently not supported

endmenu # PSA Cipher Support


menu "PSA Key derivation support"

config PSA_HAS_KEY_DERIVATION
	bool
	default y
	depends on PSA_WANT_ALG_HKDF 		|| \
		   PSA_WANT_ALG_PBKDF2_HMAC	|| \
		   PSA_WANT_ALG_TLS12_PRF	|| \
		   PSA_WANT_ALG_TLS12_PSK_TO_MS
	help
	  Prompt-less configuration that states that key derivation is supported.

config PSA_WANT_ALG_HKDF
	bool
	prompt "PSA HKFD support" if !PSA_PROMPTLESS
	default y if !PSA_DEFAULT_OFF
	depends on PSA_WANT_ALG_HMAC

config PSA_WANT_ALG_PBKDF2_HMAC
	bool
	depends on PSA_WANT_ALG_HMAC
	help
	  PBKDF2-HMAC is not yet supported via the PSA APIs in Mbed TLS.

config PSA_WANT_ALG_TLS12_PRF
	bool
	prompt "PSA PRF support (TLS1.2)" if !PSA_PROMPTLESS

config PSA_WANT_ALG_TLS12_PSK_TO_MS
	bool
	prompt "PSA TLS 1.2 PSK to MS support" if !PSA_PROMPTLESS

endmenu # PSA Key derivation support


menu "PSA Asymmetric support"

config PSA_HAS_ASYM_ENCRYPT_SUPPORT
	bool
	default y
	depends on PSA_WANT_ALG_RSA_OAEP || \
			   PSA_WANT_ALG_RSA_PKCS1V15_CRYPT
	help
	  Prompt-less configuration that states that asymmetric encryption
	  is supported.


config PSA_HAS_ASYM_SIGN_SUPPORT
	bool
	default y
	depends on PSA_WANT_ALG_DETERMINISTIC_ECDSA	|| \
		   PSA_WANT_ALG_ECDSA 			|| \
		   PSA_WANT_ALG_RSA_PKCS1V15_SIGN	|| \
		   PSA_WANT_ALG_RSA_PSS

	help
	  Prompt-less configuration that states that asymmetric signing
	  is supported.

config PSA_HAS_ECC_SUPPORT
	bool
	depends on PSA_WANT_ALG_ECDH || PSA_WANT_ALG_ECDSA || PSA_WANT_ALG_DETERMINISTIC_ECDSA
	default y
	help
	  Prompt-less configuration that states that ECC is supported.

config PSA_WANT_ALG_ECDH
	bool
	prompt "PSA ECDH support" if !PSA_PROMPTLESS
	default y if !PSA_DEFAULT_OFF

config PSA_WANT_ALG_ECDSA
	bool
	prompt "PSA ECDSA support" if !PSA_PROMPTLESS
	default y if !PSA_DEFAULT_OFF

config PSA_WANT_ALG_DETERMINISTIC_ECDSA
	bool
	prompt "PSA ECDSA support (deterministic mode)" if !PSA_PROMPTLESS
	default y if !PSA_DEFAULT_OFF

menu "Elliptic Curve type support"
	depends on PSA_HAS_ECC_SUPPORT

config PSA_WANT_ECC_BRAINPOOL_P_R1_256
	bool
	prompt "PSA ECC Brainpool256r1 support"

config PSA_WANT_ECC_BRAINPOOL_P_R1_384
	bool "PSA ECC Brainpool384r1 support"

config PSA_WANT_ECC_BRAINPOOL_P_R1_512
	bool "PSA ECC Brainpool512r1 support"

config PSA_WANT_ECC_MONTGOMERY_255
	bool "PSA ECC Curve X25519 support"

config PSA_WANT_ECC_MONTGOMERY_448
	bool "PSA ECC Curve X448 support"

config PSA_WANT_ECC_TWISTED_EDWARDS_255
	bool "PSA ECC Curve Ed25519 support"

config PSA_WANT_ECC_SECP_K1_192
	bool "PSA ECC secp192k1 support"

config PSA_WANT_ECC_SECP_K1_224
	bool
	help
	  SECP224K1 is buggy via the PSA API in Mbed TLS
	  See https://github.com/ARMmbed/mbedtls/issues/3541

config PSA_WANT_ECC_SECP_K1_256
	bool
	prompt "PSA ECC secp256k1 support" if !PSA_PROMPTLESS

config PSA_WANT_ECC_SECP_R1_192
	bool
	prompt "PSA ECC secp192r1" if !PSA_PROMPTLESS

config PSA_WANT_ECC_SECP_R1_224
	bool
	prompt "PSA ECC secp224r1" if !PSA_PROMPTLESS

config PSA_WANT_ECC_SECP_R1_256
	bool
	prompt "PSA ECC secp256r1" if !PSA_PROMPTLESS
	default y if !PSA_DEFAULT_OFF

config PSA_WANT_ECC_SECP_R1_384
	bool
	prompt "PSA ECC secp384r1" if !PSA_PROMPTLESS

config PSA_WANT_ECC_SECP_R1_521
	bool
	prompt "PSA ECC secp521r1" if !PSA_PROMPTLESS

endmenu # Elliptic Curve type support

config PSA_HAS_RSA_SUPPORT
	bool
	depends on PSA_WANT_ALG_RSA_OAEP 		|| \
		   PSA_WANT_ALG_RSA_PKCS1V15_CRYPT 	|| \
		   PSA_WANT_ALG_RSA_PKCS1V15_SIGN 	|| \
		   PSA_WANT_ALG_RSA_PSS
	default y
	help
	  Prompt-less configuration that states that RSA is supported.

config PSA_WANT_ALG_RSA_OAEP
	bool
	prompt "PSA RSA OAEP support" if !PSA_PROMPTLESS

config PSA_WANT_ALG_RSA_PKCS1V15_CRYPT
	bool
	prompt "PSA RSA crypt support (PKCS1V15 mode)" if !PSA_PROMPTLESS

config PSA_WANT_ALG_RSA_PKCS1V15_SIGN
	bool
	prompt "PSA RSA signature support (PKCS1V15 mode)" if !PSA_PROMPTLESS

config PSA_WANT_ALG_RSA_PSS
	bool
	prompt "PSA RSA (PSS mode)" if !PSA_PROMPTLESS

endmenu # PSA Asymmetric support

config PSA_WANT_ALG_STREAM_CIPHER
	bool
	prompt "PSA stream cipher support" if !PSA_PROMPTLESS
	default y if !PSA_DEFAULT_OFF
```

## samples/basic/blinky/sample.yaml
```yaml
sample:
  name: Blinky Sample
tests:
  sample.basic.blinky:
    tags:
      - LED
      - gpio
    filter: dt_enabled_alias_with_parent_compat("led0", "gpio-leds")
    depends_on: gpio
    harness: led
    integration_platforms:
      - frdm_k64f

  sample.basic.blinky.egpio_icmsg:
    tags:
      - LED
      - gpio
    filter: dt_enabled_alias_with_parent_compat("led0", "gpio-leds")
    depends_on: gpio
    integration_platforms:
      - nrf54l15pdk/nrf54l15/cpuapp
    sysbuild: true
    harness: console
    harness_config:
      type: multi_line
      ordered: true
      regex:
        - "LED state: ON"
        - "LED state: OFF"
    extra_args:
      blinky_SNIPPET=emulated-gpio-icmsg
    extra_configs:
      SB_CONFIG_SW_IO_DEVICES=y
      SB_CONFIG_EGPIO_FLPR_APPLICATION=y

  sample.basic.blinky.egpio_mbox:
    tags:
      - LED
      - gpio
    filter: dt_enabled_alias_with_parent_compat("led0", "gpio-leds")
    depends_on: gpio
    integration_platforms:
      - nrf54l15pdk/nrf54l15/cpuapp
    sysbuild: true
    harness: console
    harness_config:
      type: multi_line
      ordered: true
      regex:
        - "LED state: ON"
        - "LED state: OFF"
    extra_args:
      blinky_SNIPPET=emulated-gpio-mbox
    extra_configs:
      SB_CONFIG_SW_IO_DEVICES=y
      SB_CONFIG_EGPIO_FLPR_APPLICATION=y
```

## samples/basic/multicore_hello_world/sample.yaml
```yaml
sample:
  name: Multicore Hello World
  description: |
    Hello World application that builds remote core from sources. Both cores
    print board name they were run on.

common:
  build_only: true
  sysbuild: true

tests:
  sample.basic.multicore_hello_world.nrf5340dk_cpuapp_cpunet:
    platform_allow:
      - nrf5340dk_nrf5340_cpuapp
    integration_platforms:
      - nrf5340dk_nrf5340_cpuapp
    extra_args:
      SB_CONF_FILE=sysbuild/nrf5340dk_nrf5340_cpunet.conf

  sample.basic.multicore_hello_world.nrf54h20pdk_cpuapp_cpurad:
    platform_allow:
      - nrf54h20pdk_nrf54h20_cpuapp
    integration_platforms:
      - nrf54h20pdk_nrf54h20_cpuapp
    extra_args:
      SB_CONF_FILE=sysbuild/nrf54h20pdk_nrf54h20_cpurad.conf

  sample.basic.multicore_hello_world.nrf54h20pdk_cpuapp_cpuppr:
    platform_allow:
      - nrf54h20pdk_nrf54h20_cpuapp
    integration_platforms:
      - nrf54h20pdk_nrf54h20_cpuapp
    extra_args:
      SB_CONF_FILE=sysbuild/nrf54h20pdk_nrf54h20_cpuppr.conf
      multicore_hello_world_SNIPPET=nordic-ppr

  sample.basic.multicore_hello_world.nrf54h20pdk_cpuapp_cpuppr_ram:
    platform_allow:
      - nrf54h20pdk_nrf54h20_cpuapp
    integration_platforms:
      - nrf54h20pdk_nrf54h20_cpuapp
    extra_args:
      SB_CONF_FILE=sysbuild/nrf54h20pdk_nrf54h20_cpuppr.conf
      multicore_hello_world_SNIPPET=nordic-ppr-ram
      remote_OVERLAY_CONFIG=boards/nrf54h20pdk_nrf54h20_cpuppr_ram.conf
```

## samples/bluetooth/iso_central/sample.yaml
```yaml
sample:
  description: Bluetooth ISO central (client) sample
  name: Bluetooth ISO central (client) sample
tests:
  sample.bluetooth.iso_central:
    harness: bluetooth
    platform_allow:
      - qemu_x86
      - nrf5340dk/nrf5340/cpuapp
    integration_platforms:
      - qemu_x86
      - nrf5340dk/nrf5340/cpuapp
    tags: bluetooth
    sysbuild: true
  sample.bluetooth.iso_central.bt_ll_sw_split:
    harness: bluetooth
    platform_allow:
      - nrf52_bsim
      - nrf52833dk/nrf52833
    integration_platforms:
      - nrf52833dk/nrf52833
    extra_args:
      - OVERLAY_CONFIG=overlay-bt_ll_sw_split.conf
      - SNIPPET="bt-ll-sw-split"
    tags: bluetooth
```

## samples/bluetooth/peripheral_hr/boards/nrf9160dk_nrf9160.conf
```kconfig
CONFIG_BT_WAIT_NOP=y

CONFIG_UART_2_ASYNC=y
CONFIG_UART_2_INTERRUPT_DRIVEN=n
CONFIG_UART_2_NRF_HW_ASYNC=y
CONFIG_UART_2_NRF_HW_ASYNC_TIMER=2
CONFIG_NRFX_TIMER2=y
CONFIG_NRF_SW_LPUART=y
CONFIG_NRF_SW_LPUART_INT_DRIVEN=y
```

## samples/bluetooth/scanner/sample.yaml
```yaml
sample:
  description: TBD
  name: TBD
tests:
  sample.bluetooth.scanner:
    harness: bluetooth
    platform_allow: qemu_cortex_m3 qemu_x86
    tags: bluetooth
```

## samples/boards/nordic/coproc_launcher/boards/nrf54h20dk_nrf54h20_cpuapp.conf
```kconfig
# Copyright (c) 2026 Nordic Semiconductor ASA
# SPDX-License-Identifier: Apache-2.0

CONFIG_GPIO=n
CONFIG_SERIAL=n
CONFIG_CONSOLE=n
CONFIG_UART_CONSOLE=n
```

## samples/drivers/adc/adc_sequence/sample.yaml
```yaml
sample:
  name: ADC driver sequence sample
tests:
  sample.drivers.adc.adc_sequence:
    tags:
      - adc
    depends_on: adc
    platform_allow:
      - cy8cproto_063_ble
      - cy8cproto_062_4343w
      - nrf54l15pdk_nrf54l15_cpuapp
    integration_platforms:
      - nrf52840dk_nrf52840
    harness: console
    timeout: 10
    harness_config:
      type: multi_line
      regex:
        - "ADC sequence reading\\[\\d+\\]:"
        - "- .+, channel \\d+, \\d+ sequence samples:"
        - "- - \\d+ (= \\d+mV)|(\\(value in mV not available\\))"
```

## samples/drivers/spi_flash/boards/nrf9160dk_nrf9160.conf
```kconfig
#
# Copyright (c) 2020 Nordic Semiconductor ASA
#
# SPDX-License-Identifier: Apache-2.0
#

CONFIG_SPI_NOR=y
```

## samples/mcuboot/sample.yaml
```yaml
sample:
  name: mcuboot
tests:
  boards.mcuboot:
    tags: mcuboot
    # All platforms supported by MCUBoot out-of-the-box are
    # supported. nRF52 is known to be supported.
    platform_whitelist: nrf52840_pca10056 nrf52_pca10040
    harness: console
    harness_config:
      type: one_line
      regex:
        - "Hello World! (.*)"
```

## samples/net/sockets/echo_client/Kconfig.sysbuild
```kconfig
#
# Copyright (c) 2024 Nordic Semiconductor ASA
#
# SPDX-License-Identifier: Apache-2.0
#

config WIFI_NRF70
	default y if BOARD_NRF7002DK_NRF5340_CPUAPP || \
		     BOARD_NRF7002DK_NRF5340_CPUAPP_NS

source "${ZEPHYR_BASE}/share/sysbuild/Kconfig"
```
