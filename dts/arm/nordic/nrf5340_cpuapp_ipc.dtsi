/*
 * Copyright (c) 2022 Nordic Semiconductor ASA
 *
 * SPDX-License-Identifier: Apache-2.0
 */

ipc0: ipc0 {
	compatible = "zephyr,ipc-icmsg-me-initiator";
	tx-region = <&sram0_shared_to_net>;
	rx-region = <&sram0_shared_to_app>;
	mboxes = <&mbox 0>, <&mbox 1>;
	mbox-names = "tx", "rx";
	status = "okay";
};
