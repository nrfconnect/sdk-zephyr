## soc/arm/nordic_nrf/nrf54h/Kconfig.soc
```kconfig
# Nordic Semiconductor nRF54H MCU line

# Copyright (c) 2024 Nordic Semiconductor ASA
# SPDX-License-Identifier: Apache-2.0

config SOC_NRF54H20
	bool "nRF54H20"
	depends on SOC_SERIES_NRF54HX

if SOC_NRF54H20

config SOC_NRF54H20_CPUAPP
	bool "nRF54H20 CPUAPP"
	select CPU_HAS_ARM_MPU
	select CPU_HAS_ARM_SAU
	select CPU_HAS_DCACHE
	select CPU_HAS_ICACHE
	select CPU_HAS_FPU
	select HAS_SEGGER_RTT if ZEPHYR_SEGGER_MODULE
	select NRFS_HAS_CLOCK_SERVICE
	select NRFS_HAS_DVFS_SERVICE
	select NRFS_HAS_MRAM_SERVICE
	select NRFS_HAS_TEMP_SERVICE
	select NRFS_HAS_VBUS_DETECTOR_SERVICE

config SOC_NRF54H20_CPURAD
	bool "nRF54H20 CPURAD"
	select CPU_HAS_ARM_MPU
	select CPU_HAS_ARM_SAU
	select CPU_HAS_DCACHE
	select CPU_HAS_ICACHE
	select CPU_HAS_FPU
	select HAS_SEGGER_RTT if ZEPHYR_SEGGER_MODULE
	select NRFS_HAS_CLOCK_SERVICE
	select NRFS_HAS_MRAM_SERVICE
	select NRFS_HAS_TEMP_SERVICE

config NRF_ENABLE_ICACHE
	bool "Instruction cache (I-Cache)"
	default y

endif # SOC_NRF54H20
```

## soc/nordic/Kconfig.sysbuild
```kconfig
# Copyright (c) 2024 Nordic Semiconductor ASA
# SPDX-License-Identifier: Apache-2.0

config HAS_NORDIC_VPR_LAUNCHER_IMAGE
	bool

config HAS_NORDIC_COPROC_LAUNCHER_IMAGE
	bool

config NORDIC_COPROC_LAUNCHER
	bool "Nordic coprocessor launcher"
	default y
	depends on HAS_NORDIC_COPROC_LAUNCHER_IMAGE

config HAS_NORDIC_LOG_STM
	bool

choice NORDIC_LOG_STM_MODE
	prompt "Nordic logging to coresigt STM mode"
	default NORDIC_LOG_STM_DISABLED
	depends on HAS_NORDIC_LOG_STM

config NORDIC_LOG_STM_DISABLED
	bool "Nordic logging to coresigt STM disabled"

config NORDIC_LOG_STM
	bool "Nordic logging to coresigt STM, output via UART"

config NORDIC_LOG_STM_DICT
	bool "Nordic dict-based logging to coresigt STM, output via UART"

config NORDIC_LOG_STM_TPIU_DICT
	bool "Nordic dict-based logging to coresigt STM, output via TPIU"

endchoice # NORDIC_LOG_STM_MODE

rsource "common/uicr/Kconfig.sysbuild"
rsource "common/vpr/Kconfig.sysbuild"
orsource "*/Kconfig.sysbuild"
```

## soc/nordic/common/uicr/Kconfig
```kconfig
# Copyright (c) 2025 Nordic Semiconductor ASA
# SPDX-License-Identifier: Apache-2.0

config NRF_HALTIUM_GENERATE_UICR
	bool "Generate UICR file"
	depends on SOC_NRF54H20_CPUAPP
	default y
	help
	  Generate UICR HEX file.

if NRF_HALTIUM_GENERATE_UICR

config NRF_HALTIUM_UICR_PERIPHCONF
	bool "Initialize global domain peripherals"
	default y
	help
	  Generates a blob containing static global domain peripheral initialization
	  values extracted from the build artifacts, and configures UICR.PERIPHCONF
	  to point at the blob. The initialization values are then loaded ahead of
	  ahead of the application boot.

config NRF_HALTIUM_UICR_RECOVERY
	bool "Configure UICR RECOVERY field"
	help
	  Configure the UICR RECOVERY field to enable recovery firmware boot.
	  This should be enabled by the main application to configure recovery
	  firmware parameters. The recovery firmware itself does not need to
	  enable this option.

if NRF_HALTIUM_UICR_RECOVERY

choice NRF_HALTIUM_UICR_RECOVERY_PROCESSOR
	prompt "Recovery processor core"
	default NRF_HALTIUM_UICR_RECOVERY_PROCESSOR_APPLICATION
	help
	  Select the processor core for recovery firmware.

config NRF_HALTIUM_UICR_RECOVERY_PROCESSOR_APPLICATION
	bool "APPLICATION (cpuapp)"
	help
	  Boot the APPLICATION processor core for recovery firmware.

config NRF_HALTIUM_UICR_RECOVERY_PROCESSOR_RADIOCORE
	bool "RADIOCORE (cpurad)"
	help
	  Boot the RADIOCORE processor core for recovery firmware.

endchoice

config NRF_HALTIUM_UICR_RECOVERY_INITSVTOR
	hex "Recovery firmware INITSVTOR address"
	help
	  Initial value of the secure VTOR (Vector Table Offset Register)
	  for recovery firmware. This should match the recovery firmware's
	  memory partition address.

config NRF_HALTIUM_UICR_RECOVERY_SIZE4KB
	int "Recovery firmware size in 4KB blocks"
	range 1 1024
	help
	  Size of the recovery firmware partition in 4KB blocks.

config NRF_HALTIUM_UICR_RECOVERY_PERIPHCONF
	bool "Recovery firmware global domain peripheral configuration"
	help
	  Generates a blob containing static global domain peripheral initialization
	  values extracted from recovery firmware build artifacts, and configures
	  UICR.RECOVERY.PERIPHCONF to point at the blob. The initialization values
	  are then loaded ahead of the recovery firmware boot.

endif # NRF_HALTIUM_UICR_RECOVERY

endif

config NRF_PERIPHCONF_SECTION
	bool "Populate global peripheral initialization section"
	default y if SOC_NRF54H20_CPUAPP
	depends on LINKER_DEVNULL_SUPPORT
	imply LINKER_DEVNULL_MEMORY
	help
	  Include static global domain peripheral initialization values from the
	  build in a dedicated section in the devnull region.
```

## soc/nordic/common/uicr/gen_uicr/Kconfig
```kconfig
# SPDX-License-Identifier: Apache-2.0

source "Kconfig.zephyr"

menu "UICR generator options"

config UICR_SAMPLE_GENERATE_PERIPHCONF
	bool "Generate PERIPHCONF hex alongside UICR"
	default y
	help
	  When enabled, the UICR generator will emit periphconf.hex in addition to uicr.hex.

endmenu
```

## soc/nordic/nrf54h/Kconfig.defconfig.nrf54h20_cpurad
```kconfig
# Nordic Semiconductor nRF54H20 Radio MCU

# Copyright (c) 2024 Nordic Semiconductor ASA
# SPDX-License-Identifier: Apache-2.0

if SOC_NRF54H20_CPURAD

config NUM_IRQS
	default 471

config PM
	default y

config POWER_DOMAIN
	default y

config CODE_DATA_RELOCATION
	default y if PM || POWEROFF

# Support for firmware relocation pattern (load from MRAM, run from TCM)
# If 'fw-to-relocate' chosen node exists, use it to calculate LMA adjustment
# Otherwise, fall back to standard code-partition calculation
DT_CHOSEN_FW_TO_RELOCATE = fw-to-relocate
DT_CHOSEN_Z_CODE = zephyr,code-partition
DT_CHOSEN_Z_SRAM = zephyr,sram

config BUILD_OUTPUT_ADJUST_LMA
	default "$(dt_chosen_partition_addr_hex,$(DT_CHOSEN_FW_TO_RELOCATE)) - \
		 $(dt_chosen_reg_addr_hex,$(DT_CHOSEN_Z_CODE))" \
		if "$(dt_chosen_enabled,$(DT_CHOSEN_FW_TO_RELOCATE))" = "y"
	help
	  Automatically calculate LMA adjustment for firmware relocation.
	  If 'fw-to-relocate' chosen node exists, the firmware will be loaded
	  from the MRAM partition it points to, but will run from the TCM region
	  specified by 'zephyr,code-partition'.
	  Otherwise, uses standard calculation: 'code-partition' - 'sram'.

endif # SOC_NRF54H20_CPURAD
```

## soc/nordic/nrf54h/ironside_boot_report/Kconfig
```kconfig
# Copyright (c) 2025 Nordic Semiconductor
# SPDX-License-Identifier: Apache-2.0

config SOC_NRF54H20_IRONSIDE_BOOT_REPORT
	bool "Nordic IRONside SE boot report"
	default y if SOC_NRF54H20_CPUAPP
	depends on SOC_NRF54H20_IRON
	help
	  This option enables parsing of the Boot Report populated by Nordic IRONside SE.

config SOC_NRF54H_IRONSIDE_BOOT_REPORT_MAGIC
	hex
	default 0xe176928d
	help
	  Constant used to check if an Nordic IRONside SE boot report has been written.
```

## soc/nordic/nrf54h/ironside_se/Kconfig
```kconfig
# Copyright (c) 2025 Nordic Semiconductor
# SPDX-License-Identifier: Apache-2.0

config SOC_NRF54H20_IRONSIDE_SE_BOOT_REPORT
	bool "Nordic IRONside SE boot report"
	default y if SOC_NRF54H20_CPUAPP
	depends on SOC_NRF54H20_IRON
	help
	  This option enables parsing of the Boot Report populated by Nordic IRONside SE.

config SOC_NRF54H20_IRONSIDE_SE_BOOT_REPORT_MAGIC
	hex
	default 0x4d69546f
	help
	  Constant used to check if an Nordic IRONside SE boot report has been written.

config SOC_NRF54H20_IRONSIDE_SE_BOOT_REPORT_LOCAL_DOMAIN_CONTEXT_SIZE
	int
	default 16
	help
	  Size of the local domain context in bytes

config SOC_NRF54H20_IRONSIDE_SE_BOOT_REPORT_RANDOM_DATA_SIZE
	int
	default 32
	help
	  Size of the random data in bytes
```

## soc/nordic/nrf92/ironside/se/Kconfig
```kconfig
# Copyright (c) 2025 Nordic Semiconductor
# SPDX-License-Identifier: Apache-2.0

config SOC_SERIES_NRF92X_IRONSIDE_SE_BOOT_REPORT
	bool "Nordic IRONside SE boot report"
	default y if SOC_NRF9280_CPUAPP
	depends on SOC_NRF9280_IRON
	help
	  This option enables parsing of the Boot Report populated by Nordic IRONside SE.

config SOC_SERIES_NRF92X_IRONSIDE_SE_BOOT_REPORT_MAGIC
	hex
	default 0x4d69546f
	help
	  Constant used to check if an Nordic IRONside SE boot report has been written.
```

## subsys/bluetooth/crypto/Kconfig
```kconfig
# Copyright (c) 2022 Nordic Semiconductor ASA
# SPDX-License-Identifier: Apache-2.0

config BT_CRYPTO
	bool
	depends on WOLFSSL || TINYCRYPT
	select TINYCRYPT_AES if TINYCRYPT
	select TINYCRYPT_AES_CMAC if TINYCRYPT
	help
	  This option enables the Bluetooth Cryptographic Toolbox.
```

## subsys/bootloader/Kconfig
```kconfig
#
# Copyright (c) 2018 Nordic Semiconductor ASA
#
# SPDX-License-Identifier: Apache-2.0
#

config SECURE_BOOT 
	bool "Secure Boot Support"
if SECURE_BOOT
config SECURE_BOOT_SYSTEM_INIT
	bool "Add system intialization code to bootloader"
	select SYSTEM_INIT
endif 
##endmenu
```

## subsys/ipc/Kconfig
```kconfig
# Copyright (c) 2020-2021 Nordic Semiconductor (ASA)
# SPDX-License-Identifier: Apache-2.0

# Workaround for not being able to have commas in macro arguments
DT_CHOSEN_Z_IPC_SHM := zephyr,ipc_shm
DT_CHOSEN_Z_IPC := zephyr,ipc
DT_CHOSEN_Z_IPC_TX := zephyr,ipc_tx
DT_CHOSEN_Z_IPC_RX := zephyr,ipc_rx

config IPC_SERVICE_SINGLE_DEV_SUPPORT
	bool
	default $(dt_chosen_enabled,$(DT_CHOSEN_Z_IPC))

config IPC_SERVICE_DUAL_DEV_SUPPORT
	bool
	default $(dt_chosen_enabled,$(DT_CHOSEN_Z_IPC_TX)) && \
		$(dt_chosen_enabled,$(DT_CHOSEN_Z_IPC_RX))

menuconfig IPC_SERVICE
	bool "IPC service for multiple users"
	select IPM
	select OPENAMP
	help
	  Enables support for a service that can be shared by multiple
	  users to establish an IPC endpoints for given channel.

if IPC_SERVICE

config IPC_SERVICE_SHM_BASE_ADDRESS
	hex
	default "$(dt_chosen_reg_addr_hex,$(DT_CHOSEN_Z_IPC_SHM))"
	help
	  This option specifies base address of the memory region to
	  be used for the OpenAMP IPC shared memory

config IPC_SERVICE_SHM_SIZE
	hex
	default "$(dt_chosen_reg_size_hex,$(DT_CHOSEN_Z_IPC_SHM))"
	help
	  This option specifies size of the memory region to be used
	  for the OpenAMP IPC shared memory

if IPC_SERVICE_SINGLE_DEV_SUPPORT

config IPC_SERVICE_DEV_NAME
	string
	default "$(dt_chosen_label,$(DT_CHOSEN_Z_IPC))"
	help
	  This option specifies the device name for the IPC device to be used

endif # IPC_SERVICE_SINGLE_DEV_SUPPORT

if IPC_SERVICE_DUAL_DEV_SUPPORT

config IPC_SERVICE_TX_DEV_NAME
	string
	default "$(dt_chosen_label,$(DT_CHOSEN_Z_IPC_TX))"
	help
	  This option specifies the device name for the IPC device to be used

config IPC_SERVICE_RX_DEV_NAME
	string
	default "$(dt_chosen_label,$(DT_CHOSEN_Z_IPC_RX))"
	help
	  This option specifies the device name for the IPC device to be used

endif # IPC_SERVICE_DUAL_DEV_SUPPORT

choice IPC_SERVICE_MODE
	prompt "IPC Service mode"

config IPC_SERVICE_MODE_MASTER
	bool "IPC master"
	select OPENAMP_MASTER

config IPC_SERVICE_MODE_REMOTE
	bool "IPC remote"
	select OPENAMP_SLAVE

endchoice

config IPC_SERVICE_NUM_ENDPOINTS
	int "Max number of registered endpoints"
	default 2
	help
	  Maximal number of endpoints that can be registered for given
	  IPC service.

config IPC_SERVICE_INIT_PRIORITY
	int "Initialization priority of IPC service"
	default 48
	help
	  The order of IPC Service initialization and endpoints registration
	  is important to avoid race conditions in IPC endpoints handshake.

	  If in doubt, do not modify this value.

config IPC_SERVICE_EP_REG_PRIORITY
	int "Initialization priority of modules registering IPC endpoints"
	default 47
	help
	  The endpoints must be registered before IPC Service is initialized.

	  If in doubt, do not modify this value.

endif # IPC_SERVICE
```

## subsys/lorawan/Kconfig
```kconfig
# LoRaWAN configuration options

# Copyright (c) 2020 Manivannan Sadhasivam <mani@kernel.org>
# SPDX-License-Identifier: Apache-2.0

menuconfig LORAWAN
	bool "LoRaWAN support [EXPERIMENTAL]"
	depends on LORA
	select HAS_SEMTECH_LORAMAC
	help
	  This option enables LoRaWAN support.

if LORAWAN

module = LORAWAN
module-str = lorawan
source "subsys/logging/Kconfig.template.log_config"

config LORAWAN_SYSTEM_MAX_RX_ERROR
	int "LoRaWAN System Max Rx Error"
	default 20
	help
	  System Max Rx timing error value in ms to be used by LoRaWAN stack
	  for calculating the RX1/RX2 window timing.

choice LORAMAC_REGION
	prompt "LoRaWAN Region Selection"
	default LORAMAC_REGION_UNKNOWN
	help
	  Select the LoRaWAN region.

config LORAMAC_REGION_UNKNOWN
	bool "Unknown region"

config LORAMAC_REGION_AS923
	bool "Asia 923MHz Frequency band"

config LORAMAC_REGION_AU915
	bool "Australia 915MHz Frequency band"

config LORAMAC_REGION_CN470
	bool "China 470MHz Frequency band"

config LORAMAC_REGION_CN779
	bool "China 779MHz Frequency band"

config LORAMAC_REGION_EU433
	bool "Europe 433MHz Frequency band"

config LORAMAC_REGION_EU868
	bool "Europe 868MHz Frequency band"

config LORAMAC_REGION_KR920
	bool "South Korea 920MHz Frequency band"

config LORAMAC_REGION_IN865
	bool "India 865MHz Frequency band"

config LORAMAC_REGION_US915
	bool "North America 915MHz Frequency band"

config LORAMAC_REGION_RU864
	bool "Russia 864MHz Frequency band"

endchoice

choice LORAWAN_NVM
	bool "LoRaWAN NVM backend"
	default LORAWAN_NVM_SETTINGS if SETTINGS
	default LORAWAN_NVM_NONE

config LORAWAN_NVM_NONE
	bool "No NVM backend for LoRaWAN"
	help
	  This configuration should only be used during testing as all
	  the join request using OTAA will fail because of anti-replay
	  protection

config LORAWAN_NVM_SETTINGS
	bool "Settings based NVM"
	depends on SETTINGS

endchoice

config LORAWAN_SE_HAS_OWN_NVM
	bool

choice LORAWAN_SE
	bool "LoRaWAN Secure element backend"
	default LORAWAN_SE_SOFT

config LORAWAN_SE_SOFT
	bool "Software secure element backend"

config LORAWAN_SE_NRFX
	bool "nRFx series Key management secure element backend"
	select MBEDTLS
	select NORDIC_SECURITY_BACKEND
	select CC3XX_BACKEND
	select HWINFO
	select MPU_ALLOW_FLASH_WRITE
	select HW_UNIQUE_KEY
	select HW_UNIQUE_KEY_RANDOM
	select SETTINGS
	help
	  This option also links mbedTLS to manage all the
	  cryptographic operations, as well as Nordic specific
	  CC3xx hardware accelerated crypto

endchoice

if LORAWAN_SE_NRFX

config LORAWAN_SE_NRFX_GENERATE_DEVEUI
	bool "Generate devEUI using nRFx unique identifier"
	default y
	help
	  The devEUI will be generated using the unique
	  identifier found in the FICR registers
	  If this option is enabled, the devEUI shall never be
	  updated.

endif # LORAWAN_SE_NRFX

endif # LORAWAN
```

## subsys/net/pkt_filter/Kconfig
```kconfig
# Packet filtering config
# Copyright (c) 2021 BayLibre SAS
# SPDX-License-Identifier: Apache-2.0

menu "Network Packet Filtering"

config NET_PKT_FILTER
	bool "Network packet filtering"
	help
	  The Network Packet Filtering facility provides the infrastructure
	  to construct custom rules for accepting and/or denying packet
	  transmission and reception.

if NET_PKT_FILTER
module = NET_PKT_FILTER
module-dep = NET_LOG
module-str = Log level for packet filtering
module-help = Enables packet filter output debug messages
source "subsys/net/Kconfig.template.log_config.net"
endif # NET_PKT_FILTER

config NET_FILTER
	bool "Network filter based on hooks"
	help
	  The network filter allows place hook(s) in different places in stack
	  and register bunch of hook functions. Thanks of that network packets
	  can be filtered or modified.

if NET_FILTER
module = NET_FILTER
module-dep = NET_LOG
module-str = Log level for network trafic filtering
module-help = Enables network filter output debug messages
source "subsys/net/Kconfig.template.log_config.net"
endif # NET_FILTER

endmenu
```
