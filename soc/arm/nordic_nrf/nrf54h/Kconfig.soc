## subsys/trusted_storage/Kconfig
```kconfig
# Trusted storage subsystem configuration options

# Copyright (c) 2023 Nordic Semiconductor ASA
# SPDX-License-Identifier: Apache-2.0

menuconfig PSA_TRUSTED_STORAGE
	bool "Trusted Storage"
	depends on !BUILD_WITH_TFM
	help
	  The trusted storage subsystem allows its users to store in a trusted
	  way data ensuring data integrity and confidentially by using AEAD
	  algorithms. It supports several trusted implementation back-ends to
	  provide various levels of trust depending on the device security
	  features.

if PSA_TRUSTED_STORAGE
module = PSA_TRUSTED_STORAGE
module-str = trusted_storage
source "subsys/logging/Kconfig.template.log_config"


menuconfig PROTECTED_STORAGE
	bool "Protected Storage"
	depends on PSA_TRUSTED_STORAGE
	help
	  The Protected Storage is designed to store in a trusted
	  way device intimate data and protects against physical attacks.
	  It supports several storage back-ends and several trusted
	  implementation back-ends to provide various levels of trust.

if PROTECTED_STORAGE

config PROTECTED_STORAGE_PREFIX
	string "Protected Storage object prefix"
	depends on PROTECTED_STORAGE
	default "ps/"
	help
	  This defines the prefix for Protected Storage object names.

endif # PROTECTED_STORAGE

menuconfig INTERNAL_TRUSTED_STORAGE
	bool "Internal Trusted Storage"
	depends on PSA_TRUSTED_STORAGE
	default y
	help
	  The Internal Trusted Storage is designed to store assets that must
	  be placed inside internal flash. Some examples of assets that require
	  this are replay protection values for external storage and keys for
	  use by components of the PSA Root of Trust.

if INTERNAL_TRUSTED_STORAGE

config INTERNAL_TRUSTED_STORAGE_PREFIX
	string "Internal Trusted Storage object prefix"
	depends on INTERNAL_TRUSTED_STORAGE
	default "its/"
	help
	  This defines the prefix for Internal Trusted Storage object names.

endif # INTERNAL_TRUSTED_STORAGE

choice PROTECTED_STORAGE_TRUSTED_BACKEND
	prompt "Trust backend"
	depends on PSA_TRUSTED_STORAGE
	default TRUSTED_STORAGE_TRUSTED_AEAD_BACKEND
	help
	  The backend that handles encryption, authentication or other means of
	  trust validation of the stored assets.

menuconfig TRUSTED_STORAGE_TRUSTED_AEAD_BACKEND
	bool "Use AEAD scheme"
	help
	  Use an AEAD scheme to encrypt the asset data and authenticate its
	  data including the meta data.

if TRUSTED_STORAGE_TRUSTED_AEAD_BACKEND

config TRUSTED_STORAGE_TRUSTED_AEAD_BACKEND_MAX_DATA_SIZE
	int "AEAD backend maximum storage size"
	depends on TRUSTED_STORAGE_TRUSTED_AEAD_BACKEND
	default 256
	help
	  This defines the maximum data size that can be stored.

choice TRUSTED_STORAGE_TRUSTED_AEAD_CRYPTO_BACKEND
	prompt "AEAD crypto backend"
	depends on TRUSTED_STORAGE_TRUSTED_AEAD_BACKEND
	default TRUSTED_STORAGE_TRUSTED_AEAD_BACKEND_CRYPTO_PSA_CHACHAPOLY
	help
	  Decides which implementation to be used to perform the AEAD crypto
	  operations.

config TRUSTED_STORAGE_TRUSTED_AEAD_BACKEND_CRYPTO_PSA_CHACHAPOLY
	prompt "PSA ChaChaPoly"
	select PSA_WANT_ALG_CHACHA20_POLY1305
	help
	  Use PSA Crypto API's with the ChaChaPoly-1305 AEAD algorithm.

config TRUSTED_STORAGE_TRUSTED_AEAD_BACKEND_CRYPTO_MBEDTLS_CHACHAPOLY
	bool "MbedTLS ChaChaPoly"
	select MBEDTLS_CHACHA20_C
	select MBEDTLS_POLY1305_C
	select MBEDTLS_CHACHAPOLY_C
	select MBEDTLS_LEGACY_CRYPTO_C
	help
	  Use MbedTLS ChaChaPoly-1305 AEAD based backend implementation.

config TRUSTED_STORAGE_TRUSTED_AEAD_BACKEND_CRYPT_CUSTOM
	bool "Custom"
	help
	  Custom implementation for AEAD.
endchoice # TRUSTED_STORAGE_TRUSTED_AEAD_CRYPTO_BACKEND

choice TRUSTED_STORAGE_TRUSTED_AEAD_BACKEND_NONCE
	prompt "AEAD nonce implementation"
	depends on TRUSTED_STORAGE_TRUSTED_AEAD_BACKEND
	default TRUSTED_STORAGE_TRUSTED_AEAD_BACKEND_NONCE_PSA_SEED_COUNTER
	help
	  Implementation to provide a AEAD nonce.

config TRUSTED_STORAGE_TRUSTED_AEAD_BACKEND_NONCE_PSA_SEED_COUNTER
	bool "PSA Nonce Seed + Counter"
	select PSA_WANT_GENERATE_RANDOM
	help
	  Use PSA Crypto for Nonce initial random seed, then incrementing
	  nonce for each AEAD encryption.

config TRUSTED_STORAGE_TRUSTED_AEAD_BACKEND_NONCE_CUSTOM
	bool "Custom"
	help
	  Use custom implementation for AEAD Nonce provider.

endchoice # TRUSTED_STORAGE_TRUSTED_AEAD_BACKEND_NONCE

choice TRUSTED_STORAGE_TRUSTED_AEAD_BACKEND_KEY
	prompt "AEAD Key implementation"
	depends on TRUSTED_STORAGE_TRUSTED_AEAD_BACKEND
	default TRUSTED_STORAGE_TRUSTED_AEAD_BACKEND_KEY_HASH_UID
	help
	  Implementation to provide the AEAD keys.

config TRUSTED_STORAGE_TRUSTED_AEAD_BACKEND_KEY_HASH_UID
	bool "Hash of UID"
	select PSA_WANT_ALG_SHA_256
	help
	  Use SHA-256 hash of UID as key

config TRUSTED_STORAGE_TRUSTED_AEAD_BACKEND_KEY_CUSTOM
	bool "Custom"
	help
	  Use custom implementation for AEAD key provider.

endchoice # TRUSTED_STORAGE_TRUSTED_AEAD_BACKEND_KEY

endif # TRUSTED_STORAGE_TRUSTED_AEAD_BACKEND

config TRUSTED_STORAGE_TRUSTED_CUSTOM_BACKEND
	bool "Custom"
	help
	  Use a custom implementation as trusted backend.

endchoice # PROTECTED_STORAGE_TRUSTED_BACKEND

choice TRUSTED_STORAGE_STORAGE_BACKEND
	prompt "Storage backend"
	depends on PSA_TRUSTED_STORAGE
	default TRUSTED_STORAGE_STORAGE_SETTINGS_BACKEND
	help
	  Implementation used to store the assets

config TRUSTED_STORAGE_STORAGE_SETTINGS_BACKEND
	bool "Settings for storage"
	depends on SETTINGS
	depends on SETTINGS_RUNTIME
	help
	  Use the Settings subsystem to store the assets

config  TRUSTED_STORAGE_STORAGE_CUSTOM_BACKEND
	bool "Custom storage implementation"
	help
	  Use custom implementation to store assets.

endchoice # CONFIG_TRUSTED_STORAGE_STORAGE_BACKEND


endif # PSA_TRUSTED_STORAGE
```

## tests/bsim/bluetooth/host/security/bond_auto_swap/testcase.yaml
```yaml
common:
  build_only: true
  tags:
    - bluetooth
  platform_allow:
    - nrf52_bsim/native
  harness: bsim

tests:
  bluetooth.host.security.bond_auto_swap.central:
    harness_config:
      bsim_exe_name: tests_bsim_bluetooth_host_security_bond_auto_swap_central_prj_conf
    extra_configs:
      - CONFIG_BT_CENTRAL=y
  bluetooth.host.security.bond_auto_swap.peripheral:
    harness_config:
      bsim_exe_name: tests_bsim_bluetooth_host_security_bond_auto_swap_peripheral_prj_conf
    extra_configs:
      - CONFIG_BT_PERIPHERAL=y
  bluetooth.host.security.bond_auto_swap.persist.central:
    harness_config:
      bsim_exe_name: tests_bsim_bluetooth_host_security_bond_auto_swap_persist_central_prj_conf
    extra_configs:
      - CONFIG_BT_CENTRAL=y
      - CONFIG_SETTINGS=y
      - CONFIG_BT_SETTINGS=y
      - CONFIG_FLASH=y
      - CONFIG_FLASH_MAP=y
      - CONFIG_NVS=y
  bluetooth.host.security.bond_auto_swap.persist.peripheral:
    harness_config:
      bsim_exe_name: tests_bsim_bluetooth_host_security_bond_auto_swap_persist_peripheral_prj_conf
    extra_configs:
      - CONFIG_BT_PERIPHERAL=y
      - CONFIG_SETTINGS=y
      - CONFIG_BT_SETTINGS=y
      - CONFIG_FLASH=y
      - CONFIG_FLASH_MAP=y
      - CONFIG_NVS=y
```

## tests/bsim/bluetooth/host/security/bond_auto_swap_multi_adv/testcase.yaml
```yaml
common:
  build_only: true
  tags:
    - bluetooth
  platform_allow:
    - nrf52_bsim/native
  harness: bsim

tests:
  bluetooth.host.security.bond_auto_swap_multi_adv.central:
    harness_config:
      bsim_exe_name: tests_bsim_bluetooth_host_security_bond_auto_swap_multi_adv_central_prj_conf
    extra_configs:
      - CONFIG_BT_CENTRAL=y
  bluetooth.host.security.bond_auto_swap_multi_adv.peripheral:
    harness_config:
      bsim_exe_name: tests_bsim_bluetooth_host_security_bond_auto_swap_multi_adv_peripheral_prj_conf
    extra_configs:
      - CONFIG_BT_PERIPHERAL=y
```

## tests/drivers/gpio/gpio_button_led/testcase.yaml
```yaml
# SPDX-License-Identifier: Apache-2.0

tests:
  drivers.gpio.button_led:
    tags:
      - drivers
      - gpio
    platform_allow:
      - native_sim
      - native_sim/native/64
    integration_platforms:
      - native_sim
    harness: ztest
```

## tests/drivers/pwm/pwm_loopback/dts/bindings/test-pwm-to-gpio-loopback.yaml
```yaml
#
# Copyright (c) 2020-2021 Vestas Wind Systems A/S
#
# SPDX-License-Identifier: Apache-2.0
#

description: |
    This binding provides resources required to build and run the
    tests/drivers/pwm/pwm_to_gpio_loopback test in Zephyr.

compatible: "test-pwm-to-gpio-loopback"

properties:
  pwms:
    type: phandle-array
    required: true
    description: |
      PWM pin that will be used for generating a pulse-width modulated signal.
  gpios:
    type: phandle-array
    required: true
    description: |
      GPIO pin will be used for capuring the generated signal. The PWM and GPIO
      pins must be physically connected to each other.
```

## tests/drivers/pwm/pwm_loopback/testcase.yaml
```yaml
tests:
  drivers.pwm.loopback:
    tags:
      - pwm
      - drivers
      - userspace
    depends_on: pwm
    filter: dt_compat_enabled("test-pwm-loopback") | dt_compat_enabled("test-pwm-to-gpio-loopback")
    harness: ztest
    harness_config:
      fixture: pwm_loopback
```

## tests/drivers/sensor/multicore_temp_sensor/testcase.yaml
```yaml
common:
  sysbuild: true
  tags:
    - drivers
    - sensors
  filter: dt_nodelabel_enabled("temp_sensor")
  harness: console
  harness_config:
    type: multi_line
    ordered: false
    regex:
      - "Temperature was successfully read 1000 times"

tests:
  drivers.sensor.multicore_temp_sensor.nrf54h20dk_cpuapp_cpurad:
    platform_allow:
      - nrf54h20dk/nrf54h20/cpuapp
    integration_platforms:
      - nrf54h20dk/nrf54h20/cpuapp
    extra_args:
      SB_CONF_FILE=sysbuild/nrf54h20dk_nrf54h20_cpurad.conf

  drivers.sensor.multicore_temp_sensor.nrf54h20dk_cpurad_cpuapp:
    platform_allow:
      - nrf54h20dk/nrf54h20/cpurad
    integration_platforms:
      - nrf54h20dk/nrf54h20/cpurad
    extra_args:
      SB_CONF_FILE=sysbuild/nrf54h20dk_nrf54h20_cpuapp.conf
```

## tests/drivers/spi/spi_nrfx_spim_no_multithreading/testcase.yaml
```yaml
# Copyright (c) 2025 Nordic Semiconductor ASA
# SPDX-License-Identifier: Apache-2.0

common:
  tags:
    - drivers
    - spi
  filter: dt_compat_enabled("nordic,nrf-spim")
tests:
  drivers.spi.nrfx_spim.no_multithreading:
    build_only: true
    extra_configs:
      - CONFIG_MULTITHREADING=n
    platform_allow:
      - nrf54lm20dk/nrf54lm20a/cpuapp
      - nrf54lm20dk/nrf54lm20b/cpuapp
      - nrf54l15dk/nrf54l15/cpuapp
      - nrf54h20dk/nrf54h20/cpuapp
    integration_platforms:
      - nrf54lm20dk/nrf54lm20a/cpuapp
```

## tests/ext/hal/nordic/nrfx/hal/testcase.yaml
```yaml
tests:
  section.subsection:
    platform_whitelist: nrf52840_pca10056
    build_only: true
    tags: my_tags
```
